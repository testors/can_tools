VERSION ""

NS_ :

BS_: 500

BU_: Vector__XXX

BO_ 170 MSG_0AA: 8 Vector__XXX
 SG_ Throttle_Position : 56|8@0+ (0.39,0) [0|100] "%" Vector__XXX

BO_ 300 MSG_12C: 8 Vector__XXX
 SG_ Brake_Position : 8|1@0+ (1,0) [0|1] "" Vector__XXX
 SG_ Engine_Speed : 16|16@0+ (1,0) [0|10000] "rpm" Vector__XXX
 SG_ Air_Temperature : 48|8@0+ (1,-40) [0|0] "��C" Vector__XXX
 SG_ Coolant_Temperature : 56|8@0+ (1,-40) [0|0] "��C" Vector__XXX
