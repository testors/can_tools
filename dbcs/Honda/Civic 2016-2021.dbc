VERSION ""

NS_ :

BS_: 500

BU_: Vector__XXX

BO_ 274 MSG_112: 8 Vector__XXX
 SG_ Clutch_Position : 56|8@0+ (0.39,0) [0|100] "%" Vector__XXX

BO_ 330 MSG_14A: 8 Vector__XXX
 SG_ Steering_Angle : 48|16@0- (0.1,0) [-600|600] "��" Vector__XXX

BO_ 344 MSG_158: 8 Vector__XXX
 SG_ Indicated_Vehicle_Speed_kph : 48|15@0+ (0.01,0) [0|0] "km/h" Vector__XXX
 SG_ Indicated_Vehicle_Speed_mph : 48|15@0+ (0.00621,0) [0|0] "mph" Vector__XXX

BO_ 380 MSG_17C: 8 Vector__XXX
 SG_ Engine_Speed : 32|16@0+ (1,0) [0|10000] "rpm" Vector__XXX
 SG_ Accelerator_Pedal_Position : 56|8@0+ (0.392,0) [0|100] "%" Vector__XXX

BO_ 420 MSG_1A4: 8 Vector__XXX
 SG_ Brake_Position : 48|16@0+ (0.15,-15.3) [0|100] "%" Vector__XXX

BO_ 464 MSG_1D0: 8 Vector__XXX
 SG_ Wheel_Speed_RR_kph : 4|15@0+ (0.01,0) [0|0] "km/h" Vector__XXX
 SG_ Wheel_Speed_RR_mph : 4|15@0+ (0.00621,0) [0|0] "mph" Vector__XXX
 SG_ Wheel_Speed_RL_kph : 19|15@0+ (0.01,0) [0|0] "km/h" Vector__XXX
 SG_ Wheel_Speed_RL_mph : 19|15@0+ (0.00621,0) [0|0] "mph" Vector__XXX
 SG_ Wheel_Speed_FR_kph : 34|15@0+ (0.01,0) [0|0] "km/h" Vector__XXX
 SG_ Wheel_Speed_FR_mph : 34|15@0+ (0.00621,0) [0|0] "mph" Vector__XXX
 SG_ Wheel_Speed_FL_kph : 49|15@0+ (0.01,0) [0|0] "km/h" Vector__XXX
 SG_ Wheel_Speed_FL_mph : 49|15@0+ (0.00621,0) [0|0] "mph" Vector__XXX

BO_ 773 MSG_305: 7 Vector__XXX
 SG_ Seat_Belt___Driver : 53|1@0+ (1,0) [0|1] "" Vector__XXX
