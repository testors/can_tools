VERSION ""

NS_ :

BS_: 500

BU_: Vector__XXX

BO_ 310 MSG_136: 8 Vector__XXX
 SG_ Accelerator_Pedal_Position : 24|8@0+ (0.5,0) [0|100] "%" Vector__XXX

BO_ 344 MSG_158: 8 Vector__XXX
 SG_ Engine_Speed : 32|16@0+ (1,0) [0|8000] "rpm" Vector__XXX

BO_ 380 MSG_17C: 8 Vector__XXX
 SG_ Brake_Position : 24|1@0+ (1,0) [0|1] "on/off" Vector__XXX

BO_ 392 MSG_188: 6 Vector__XXX
 SG_ Gear_Switch : 32|8@0+ (1,0) [0|64] "" Vector__XXX
 SG_ Gear_Requested : 48|8@0+ (1,0) [0|16] "" Vector__XXX
 SG_ Gear : 56|8@0+ (1,0) [0|16] "" Vector__XXX

BO_ 420 MSG_1A4: 8 Vector__XXX
 SG_ Brake_Position : 48|16@0+ (0.1,-10) [0|100] "%" Vector__XXX

BO_ 432 MSG_1B0: 7 Vector__XXX
 SG_ Steering_Angle : 32|16@0- (-1,0) [-720|720] "��" Vector__XXX
