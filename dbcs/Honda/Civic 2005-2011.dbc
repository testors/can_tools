VERSION ""

NS_ :

BS_: 500

BU_: Vector__XXX

BO_ 344 MSG_158: 8 Vector__XXX
 SG_ Indicated_Vehicle_Speed_kph : 16|16@0+ (0.01,0) [0|0] "km/h" Vector__XXX
 SG_ Indicated_Vehicle_Speed_mph : 16|16@0+ (0.00621,0) [0|0] "mph" Vector__XXX

BO_ 406 MSG_196: 8 Vector__XXX
 SG_ Yaw_Rate : 48|16@0- (1,0) [0|0] "" Vector__XXX

BO_ 464 MSG_1D0: 8 Vector__XXX
 SG_ Wheel_Speed_3_kph : 4|15@0+ (0.01,0) [0|0] "km/h" Vector__XXX
 SG_ Wheel_Speed_3_mph : 4|15@0+ (0.00621,0) [0|0] "mph" Vector__XXX
 SG_ Wheel_Speed_2_kph : 19|15@0+ (0.01,0) [0|0] "km/h" Vector__XXX
 SG_ Wheel_Speed_2_mph : 19|15@0+ (0.00621,0) [0|0] "mph" Vector__XXX
 SG_ Wheel_Speed_1_kph : 34|15@0+ (0.01,0) [0|0] "km/h" Vector__XXX
 SG_ Wheel_Speed_1_mph : 34|15@0+ (0.00621,0) [0|0] "mph" Vector__XXX
