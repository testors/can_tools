VERSION ""

NS_ :

BS_: 500

BU_: Vector__XXX

BO_ 520 MSG_208: 8 Vector__XXX
 SG_ Throttle_Position : 32|8@0+ (0.5,0) [0|0] "%" Vector__XXX
 SG_ Engine_Speed : 48|16@0+ (0.125,0) [0|10000] "rpm" Vector__XXX

BO_ 781 MSG_30D: 8 Vector__XXX
 SG_ Wheel_Speed_FR_kph : 32|16@0+ (0.01,0) [0|0] "km/h" Vector__XXX
 SG_ Wheel_Speed_FR_mph : 32|16@0+ (0.00621,0) [0|0] "mph" Vector__XXX
 SG_ Wheel_Speed_FL_kph : 48|16@0+ (0.01,0) [0|0] "km/h" Vector__XXX
 SG_ Wheel_Speed_FL_mph : 48|16@0+ (0.00621,0) [0|0] "mph" Vector__XXX

BO_ 840 MSG_348: 8 Vector__XXX
 SG_ Clutch_Position : 27|1@0+ (1,0) [0|0] "" Vector__XXX

BO_ 909 MSG_38D: 5 Vector__XXX
 SG_ Indicated_Vehicle_Speed_kph : 48|16@0+ (0.01,0) [0|0] "km/h" Vector__XXX
 SG_ Indicated_Vehicle_Speed_mph : 48|16@0+ (0.00621,0) [0|0] "mph" Vector__XXX

BO_ 1042 MSG_412: 8 Vector__XXX
 SG_ Ignition_On : 60|1@0+ (1,0) [0|0] "" Vector__XXX
 SG_ Brake_Position : 61|1@0+ (1,0) [0|0] "" Vector__XXX

BO_ 1101 MSG_44D: 8 Vector__XXX
 SG_ Wheel_Speed_RR_kph : 16|16@0+ (0.01,0) [0|0] "km/h" Vector__XXX
 SG_ Wheel_Speed_RR_mph : 16|16@0+ (0.00621,0) [0|0] "mph" Vector__XXX
 SG_ Wheel_Speed_RL_kph : 32|16@0+ (0.01,0) [0|0] "km/h" Vector__XXX
 SG_ Wheel_Speed_RL_mph : 32|16@0+ (0.00621,0) [0|0] "mph" Vector__XXX
 SG_ Wheel_Speed_1_kph : 48|16@0+ (0.01,0) [0|0] "km/h" Vector__XXX
 SG_ Wheel_Speed_1_mph : 48|16@0+ (0.00621,0) [0|0] "mph" Vector__XXX

BO_ 1160 MSG_488: 8 Vector__XXX
 SG_ Oil_Temperature : 16|8@0+ (1,-40) [0|0] "��C" Vector__XXX
 SG_ Fuel_Consumption : 48|8@0+ (80,0) [0|0] "mm��" Vector__XXX
 SG_ Coolant_Temperature : 56|8@0+ (1,-40) [0|0] "��C" Vector__XXX

BO_ 1293 MSG_50D: 6 Vector__XXX
 SG_ Battery_Voltage : 16|8@0+ (0.1,0) [0|0] "V" Vector__XXX

BO_ 1554 MSG_612: 5 Vector__XXX
 SG_ Side_Lights : 48|1@0+ (1,0) [0|0] "" Vector__XXX
 SG_ Headlights : 49|1@0+ (1,0) [0|0] "" Vector__XXX
