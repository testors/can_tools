VERSION ""

NS_ :

BS_: 500

BU_: Vector__XXX

BO_ 416 MSG_1A0: 8 Vector__XXX
 SG_ Indicated_Vehicle_Speed_kph : 16|16@1+ (0.004991,0) [0|410.55] "km/h" Vector__XXX
 SG_ Indicated_Vehicle_Speed_mph : 16|16@1+ (0.0031,0) [0|255] "mph" Vector__XXX

BO_ 640 MSG_280: 8 Vector__XXX
 SG_ Accelerator_Pedal_Position : 16|8@0+ (0.4,0) [0|255] "%" Vector__XXX
 SG_ Engine_Speed : 16|16@1+ (0.25,0) [0|10000] "rpm" Vector__XXX

BO_ 1088 MSG_440: 8 Vector__XXX
 SG_ Gear : 52|4@0+ (1,0) [0|255] "" Vector__XXX

BO_ 1184 MSG_4A0: 8 Vector__XXX
 SG_ Wheel_Speed_1_kph : 0|16@1+ (0.0625,0) [0|255] "km/h" Vector__XXX
 SG_ Wheel_Speed_1_mph : 0|16@1+ (0.0388125,0) [0|158.355] "mph" Vector__XXX
 SG_ Wheel_Speed_2_kph : 16|16@1+ (0.0625,0) [0|255] "km/h" Vector__XXX
 SG_ Wheel_Speed_2_mph : 16|16@1+ (0.0388125,0) [0|158.355] "mph" Vector__XXX
 SG_ Wheel_Speed_3_kph : 32|16@1+ (0.0625,0) [0|255] "km/h" Vector__XXX
 SG_ Wheel_Speed_3_mph : 32|16@1+ (0.0388125,0) [0|158.355] "mph" Vector__XXX
 SG_ Wheel_Speed_4_kph : 48|16@1+ (0.0625,0) [0|255] "km/h" Vector__XXX
 SG_ Wheel_Speed_4_mph : 48|16@1+ (0.0388125,0) [0|158.355] "mph" Vector__XXX

BO_ 1192 MSG_4A8: 8 Vector__XXX
 SG_ Brake_Pressure : 16|12@1+ (1,0) [0|255] "" Vector__XXX
