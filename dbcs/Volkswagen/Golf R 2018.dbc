VERSION ""

NS_ :

BS_: 500

BU_: Vector__XXX

BO_ 253 MSG_0FD: 8 Vector__XXX
 SG_ Indicated_Vehicle_Speed_kph : 32|16@1+ (0.01,0) [0|500] "km/h" Vector__XXX
 SG_ Indicated_Vehicle_Speed_mph : 32|16@1+ (0.00621,0) [0|310.5] "mph" Vector__XXX

BO_ 913 MSG_391: 8 Vector__XXX
 SG_ Accelerator_Pedal_Position : 16|8@0+ (0.534759,-19.8) [0|100] "%" Vector__XXX

BO_ 958 MSG_3BE: 8 Vector__XXX
 SG_ Brake_Position : 38|1@0+ (1,0) [0|1] "%" Vector__XXX

BO_ 986 MSG_3DA: 8 Vector__XXX
 SG_ Steering_Direction : 18|1@0+ (2,-1) [-1|1] "" Vector__XXX
 SG_ Clutch_Position : 40|8@0+ (0.502513,-11.6) [0|100] "%" Vector__XXX
 SG_ Steering_Angle : 43|13@1+ (0.0825,0) [0|360] "��" Vector__XXX

BO_ 988 MSG_3DC: 8 Vector__XXX
 SG_ Engine_Speed : 18|14@1+ (1,0) [0|16383] "rpm" Vector__XXX
