VERSION ""

NS_ :

BS_: 500

BU_: Vector__XXX

BO_ 159 MSG_09F: 8 Vector__XXX
 SG_ Steering_Angle : 16|15@1+ (0.15,0) [0|0] "" Vector__XXX

BO_ 168 MSG_0A8: 8 Vector__XXX
 SG_ Engine_Speed : 48|16@1+ (0.25,0) [0|10000] "rpm" Vector__XXX

BO_ 178 MSG_0B2: 8 Vector__XXX
 SG_ Wheel_Speed_RL_kph : 0|16@1+ (0.011914,0) [0|0] "km/h" Vector__XXX
 SG_ Wheel_Speed_RL_mph : 0|16@1+ (0.0074,0) [0|0] "mph" Vector__XXX
 SG_ Wheel_Speed_RR_kph : 16|16@1+ (0.011914,0) [0|0] "km/h" Vector__XXX
 SG_ Wheel_Speed_RR_mph : 16|16@1+ (0.0074,0) [0|0] "mph" Vector__XXX
 SG_ Wheel_Speed_FL_kph : 32|16@1+ (0.011914,0) [0|0] "km/h" Vector__XXX
 SG_ Wheel_Speed_FL_mph : 32|16@1+ (0.0074,0) [0|0] "mph" Vector__XXX
 SG_ Wheel_Speed_FR_kph : 48|16@1+ (0.011914,0) [0|0] "km/h" Vector__XXX
 SG_ Wheel_Speed_FR_mph : 48|16@1+ (0.0074,0) [0|0] "mph" Vector__XXX

BO_ 262 MSG_106: 8 Vector__XXX
 SG_ Brake_Position : 16|16@1+ (1,0) [0|0] "" Vector__XXX

BO_ 289 MSG_121: 8 Vector__XXX
 SG_ Throttle_Position : 12|8@1+ (1,0) [0|0] "%" Vector__XXX
