VERSION ""

NS_ :

BS_: 500

BU_: Vector__XXX

BO_ 648 MSG_288: 4 Vector__XXX
 SG_ Brake_Position : 37|4@0+ (0.125,0) [0|1.875] "" Vector__XXX
