VERSION ""

NS_ :

BS_: 500

BU_: Vector__XXX

BO_ 206 MSG_0CE: 8 Vector__XXX
 SG_ Wheel_Speed_FL_kph : 0|16@1- (0.0625,0) [-300|300] "km/h" Vector__XXX
 SG_ Wheel_Speed_FL_mph : 0|16@1- (0.0388125,0) [-186.3|186.3] "mph" Vector__XXX
 SG_ Wheel_Speed_FR_kph : 16|16@1- (0.0625,0) [-300|300] "km/h" Vector__XXX
 SG_ Wheel_Speed_FR_mph : 16|16@1- (0.0388125,0) [-186.3|186.3] "mph" Vector__XXX
 SG_ Wheel_Speed_RL_kph : 32|16@1- (0.0625,0) [-300|300] "km/h" Vector__XXX
 SG_ Wheel_Speed_RL_mph : 32|16@1- (0.0388125,0) [-186.3|186.3] "mph" Vector__XXX
 SG_ Wheel_Speed_RR_kph : 48|16@1- (0.0625,0) [-300|300] "km/h" Vector__XXX
 SG_ Wheel_Speed_RR_mph : 48|16@1- (0.0388125,0) [-186.3|186.3] "mph" Vector__XXX

BO_ 640 MSG_280: 8 Vector__XXX
 SG_ Engine_Speed : 16|16@1+ (0.25,0) [0|10000] "rpm" Vector__XXX
