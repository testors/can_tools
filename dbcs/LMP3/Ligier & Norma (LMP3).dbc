VERSION ""

NS_ :

BS_: 500

BU_: Vector__XXX

BO_ 256 MSG_100: 8 Vector__XXX
 SG_ Wheel_Speed_RR_kph : 0|16@0+ (1,0) [0|1000] "km/h" Vector__XXX
 SG_ Wheel_Speed_RR_mph : 0|16@0+ (0.621,0) [0|621] "mph" Vector__XXX
 SG_ Wheel_Speed_RL_kph : 16|16@0+ (1,0) [0|1000] "km/h" Vector__XXX
 SG_ Wheel_Speed_RL_mph : 16|16@0+ (0.621,0) [0|621] "mph" Vector__XXX
 SG_ Wheel_Speed_FR_kph : 32|16@0+ (1,0) [0|1000] "km/h" Vector__XXX
 SG_ Wheel_Speed_FR_mph : 32|16@0+ (0.621,0) [0|621] "mph" Vector__XXX
 SG_ Wheel_Speed_FL_kph : 48|16@0+ (1,0) [0|1000] "km/h" Vector__XXX
 SG_ Wheel_Speed_FL_mph : 48|16@0+ (0.621,0) [0|621] "mph" Vector__XXX

BO_ 264 MSG_108: 8 Vector__XXX
 SG_ Transmission_Oil_Temperature : 0|16@0+ (1,6) [6|200] "��C" Vector__XXX
 SG_ Throttle_Position : 48|16@0+ (1,0) [0|100] "%" Vector__XXX

BO_ 272 MSG_110: 8 Vector__XXX
 SG_ Oil_Temperature : 16|16@0+ (1,0) [0|65537] "��C" Vector__XXX
 SG_ Coolant_Temperature : 32|16@0+ (1,0) [0|10000] "��C" Vector__XXX
 SG_ Air_Temperature : 56|8@0+ (1,0) [0|100] "��C" Vector__XXX

BO_ 296 MSG_128: 8 Vector__XXX
 SG_ Oil_Pressure : 48|16@0+ (0.001,0) [0|65.535] "mbar" Vector__XXX

BO_ 312 MSG_138: 8 Vector__XXX
 SG_ Steering_Angle : 48|16@0- (1,0) [-3276.8|3276.7] "��" Vector__XXX

BO_ 368 MSG_170: 8 Vector__XXX
 SG_ Indicated_Vehicle_Speed_kph : 0|16@0+ (1,0) [0|1000] "km/h" Vector__XXX
 SG_ Indicated_Vehicle_Speed_mph : 0|16@0+ (0.621,0) [0|621] "mph" Vector__XXX
 SG_ Engine_Speed : 48|16@0+ (1,0) [0|10000] "rpm" Vector__XXX

BO_ 392 MSG_188: 8 Vector__XXX
 SG_ Gear : 32|16@0+ (1,0) [0|16] "" Vector__XXX

BO_ 432 MSG_1B0: 8 Vector__XXX
 SG_ Brake_Pressure : 48|16@0+ (1,0) [0|65535] "bar" Vector__XXX
