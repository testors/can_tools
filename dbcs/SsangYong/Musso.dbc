VERSION ""

NS_ :

BS_: 500

BU_: Vector__XXX

BO_ 512 MSG_200: 8 Vector__XXX
 SG_ Wheel_Speed_FR_kph : 16|14@0+ (0.060375,0) [0|0] "km/h" Vector__XXX
 SG_ Wheel_Speed_FR_mph : 16|14@0+ (0.0375,0) [0|0] "mph" Vector__XXX
 SG_ Wheel_Speed_FL_kph : 32|14@0+ (0.060375,0) [0|0] "km/h" Vector__XXX
 SG_ Wheel_Speed_FL_mph : 32|14@0+ (0.0375,0) [0|0] "mph" Vector__XXX
 SG_ Handbrake : 57|1@0+ (1,0) [0|0] "on/off" Vector__XXX

BO_ 520 MSG_208: 8 Vector__XXX
 SG_ Wheel_Speed_RL_kph : 0|14@0+ (0.060375,0) [0|0] "km/h" Vector__XXX
 SG_ Wheel_Speed_RL_mph : 0|14@0+ (0.0375,0) [0|0] "mph" Vector__XXX
 SG_ Wheel_Speed_RR_kph : 16|14@0+ (0.060375,0) [0|0] "km/h" Vector__XXX
 SG_ Wheel_Speed_RR_mph : 16|14@0+ (0.0375,0) [0|0] "mph" Vector__XXX
 SG_ Brake_Position : 32|12@0+ (0.032552083333,0) [0|0] "%" Vector__XXX

BO_ 532 MSG_214: 8 Vector__XXX
 SG_ Throttle_Position : 8|8@0+ (0.5,-15.024) [0|100] "%" Vector__XXX

BO_ 800 MSG_320: 8 Vector__XXX
 SG_ Brake_Light : 26|2@0+ (1,0) [0|3] "on/off" Vector__XXX

BO_ 1033 MSG_409: 8 Vector__XXX
 SG_ Indicated_Vehicle_Speed_kph : 40|10@0+ (1,0) [0|1023] "km/h" Vector__XXX
 SG_ Indicated_Vehicle_Speed_mph : 40|10@0+ (0.621,0) [0|635.283] "mph" Vector__XXX
