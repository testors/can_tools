VERSION ""

NS_ :

BS_: 500

BU_: Vector__XXX

BO_ 496 MSG_1F0: 8 Vector__XXX
 SG_ Wheel_Speed_1_kph : 0|16@1+ (0.0625,0) [2.75|500] "km/h" Vector__XXX
 SG_ Wheel_Speed_1_mph : 0|16@1+ (0.0388125,0) [1.70775|310.5] "mph" Vector__XXX
 SG_ Wheel_Speed_2_kph : 16|16@1+ (0.0625,0) [2.75|500] "km/h" Vector__XXX
 SG_ Wheel_Speed_2_mph : 16|16@1+ (0.0388125,0) [1.70775|310.5] "mph" Vector__XXX
 SG_ Wheel_Speed_3_kph : 32|16@1+ (0.0625,0) [2.75|500] "km/h" Vector__XXX
 SG_ Wheel_Speed_3_mph : 32|16@1+ (0.0388125,0) [1.70775|310.5] "mph" Vector__XXX
 SG_ Wheel_Speed_4_kph : 48|16@1+ (0.0625,0) [2.75|500] "km/h" Vector__XXX
 SG_ Wheel_Speed_4_mph : 48|16@1+ (0.0388125,0) [1.70775|310.5] "mph" Vector__XXX

BO_ 1119 MSG_45F: 8 Vector__XXX
 SG_ Gear : 48|3@1+ (1,0) [0|7] "" Vector__XXX

BO_ 1423 MSG_58F: 8 Vector__XXX
 SG_ Engine_Speed : 16|16@1+ (5,0) [0|10000] "rpm" Vector__XXX

BO_ 1471 MSG_5BF: 8 Vector__XXX
 SG_ Throttle_Position : 48|16@1+ (0.0015259021897,0) [0|0] "%" Vector__XXX
