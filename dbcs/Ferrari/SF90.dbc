VERSION ""

NS_ :

BS_: 500

BU_: Vector__XXX

BO_ 175 MSG_0AF: 8 Vector__XXX
 SG_ Yaw_Rate : 8|12@0+ (0.08,-163.84) [-163.84|163.68] "��/s" Vector__XXX
 SG_ Indicated_Lateral_Acceleration : 20|12@0+ (0.02,-40.96) [-40.96|40.92] "m/s��" Vector__XXX
 SG_ Indicated_Longitudinal_Acceleration : 32|12@0+ (0.02,-40.96) [-40.96|40.92] "m/s��" Vector__XXX

BO_ 204 MSG_0CC: 6 Vector__XXX
 SG_ Steering_Angle : 24|16@0- (0.1,0) [-3276.8|3276.7] "��" Vector__XXX
 SG_ Steering_Rate : 40|8@0+ (4,0) [0|1016] "��/s" Vector__XXX

BO_ 865 MSG_361: 8 Vector__XXX
 SG_ Engine_Speed : 32|16@0+ (1,0) [0|10000] "rpm" Vector__XXX

BO_ 1376 MSG_560: 8 Vector__XXX
 SG_ Fuel_Level : 16|8@0+ (1,0) [0|100] "%" Vector__XXX
 SG_ Air_Temperature : 32|8@0+ (0.5,-40) [-40|87.5] "��C" Vector__XXX

BO_ 1377 MSG_561: 8 Vector__XXX
 SG_ Fuel_Consumption : 16|16@0+ (0.0022,0) [0|132] "L/h" Vector__XXX
 SG_ Coolant_Temperature : 32|8@0+ (1,-40) [-40|215] "��C" Vector__XXX

BO_ 1382 MSG_566: 8 Vector__XXX
 SG_ Indicated_Vehicle_Speed_kph : 32|13@0+ (0.0625,0) [0|512] "km/h" Vector__XXX
 SG_ Indicated_Vehicle_Speed_mph : 32|13@0+ (0.0388125,0) [0|317.952] "mph" Vector__XXX

BO_ 1387 MSG_56B: 8 Vector__XXX
 SG_ Gear : 41|4@0+ (1,0) [0|15] "" Vector__XXX

BO_ 1409 MSG_581: 8 Vector__XXX
 SG_ Air_Pressure : 40|8@0+ (15,0) [0|3825] "mbar" Vector__XXX
