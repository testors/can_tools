VERSION ""

NS_ :

BS_: 500

BU_: Vector__XXX

BO_ 1280 MSG_500: 8 Vector__XXX
 SG_ Engine_Speed : 0|16@1+ (1,0) [0|9000] "rpm" Vector__XXX

BO_ 1281 MSG_501: 8 Vector__XXX
 SG_ Wheel_Speed_FL_kph : 0|16@1+ (0.01,0) [0|655.35] "km/h" Vector__XXX
 SG_ Wheel_Speed_FL_mph : 0|16@1+ (0.00621,0) [0|406.97235] "mph" Vector__XXX
 SG_ Wheel_Speed_FR_kph : 16|16@1+ (0.01,0) [0|655.35] "km/h" Vector__XXX
 SG_ Wheel_Speed_FR_mph : 16|16@1+ (0.00621,0) [0|406.97235] "mph" Vector__XXX
 SG_ Wheel_Speed_RL_kph : 32|16@1+ (0.01,0) [0|655.35] "km/h" Vector__XXX
 SG_ Wheel_Speed_RL_mph : 32|16@1+ (0.00621,0) [0|406.97235] "mph" Vector__XXX
 SG_ Wheel_Speed_RR_kph : 48|16@1+ (0.01,0) [0|655.35] "km/h" Vector__XXX
 SG_ Wheel_Speed_RR_mph : 48|16@1+ (0.00621,0) [0|406.97235] "mph" Vector__XXX

BO_ 1284 MSG_504: 8 Vector__XXX
 SG_ Accelerator_Pedal_Position : 48|16@1+ (0.01,0) [0|100] "%" Vector__XXX

BO_ 1285 MSG_505: 8 Vector__XXX
 SG_ Indicated_Longitudinal_Acceleration : 0|16@1- (0.001,0) [-4.2|4.2] "g" Vector__XXX
 SG_ Indicated_Lateral_Acceleration : 16|16@1- (0.001,0) [-4.2|4.2] "g" Vector__XXX

BO_ 1289 MSG_509: 8 Vector__XXX
 SG_ Brake_Pressure : 0|16@1+ (0.005,0) [0|260] "bar" Vector__XXX
 SG_ Steering_Angle : 48|16@1- (0.01,0) [-327.67|327.67] "��" Vector__XXX

BO_ 1293 MSG_50D: 8 Vector__XXX
 SG_ Gear : 0|8@1- (1,0) [0|6] "" Vector__XXX
