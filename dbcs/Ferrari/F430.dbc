VERSION ""

NS_ :

BS_: 500

BU_: Vector__XXX

BO_ 192 MSG_0C0: 8 Vector__XXX
 SG_ Steering_Angle : 0|16@1- (0.1,0) [-720|720] "" Vector__XXX

BO_ 390 MSG_186: 8 Vector__XXX
 SG_ Brake_Position : 0|16@0+ (0.02,0) [0|100] "%" Vector__XXX

BO_ 496 MSG_1F0: 8 Vector__XXX
 SG_ Wheel_Speed_FL_kph : 0|16@1+ (0.0625,0) [0|0] "km/h" Vector__XXX
 SG_ Wheel_Speed_FL_mph : 0|16@1+ (0.0388125,0) [0|0] "mph" Vector__XXX
 SG_ Wheel_Speed_FR_kph : 16|16@1+ (0.0625,0) [0|0] "km/h" Vector__XXX
 SG_ Wheel_Speed_FR_mph : 16|16@1+ (0.0388125,0) [0|0] "mph" Vector__XXX
 SG_ Wheel_Speed_RL_kph : 32|16@1+ (0.0625,0) [0|0] "km/h" Vector__XXX
 SG_ Wheel_Speed_RL_mph : 32|16@1+ (0.0388125,0) [0|0] "mph" Vector__XXX
 SG_ Wheel_Speed_RR_kph : 48|16@1+ (0.0625,0) [0|0] "km/h" Vector__XXX
 SG_ Wheel_Speed_RR_mph : 48|16@1+ (0.0388125,0) [0|0] "mph" Vector__XXX

BO_ 790 MSG_316: 8 Vector__XXX
 SG_ Throttle_Position : 0|8@1+ (0.5,0) [0|0] "" Vector__XXX

BO_ 892 MSG_37C: 8 Vector__XXX
 SG_ Engine_Speed : 16|16@1+ (0.25,0) [0|10000] "rpm" Vector__XXX

BO_ 1119 MSG_45F: 8 Vector__XXX
 SG_ Gear : 16|3@1+ (1,0) [0|0] "" Vector__XXX
