VERSION ""

NS_ :

BS_: 500

BU_: Vector__XXX

BO_ 70 MSG_046: 8 Vector__XXX
 SG_ Yaw_Rate___Filtered : 20|12@0+ (0.0625,-128) [-128|127.938] "��/s" Vector__XXX
 SG_ Brake_Pressure : 40|10@0+ (0.25,0) [0|200] "bar" Vector__XXX

BO_ 129 MSG_081: 8 Vector__XXX
 SG_ Air_Pressure : 0|8@0+ (1.30412,700) [700|1032.551875] "mbar" Vector__XXX
 SG_ Coolant_Temperature : 24|8@0+ (1,-40) [-40|215] "��C" Vector__XXX

BO_ 175 MSG_0AF: 8 Vector__XXX
 SG_ Yaw_Rate : 8|12@0+ (0.08,-163.84) [-163.84|163.68] "��/s" Vector__XXX
 SG_ Indicated_Lateral_Acceleration : 20|12@0+ (0.02,-40.96) [-40.96|40.92] "m/s��" Vector__XXX
 SG_ Indicated_Longitudinal_Acceleration : 32|12@0+ (0.02,-40.96) [-40.96|40.92] "m/s��" Vector__XXX

BO_ 204 MSG_0CC: 5 Vector__XXX
 SG_ Steering_Angle : 24|16@0- (0.1,0) [-3276.8|3276.7] "��" Vector__XXX
 SG_ Steering_Rate : 40|8@0+ (4,0) [0|1016] "��/s" Vector__XXX

BO_ 358 MSG_166: 8 Vector__XXX
 SG_ Wheel_Speed_2_kph : 0|13@0+ (0.0625,-2.75) [-2.75|509.1875] "km/h" Vector__XXX
 SG_ Wheel_Speed_2_mph : 0|13@0+ (0.0388125,-2.75) [-1.70775|316.2054375] "mph" Vector__XXX
 SG_ Wheel_Speed_4_kph : 16|13@0+ (0.0625,-2.75) [-2.75|509.1875] "km/h" Vector__XXX
 SG_ Wheel_Speed_4_mph : 16|13@0+ (0.0388125,-2.75) [-1.70775|316.2054375] "mph" Vector__XXX
 SG_ Wheel_Speed_1_kph : 32|13@0+ (0.0625,-2.75) [-2.75|509.1875] "km/h" Vector__XXX
 SG_ Wheel_Speed_1_mph : 32|13@0+ (0.0388125,-2.75) [-1.70775|316.2054375] "mph" Vector__XXX
 SG_ Wheel_Speed_3_kph : 48|13@0+ (0.0625,-2.75) [-2.75|509.1875] "km/h" Vector__XXX
 SG_ Wheel_Speed_3_mph : 48|13@0+ (0.0388125,-2.75) [-1.70775|316.2054375] "mph" Vector__XXX

BO_ 516 MSG_204: 4 Vector__XXX
 SG_ ABS_Switch_Position : 56|4@0+ (1,1) [1|16] "" Vector__XXX

BO_ 865 MSG_361: 8 Vector__XXX
 SG_ Accelerator_Pedal_Position : 0|8@0+ (0.392,0) [0|99.96] "%" Vector__XXX
 SG_ Engine_Speed : 32|16@0+ (1,0) [0|10240] "rpm" Vector__XXX

BO_ 929 MSG_3A1: 8 Vector__XXX
 SG_ Throttle_Position : 24|8@0+ (0.392157,0) [0|100] "%" Vector__XXX

BO_ 1376 MSG_560: 8 Vector__XXX
 SG_ Fuel_Level : 16|8@0+ (1,0) [0|100] "%" Vector__XXX

BO_ 1377 MSG_561: 8 Vector__XXX
 SG_ Fuel_Consumption : 16|16@0+ (0.0022,0) [0|132] "L/h" Vector__XXX
 SG_ Coolant_Temperature_2 : 32|8@0+ (1,-40) [-40|215] "��C" Vector__XXX

BO_ 1382 MSG_566: 8 Vector__XXX
 SG_ Indicated_Vehicle_Speed_kph : 32|13@0+ (0.0625,0) [0|512] "km/h" Vector__XXX
 SG_ Indicated_Vehicle_Speed_mph : 32|13@0+ (0.0388125,0) [0|317.952] "mph" Vector__XXX

BO_ 1387 MSG_56B: 8 Vector__XXX
 SG_ Gear : 41|4@0+ (1,0) [0|15] "" Vector__XXX

BO_ 1409 MSG_581: 8 Vector__XXX
 SG_ Manifold_Pressure : 40|8@0+ (15,0) [0|3825] "mbar" Vector__XXX

BO_ 1504 MSG_5E0: 4 Vector__XXX
 SG_ Traction_Control_Switch_2_Position : 8|2@0+ (-1,4) [0|3] "" Vector__XXX
 SG_ Traction_Control_Switch_1_Position : 60|4@0+ (-0.5,5) [-2.5|5] "" Vector__XXX
