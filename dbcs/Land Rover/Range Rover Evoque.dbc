VERSION ""

NS_ :

BS_: 500

BU_: Vector__XXX

BO_ 277 MSG_115: 8 Vector__XXX
 SG_ Throttle_Position : 32|10@0+ (0.101729,0) [0|104.069175992] "%" Vector__XXX

BO_ 323 MSG_143: 8 Vector__XXX
 SG_ Clutch_Position : 24|10@0+ (0.126422,-12.6422) [-12.6422250316|116.687737042] "%" Vector__XXX

BO_ 336 MSG_150: 8 Vector__XXX
 SG_ Wheel_Speed_RR_kph : 0|16@0+ (0.01,-327.7) [0|655.35] "km/h" Vector__XXX
 SG_ Wheel_Speed_RR_mph : 0|16@0+ (0.00621,-327.7) [0|406.97235] "mph" Vector__XXX
 SG_ Wheel_Speed_RL_kph : 24|16@0+ (0.01,0) [0|655.35] "km/h" Vector__XXX
 SG_ Wheel_Speed_RL_mph : 24|16@0+ (0.00621,0) [0|406.97235] "mph" Vector__XXX

BO_ 341 MSG_155: 8 Vector__XXX
 SG_ Wheel_Speed_FL_kph : 8|16@0+ (0.01,0) [0|655.35] "km/h" Vector__XXX
 SG_ Wheel_Speed_FL_mph : 8|16@0+ (0.00621,0) [0|406.97235] "mph" Vector__XXX

BO_ 592 MSG_250: 8 Vector__XXX
 SG_ Brake_Position : 32|10@0+ (0.0977517,0) [0|100] "%" Vector__XXX

BO_ 693 MSG_2B5: 8 Vector__XXX
 SG_ Wheel_Speed_FR_kph : 8|16@0+ (0.01,-327.7) [-327.68|300] "km/h" Vector__XXX
 SG_ Wheel_Speed_FR_mph : 8|16@0+ (0.00621,-327.7) [-203.48928|186.3] "mph" Vector__XXX

BO_ 765 MSG_2FD: 8 Vector__XXX
 SG_ Steering_Angle : 16|16@0+ (-0.099889,1638.68) [-4907.54716981|1638.67924528] "��" Vector__XXX
