VERSION ""

NS_ :

BS_: 500

BU_: Vector__XXX

BO_ 223 MSG_0DF: 8 Vector__XXX
 SG_ Engine_Speed : 0|13@0+ (2,0) [0|8000] "rpm" Vector__XXX

BO_ 224 MSG_0E0: 8 Vector__XXX
 SG_ Throttle_Position : 16|10@0+ (0.1,0) [0|99.9] "%" Vector__XXX

BO_ 696 MSG_2B8: 8 Vector__XXX
 SG_ Indicated_Vehicle_Speed_kph : 0|15@0+ (0.01,0) [0|327] "km/h" Vector__XXX
 SG_ Indicated_Vehicle_Speed_mph : 0|15@0+ (0.00621,0) [0|203.067] "mph" Vector__XXX

BO_ 733 MSG_2DD: 8 Vector__XXX
 SG_ Wheel_Speed_RR_kph : 0|15@0+ (0.01,0) [0|327] "km/h" Vector__XXX
 SG_ Wheel_Speed_RR_mph : 0|15@0+ (0.00621,0) [0|203.067] "mph" Vector__XXX
 SG_ Wheel_Speed_RL_kph : 16|15@0+ (0.01,0) [0|327] "km/h" Vector__XXX
 SG_ Wheel_Speed_RL_mph : 16|15@0+ (0.00621,0) [0|203.067] "mph" Vector__XXX
 SG_ Wheel_Speed_FR_kph : 32|15@0+ (0.01,0) [0|327] "km/h" Vector__XXX
 SG_ Wheel_Speed_FR_mph : 32|15@0+ (0.00621,0) [0|203.067] "mph" Vector__XXX
 SG_ Wheel_Speed_FL_kph : 48|15@0+ (0.01,0) [0|327] "km/h" Vector__XXX
 SG_ Wheel_Speed_FL_mph : 48|15@0+ (0.00621,0) [0|203.067] "mph" Vector__XXX
