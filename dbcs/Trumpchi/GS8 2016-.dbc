VERSION ""

NS_ :

BS_: 500

BU_: Vector__XXX

BO_ 386 MSG_182: 8 Vector__XXX
 SG_ Engine_Speed : 32|16@0+ (1,0) [0|8000] "rpm" Vector__XXX

BO_ 428 MSG_1AC: 8 Vector__XXX
 SG_ Gear_Switch : 56|4@0+ (1,0) [0|15] "" Vector__XXX

BO_ 612 MSG_264: 8 Vector__XXX
 SG_ Steering_Angle : 24|16@0+ (0.1,-780) [-720|720] "��" Vector__XXX
 SG_ Steering_Rate : 40|8@0+ (1,0) [0|255] "" Vector__XXX

BO_ 620 MSG_26C: 8 Vector__XXX
 SG_ Wheel_Speed_FR : 24|13@0+ (1,0) [0|8191] "" Vector__XXX
 SG_ Wheel_Speed_FL : 40|13@0+ (1,0) [0|8191] "" Vector__XXX

BO_ 621 MSG_26D: 8 Vector__XXX
 SG_ Wheel_Speed_RR : 24|13@0+ (1,0) [0|8191] "" Vector__XXX
 SG_ Wheel_Speed_RL : 40|13@0+ (1,0) [0|8191] "" Vector__XXX

BO_ 633 MSG_279: 8 Vector__XXX
 SG_ Accelerator_Pedal_Position : 56|8@0+ (0.392157,0) [0|100] "%" Vector__XXX

BO_ 652 MSG_28C: 8 Vector__XXX
 SG_ Brake_Position : 48|12@0+ (0.05,0) [0|100] "%" Vector__XXX
