VERSION ""

NS_ :

BS_: 500

BU_: Vector__XXX

BO_ 310 MSG_136: 5 Vector__XXX
 SG_ Throttle_Position : 24|8@0+ (0.510204,0) [0|100] "%" Vector__XXX

BO_ 380 MSG_17C: 8 Vector__XXX
 SG_ Engine_Speed : 32|16@0+ (1,0) [0|10000] "rpm" Vector__XXX
