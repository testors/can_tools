VERSION ""

NS_ :

BS_: 500

BU_: Vector__XXX

BO_ 768 MSG_300: 8 Vector__XXX
 SG_ Gear : 0|4@0+ (1,0) [0|15] "" Vector__XXX

BO_ 834 MSG_342: 4 Vector__XXX
 SG_ Brake_Position : 20|12@1+ (0.925926,-0.925926) [-0.925925925926|3790.74074074] "%" Vector__XXX

BO_ 1024 MSG_400: 8 Vector__XXX
 SG_ Coolant_Temperature : 16|8@0+ (1,0) [0|0] "" Vector__XXX
 SG_ Engine_Speed : 32|16@0+ (1,0) [0|10000] "rpm" Vector__XXX
 SG_ Indicated_Vehicle_Speed_kph : 56|8@0+ (1.00040761951,0) [0|0] "km/h" Vector__XXX
 SG_ Indicated_Vehicle_Speed_mph : 56|8@0+ (0.62137119224,0) [0|0] "mph" Vector__XXX

BO_ 1028 MSG_404: 5 Vector__XXX
 SG_ Throttle_Position : 56|8@0+ (0.392157,0) [0|100] "%" Vector__XXX
