VERSION ""

NS_ :

BS_: 500

BU_: Vector__XXX

BO_ 264 MSG_108: 8 Vector__XXX
 SG_ Throttle_Position : 16|12@0+ (0.105708,0) [0|432.8752] "%" Vector__XXX

BO_ 368 MSG_170: 8 Vector__XXX
 SG_ Engine_Speed : 48|16@0+ (1,0) [0|10000] "rpm" Vector__XXX

BO_ 392 MSG_188: 8 Vector__XXX
 SG_ Gear : 32|4@0+ (1,-1) [-1|7] "" Vector__XXX
