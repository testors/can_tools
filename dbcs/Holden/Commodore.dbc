VERSION ""

NS_ :

BS_: 500

BU_: Vector__XXX

BO_ 201 MSG_0C9: 8 Vector__XXX
 SG_ Engine_Speed : 8|16@1+ (0.25,0) [0|10000] "rpm" Vector__XXX

BO_ 241 MSG_0F1: 8 Vector__XXX
 SG_ Brake_Pressure : 8|8@1+ (1,0) [0|1500] "psi" Vector__XXX

BO_ 401 MSG_191: 8 Vector__XXX
 SG_ Throttle_Position : 48|8@1+ (0.392156862745,0) [0|100] "%" Vector__XXX

BO_ 485 MSG_1E5: 8 Vector__XXX
 SG_ Steering_Angle : 8|16@1- (0.002,0) [-20|20] "��" Vector__XXX

BO_ 840 MSG_348: 8 Vector__XXX
 SG_ Wheel_Speed_RL_kph : 0|16@1+ (0.0315,0) [0|250] "km/h" Vector__XXX
 SG_ Wheel_Speed_RL_mph : 0|16@1+ (0.0195615,0) [0|155.25] "mph" Vector__XXX
 SG_ Wheel_Speed_RR : 16|16@1+ (0.0315,0) [0|250] "" Vector__XXX

BO_ 842 MSG_34A: 8 Vector__XXX
 SG_ Wheel_Speed_FL_kph : 0|16@1+ (0.0315,0) [0|250] "km/h" Vector__XXX
 SG_ Wheel_Speed_FL_mph : 0|16@1+ (0.0195615,0) [0|155.25] "mph" Vector__XXX
 SG_ Wheel_Speed_FR_kph : 16|16@1+ (0.0315,0) [0|250] "km/h" Vector__XXX
 SG_ Wheel_Speed_FR_mph : 16|16@1+ (0.0195615,0) [0|155.25] "mph" Vector__XXX
