VERSION ""

NS_ :

BS_: 500

BU_: Vector__XXX

BO_ 37 MSG_025: 8 Vector__XXX
 SG_ Steering_Angle : 48|12@0- (-1.5,0) [-3070.5|3070.5] "��" Vector__XXX

BO_ 170 MSG_0AA: 8 Vector__XXX
 SG_ Wheel_Speed_RL_kph : 0|16@0+ (0.01,-67.67) [0|65535] "km/h" Vector__XXX
 SG_ Wheel_Speed_RL_mph : 0|16@0+ (0.00621,-67.67) [0|40697.235] "mph" Vector__XXX
 SG_ Wheel_Speed_RR_kph : 16|16@0+ (0.01,-67.67) [0|65535] "km/h" Vector__XXX
 SG_ Wheel_Speed_RR_mph : 16|16@0+ (0.00621,-67.67) [0|40697.235] "mph" Vector__XXX
 SG_ Wheel_Speed_FL_kph : 32|16@0+ (0.01,-67.67) [0|65535] "km/h" Vector__XXX
 SG_ Wheel_Speed_FL_mph : 32|16@0+ (0.00621,-67.67) [0|40697.235] "mph" Vector__XXX
 SG_ Wheel_Speed_FR_kph : 48|16@0+ (0.01,-67.67) [0|65535] "km/h" Vector__XXX
 SG_ Wheel_Speed_FR_mph : 48|16@0+ (0.00621,-67.67) [0|40697.235] "mph" Vector__XXX

BO_ 464 MSG_1D0: 8 Vector__XXX
 SG_ Engine_Speed : 48|16@0+ (0.4,0) [0|65535] "rpm" Vector__XXX

BO_ 548 MSG_224: 8 Vector__XXX
 SG_ Brake_Position : 16|16@0+ (0.1,0) [0|100] "%" Vector__XXX
 SG_ Brake_Light : 61|1@0+ (1,0) [0|0] "on/off" Vector__XXX

BO_ 705 MSG_2C1: 8 Vector__XXX
 SG_ Accelerator_Pedal_Position : 8|8@0+ (0.5,0) [0|100] "%" Vector__XXX
