VERSION ""

NS_ :

BS_: 500

BU_: Vector__XXX

BO_ 37 MSG_025: 8 Vector__XXX
 SG_ Steering_Angle : 48|12@0- (1.5,0) [-3070.5|3070.5] "��" Vector__XXX

BO_ 170 MSG_0AA: 8 Vector__XXX
 SG_ Wheel_Speed_4_kph : 0|16@0+ (0.01,-67.67) [0|500] "km/h" Vector__XXX
 SG_ Wheel_Speed_4_mph : 0|16@0+ (0.00621,-67.67) [0|310.5] "mph" Vector__XXX
 SG_ Wheel_Speed_3_kph : 16|16@0+ (0.01,-67.67) [0|500] "km/h" Vector__XXX
 SG_ Wheel_Speed_3_mph : 16|16@0+ (0.00621,-67.67) [0|310.5] "mph" Vector__XXX
 SG_ Wheel_Speed_2_kph : 32|16@0+ (0.01,-67.67) [0|500] "km/h" Vector__XXX
 SG_ Wheel_Speed_2_mph : 32|16@0+ (0.00621,-67.67) [0|310.5] "mph" Vector__XXX
 SG_ Wheel_Speed_1_kph : 48|16@0+ (0.01,-67.67) [0|500] "km/h" Vector__XXX
 SG_ Wheel_Speed_1_mph : 48|16@0+ (0.00621,-67.67) [0|310.5] "mph" Vector__XXX

BO_ 180 MSG_0B4: 8 Vector__XXX
 SG_ Indicated_Vehicle_Speed_kph : 8|16@0+ (0.01,0) [0|655] "km/h" Vector__XXX
 SG_ Indicated_Vehicle_Speed_mph : 8|16@0+ (0.00621,0) [0|406.755] "mph" Vector__XXX

BO_ 452 MSG_1C4: 8 Vector__XXX
 SG_ Engine_Speed : 48|16@0+ (0.8,0) [0|10000] "rpm" Vector__XXX

BO_ 548 MSG_224: 6 Vector__XXX
 SG_ Brake_Position : 16|16@0+ (0.124224,0) [0|8141] "%" Vector__XXX

BO_ 581 MSG_245: 8 Vector__XXX
 SG_ Throttle_Position : 16|8@1+ (0.5,0) [0|127.5] "%" Vector__XXX
