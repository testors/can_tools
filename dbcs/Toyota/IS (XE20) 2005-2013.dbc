VERSION ""

NS_ :

BS_: 500

BU_: Vector__XXX

BO_ 37 MSG_025: 8 Vector__XXX
 SG_ Steering_Angle : 48|12@0- (-1.5,0) [-720|720] "��" Vector__XXX

BO_ 176 MSG_0B0: 6 Vector__XXX
 SG_ Wheel_Speed_2_kph : 32|16@0+ (0.0109319,0) [0|402.5] "km/h" Vector__XXX
 SG_ Wheel_Speed_2_mph : 32|16@0+ (0.00679,0) [0|250] "mph" Vector__XXX
 SG_ Wheel_Speed_1_kph : 48|16@0+ (0.0109319,0) [0|402.5] "km/h" Vector__XXX
 SG_ Wheel_Speed_1_mph : 48|16@0+ (0.00679,0) [0|250] "mph" Vector__XXX

BO_ 178 MSG_0B2: 6 Vector__XXX
 SG_ Wheel_Speed_4_kph : 32|16@0+ (0.0109319,0) [0|402.5] "km/h" Vector__XXX
 SG_ Wheel_Speed_4_mph : 32|16@0+ (0.00679,0) [0|250] "mph" Vector__XXX
 SG_ Wheel_Speed_3_kph : 48|16@0+ (0.0109319,0) [0|402.5] "km/h" Vector__XXX
 SG_ Wheel_Speed_3_mph : 48|16@0+ (0.00679,0) [0|250] "mph" Vector__XXX

BO_ 180 MSG_0B4: 8 Vector__XXX
 SG_ Indicated_Vehicle_Speed_kph : 8|16@0+ (0.01,0) [0|655] "km/h" Vector__XXX
 SG_ Indicated_Vehicle_Speed_mph : 8|16@0+ (0.00621,0) [0|406.755] "mph" Vector__XXX

BO_ 548 MSG_224: 8 Vector__XXX
 SG_ Brake_Position : 16|16@0+ (0.1,0) [0|100] "%" Vector__XXX

BO_ 705 MSG_2C1: 8 Vector__XXX
 SG_ Accelerator_Pedal_Position : 8|8@0+ (1,0) [0|100] "%" Vector__XXX

BO_ 708 MSG_2C4: 8 Vector__XXX
 SG_ Engine_Speed : 48|16@0+ (0.8,0) [0|8000] "rpm" Vector__XXX

BO_ 720 MSG_2D0: 8 Vector__XXX
 SG_ Gear : 24|4@0+ (1,0) [0|8] "" Vector__XXX
