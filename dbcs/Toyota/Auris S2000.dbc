VERSION ""

NS_ :

BS_: 500

BU_: Vector__XXX

BO_ 768 MSG_300: 8 Vector__XXX
 SG_ Throttle_Position : 32|16@0+ (0.392156862745,0) [0|0] "%" Vector__XXX
 SG_ Engine_Speed : 48|16@0+ (1,0) [0|10000] "rpm" Vector__XXX

BO_ 774 MSG_306: 8 Vector__XXX
 SG_ Oil_Pressure : 16|16@0+ (1,0) [0|0] "mbar" Vector__XXX
 SG_ Gear : 48|16@0+ (1,0) [0|0] "" Vector__XXX
