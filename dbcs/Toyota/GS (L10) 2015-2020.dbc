VERSION ""

NS_ :

BS_: 500

BU_: Vector__XXX

BO_ 37 MSG_025: 8 Vector__XXX
 SG_ Steering_Angle : 48|12@0- (1.5,0) [-3070.5|3070.5] "��" Vector__XXX

BO_ 170 MSG_0AA: 8 Vector__XXX
 SG_ Wheel_Speed_RL_kph : 0|16@0+ (0.01,-67.67) [0|65535] "km/h" Vector__XXX
 SG_ Wheel_Speed_RL_mph : 0|16@0+ (0.00621,-67.67) [0|40697.235] "mph" Vector__XXX
 SG_ Wheel_Speed_RR_kph : 16|16@0+ (0.01,-67.67) [0|65535] "km/h" Vector__XXX
 SG_ Wheel_Speed_RR_mph : 16|16@0+ (0.00621,-67.67) [0|40697.235] "mph" Vector__XXX
 SG_ Wheel_Speed_FL_kph : 32|16@0+ (0.01,-67.67) [0|65535] "km/h" Vector__XXX
 SG_ Wheel_Speed_FL_mph : 32|16@0+ (0.00621,-67.67) [0|40697.235] "mph" Vector__XXX
 SG_ Wheel_Speed_FR_kph : 48|16@0+ (0.01,-67.67) [0|65535] "km/h" Vector__XXX
 SG_ Wheel_Speed_FR_mph : 48|16@0+ (0.00621,-67.67) [0|40697.235] "mph" Vector__XXX

BO_ 956 MSG_3BC: 8 Vector__XXX
 SG_ Gear : 28|4@0+ (1,0) [0|15] "" Vector__XXX
