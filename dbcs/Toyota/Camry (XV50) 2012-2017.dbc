VERSION ""

NS_ :

BS_: 500

BU_: Vector__XXX

BO_ 37 MSG_025: 8 Vector__XXX
 SG_ Steering_Angle : 48|12@0- (-1.5,0) [0|65535] "��" Vector__XXX

BO_ 170 MSG_0AA: 8 Vector__XXX
 SG_ Wheel_Speed_4_kph : 0|16@0+ (0.01,-67.67) [0|500] "km/h" Vector__XXX
 SG_ Wheel_Speed_4_mph : 0|16@0+ (0.00621,-67.67) [0|310.5] "mph" Vector__XXX
 SG_ Wheel_Speed_3_kph : 16|16@0+ (0.01,-67.67) [0|500] "km/h" Vector__XXX
 SG_ Wheel_Speed_3_mph : 16|16@0+ (0.00621,-67.67) [0|310.5] "mph" Vector__XXX
 SG_ Wheel_Speed_2_kph : 32|16@0+ (0.01,-67.67) [0|500] "km/h" Vector__XXX
 SG_ Wheel_Speed_2_mph : 32|16@0+ (0.00621,-67.67) [0|310.5] "mph" Vector__XXX
 SG_ Wheel_Speed_1_kph : 48|16@0+ (0.01,-67.67) [0|500] "km/h" Vector__XXX
 SG_ Wheel_Speed_1_mph : 48|16@0+ (0.00621,-67.67) [0|310.5] "mph" Vector__XXX

BO_ 180 MSG_0B4: 8 Vector__XXX
 SG_ Indicated_Vehicle_Speed_kph : 8|16@0+ (0.01,0) [0|655] "km/h" Vector__XXX
 SG_ Indicated_Vehicle_Speed_mph : 8|16@0+ (0.00621,0) [0|406.755] "mph" Vector__XXX

BO_ 452 MSG_1C4: 8 Vector__XXX
 SG_ Engine_Speed : 48|16@0+ (0.8,0) [0|10000] "rpm" Vector__XXX

BO_ 464 MSG_1D0: 8 Vector__XXX
 SG_ Gear : 24|8@0+ (1,1) [0|255] "" Vector__XXX

BO_ 705 MSG_2C1: 8 Vector__XXX
 SG_ Throttle_Position : 8|8@0+ (0.5,0) [0|100] "%" Vector__XXX
 SG_ Brake_Pressure : 16|16@0+ (1,0) [0|65535] "Nm" Vector__XXX
