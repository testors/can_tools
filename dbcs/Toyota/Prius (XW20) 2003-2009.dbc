VERSION ""

NS_ :

BS_: 500

BU_: Vector__XXX

BO_ 37 MSG_025: 8 Vector__XXX
 SG_ Steering_Angle : 48|14@0- (-1.5,6024) [-16383|0] "��" Vector__XXX

BO_ 48 MSG_030: 8 Vector__XXX
 SG_ Brake_Position : 24|8@0+ (0.7874,0) [0|100] "%" Vector__XXX

BO_ 177 MSG_0B1: 8 Vector__XXX
 SG_ Wheel_Speed_FL_kph : 32|16@0+ (0.01,0) [0|500] "km/h" Vector__XXX
 SG_ Wheel_Speed_FL_mph : 32|16@0+ (0.00621,0) [0|310.5] "mph" Vector__XXX
 SG_ Wheel_Speed_FR_kph : 48|16@0+ (0.01,0) [0|500] "km/h" Vector__XXX
 SG_ Wheel_Speed_FR_mph : 48|16@0+ (0.00621,0) [0|310.5] "mph" Vector__XXX

BO_ 179 MSG_0B3: 8 Vector__XXX
 SG_ Wheel_Speed_RL_kph : 32|16@0+ (0.01,0) [0|500] "km/h" Vector__XXX
 SG_ Wheel_Speed_RL_mph : 32|16@0+ (0.00621,0) [0|310.5] "mph" Vector__XXX
 SG_ Wheel_Speed_RR_kph : 48|16@0+ (0.01,0) [0|500] "km/h" Vector__XXX
 SG_ Wheel_Speed_RR_mph : 48|16@0+ (0.00621,0) [0|310.5] "mph" Vector__XXX

BO_ 580 MSG_244: 8 Vector__XXX
 SG_ Accelerator_Pedal_Position : 8|8@0+ (0.5,0) [0|100] "%" Vector__XXX
