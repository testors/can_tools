VERSION ""

NS_ :

BS_: 500

BU_: Vector__XXX

BO_ 36 MSG_024: 8 Vector__XXX
 SG_ Indicated_Longitudinal_Acceleration : 16|10@0+ (0.03589,-18.375) [-18.375|18.34047] "m/s��" Vector__XXX
 SG_ Indicated_Lateral_Acceleration : 32|10@0+ (0.03589,-18.375) [-18.375|18.34047] "m/s��" Vector__XXX
 SG_ Yaw_Rate : 48|10@0+ (0.244,-125) [-125|124.612] "��/s" Vector__XXX

BO_ 37 MSG_025: 8 Vector__XXX
 SG_ Steering_Rate : 16|12@0- (1,0) [-2047|2047] "��/s" Vector__XXX
 SG_ Steering_Angle : 48|12@0- (1.5,0) [-3070.5|3070.5] "��" Vector__XXX

BO_ 170 MSG_0AA: 8 Vector__XXX
 SG_ Wheel_Speed_RL_kph : 0|16@0+ (0.01,-67.67) [0|65535] "km/h" Vector__XXX
 SG_ Wheel_Speed_RL_mph : 0|16@0+ (0.00621,-67.67) [0|40697.235] "mph" Vector__XXX
 SG_ Wheel_Speed_RR_kph : 16|16@0+ (0.01,-67.67) [0|65535] "km/h" Vector__XXX
 SG_ Wheel_Speed_RR_mph : 16|16@0+ (0.00621,-67.67) [0|40697.235] "mph" Vector__XXX
 SG_ Wheel_Speed_FL_kph : 32|16@0+ (0.01,-67.67) [0|65535] "km/h" Vector__XXX
 SG_ Wheel_Speed_FL_mph : 32|16@0+ (0.00621,-67.67) [0|40697.235] "mph" Vector__XXX
 SG_ Wheel_Speed_FR_kph : 48|16@0+ (0.01,-67.67) [0|65535] "km/h" Vector__XXX
 SG_ Wheel_Speed_FR_mph : 48|16@0+ (0.00621,-67.67) [0|40697.235] "mph" Vector__XXX

BO_ 452 MSG_1C4: 8 Vector__XXX
 SG_ Engine_Speed : 48|16@0+ (0.8,0) [0|8000] "rpm" Vector__XXX

BO_ 464 MSG_1D0: 8 Vector__XXX
 SG_ Gear : 24|4@0+ (1,1) [0|8] "" Vector__XXX
 SG_ Gear_Switch : 40|4@0+ (1,0) [0|15] "" Vector__XXX

BO_ 550 MSG_226: 8 Vector__XXX
 SG_ Brake_Pressure : 48|10@0+ (0.2,0) [0|204.6] "bar" Vector__XXX

BO_ 581 MSG_245: 5 Vector__XXX
 SG_ Accelerator_Pedal_Position : 40|8@0+ (0.5,0) [0|0] "%" Vector__XXX

BO_ 705 MSG_2C1: 8 Vector__XXX
 SG_ Accelerator_Pedal_Position : 8|8@0+ (0.5,0) [0|127.5] "%" Vector__XXX

BO_ 728 MSG_2D8: 8 Vector__XXX
 SG_ Full_Beam : 44|2@0+ (1,0) [0|3] "on/off" Vector__XXX

BO_ 1553 MSG_611: 8 Vector__XXX
 SG_ Odometer_Reading : 0|20@0+ (1,0) [0|1048575] "mi" Vector__XXX
