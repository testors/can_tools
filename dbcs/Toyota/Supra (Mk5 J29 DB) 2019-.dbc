VERSION ""

NS_ :

BS_: 500

BU_: Vector__XXX

BO_ 165 MSG_0A5: 8 Vector__XXX
 SG_ Engine_Speed : 40|16@1+ (0.25,0) [0|10000] "rpm" Vector__XXX

BO_ 217 MSG_0D9: 8 Vector__XXX
 SG_ Throttle_Position : 16|12@1+ (0.025,0) [0|100] "%" Vector__XXX

BO_ 371 MSG_173: 8 Vector__XXX
 SG_ Brake_Light : 3|2@0+ (0.5,0) [0|1.5] "on/off" Vector__XXX
 SG_ Brake_Position : 56|6@1+ (1,0) [0|63] "" Vector__XXX

BO_ 409 MSG_199: 6 Vector__XXX
 SG_ Indicated_Longitudinal_Acceleration : 16|16@1+ (0.002,-65) [-65|65] "m/s��" Vector__XXX

BO_ 410 MSG_19A: 6 Vector__XXX
 SG_ Indicated_Lateral_Acceleration : 16|16@1+ (0.002,-65) [-65|65] "m/s��" Vector__XXX

BO_ 714 MSG_2CA: 2 Vector__XXX
 SG_ Air_Temperature : 8|8@1+ (0.5,-40) [-40|85] "��C" Vector__XXX

BO_ 1019 MSG_3FB: 8 Vector__XXX
 SG_ Air_Pressure : 0|8@1+ (2,598) [600|1106] "mbar" Vector__XXX
