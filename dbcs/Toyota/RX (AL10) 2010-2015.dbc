VERSION ""

NS_ :

BS_: 500

BU_: Vector__XXX

BO_ 37 MSG_025: 8 Vector__XXX
 SG_ Steering_Angle : 48|12@0- (-1.5,0) [-720|720] "��" Vector__XXX

BO_ 449 MSG_1C1: 8 Vector__XXX
 SG_ Accelerator_Pedal_Position : 8|8@0+ (0.5,0) [0|100] "%" Vector__XXX

BO_ 452 MSG_1C4: 8 Vector__XXX
 SG_ Engine_Speed : 48|16@0+ (0.8,0) [0|8000] "rpm" Vector__XXX

BO_ 464 MSG_1D0: 8 Vector__XXX
 SG_ Gear : 24|4@0+ (1,0) [0|8] "" Vector__XXX

BO_ 548 MSG_224: 8 Vector__XXX
 SG_ Brake_Position : 16|16@0+ (0.1,0) [0|100] "%" Vector__XXX

BO_ 1553 MSG_611: 8 Vector__XXX
 SG_ Odometer_Reading : 0|20@0+ (1,0) [0|1000000] "mi" Vector__XXX
