VERSION ""

NS_ :

BS_: 500

BU_: Vector__XXX

BO_ 513 MSG_201: 8 Vector__XXX
 SG_ Accelerator_Pedal_Position : 0|16@0+ (0.001953,0) [0|0] "%" Vector__XXX
 SG_ Indicated_Vehicle_Speed_kph : 16|16@0+ (0.01,-100) [-100|555.35] "km/h" Vector__XXX
 SG_ Indicated_Vehicle_Speed_mph : 16|16@0+ (0.00621,-100) [-62.1|344.87235] "mph" Vector__XXX
 SG_ Engine_Speed : 48|16@0+ (0.25,0) [0|10000] "rpm" Vector__XXX

BO_ 560 MSG_230: 8 Vector__XXX
 SG_ Gear : 60|3@0+ (1,0) [0|7] "" Vector__XXX
