VERSION ""

NS_ :

BS_: 500

BU_: Vector__XXX

BO_ 129 MSG_081: 4 Vector__XXX
 SG_ Steering_Angle : 32|16@0- (1,0) [-720|720] "��" Vector__XXX

BO_ 513 MSG_201: 8 Vector__XXX
 SG_ Accelerator_Pedal_Position : 8|8@0+ (0.5,0) [0|100] "%" Vector__XXX
 SG_ Indicated_Vehicle_Speed_kph : 16|16@0+ (0.01,-100) [-100|555.33] "km/h" Vector__XXX
 SG_ Indicated_Vehicle_Speed_mph : 16|16@0+ (0.00621,-100) [-62.1|344.85993] "mph" Vector__XXX
 SG_ Engine_Speed : 48|16@0+ (0.25,0) [0|9000] "rpm" Vector__XXX

BO_ 561 MSG_231: 5 Vector__XXX
 SG_ Gear : 28|4@0+ (1,0) [0|0] "" Vector__XXX

BO_ 1056 MSG_420: 7 Vector__XXX
 SG_ Coolant_Temperature : 56|8@0+ (1,-40) [-40|213] "��C" Vector__XXX

BO_ 1200 MSG_4B0: 8 Vector__XXX
 SG_ Wheel_Speed_RR_kph : 0|16@0+ (0.01,-100) [0|300] "km/h" Vector__XXX
 SG_ Wheel_Speed_RR_mph : 0|16@0+ (0.00621,-100) [0|186.3] "mph" Vector__XXX
 SG_ Wheel_Speed_RL_kph : 16|16@0+ (0.01,-100) [0|300] "km/h" Vector__XXX
 SG_ Wheel_Speed_RL_mph : 16|16@0+ (0.00621,-100) [0|186.3] "mph" Vector__XXX
 SG_ Wheel_Speed_FR_kph : 32|16@0+ (0.01,-100) [0|300] "km/h" Vector__XXX
 SG_ Wheel_Speed_FR_mph : 32|16@0+ (0.00621,-100) [0|186.3] "mph" Vector__XXX
 SG_ Wheel_Speed_FL_kph : 48|16@0+ (0.01,-100) [0|300] "km/h" Vector__XXX
 SG_ Wheel_Speed_FL_mph : 48|16@0+ (0.00621,-100) [0|186.3] "mph" Vector__XXX
