VERSION ""

NS_ :

BS_: 500

BU_: Vector__XXX

BO_ 128 MSG_080: 8 Vector__XXX
 SG_ Steering_Angle : 48|16@0+ (-0.1,1000) [0|65535] "��" Vector__XXX

BO_ 513 MSG_201: 8 Vector__XXX
 SG_ Accelerator_Pedal_Position : 8|8@0+ (0.5,0) [0|100] "%" Vector__XXX
 SG_ Indicated_Vehicle_Speed_kph : 16|15@0+ (0.01,0) [0|327] "km/h" Vector__XXX
 SG_ Indicated_Vehicle_Speed_mph : 16|15@0+ (0.00621,0) [0|203.067] "mph" Vector__XXX
 SG_ Engine_Speed : 48|16@0+ (1,0) [0|9000] "rpm" Vector__XXX

BO_ 517 MSG_205: 8 Vector__XXX
 SG_ Brake_Position : 22|1@1+ (1,0) [0|1] "on/off" Vector__XXX

BO_ 527 MSG_20F: 8 Vector__XXX
 SG_ Brake_Pressure : 48|16@0+ (0.01,-300) [-300|300] "bar" Vector__XXX

BO_ 552 MSG_228: 8 Vector__XXX
 SG_ Gear_Requested : 60|4@0+ (1,0) [0|15] "" Vector__XXX

BO_ 1056 MSG_420: 8 Vector__XXX
 SG_ Coolant_Temperature : 56|8@0+ (1,-40) [-40|213] "��C" Vector__XXX

BO_ 1075 MSG_433: 8 Vector__XXX
 SG_ Handbrake : 32|1@0+ (1,0) [0|0] "" Vector__XXX

BO_ 1200 MSG_4B0: 8 Vector__XXX
 SG_ Wheel_Speed_RR_kph : 0|16@0+ (0.01,-100) [0|300] "km/h" Vector__XXX
 SG_ Wheel_Speed_RR_mph : 0|16@0+ (0.00621,-100) [0|186.3] "mph" Vector__XXX
 SG_ Wheel_Speed_RL_kph : 16|16@0+ (0.01,-100) [0|300] "km/h" Vector__XXX
 SG_ Wheel_Speed_RL_mph : 16|16@0+ (0.00621,-100) [0|186.3] "mph" Vector__XXX
 SG_ Wheel_Speed_FR_kph : 32|16@0+ (0.01,-100) [0|300] "km/h" Vector__XXX
 SG_ Wheel_Speed_FR_mph : 32|16@0+ (0.00621,-100) [0|186.3] "mph" Vector__XXX
 SG_ Wheel_Speed_FL_kph : 48|16@0+ (0.01,-100) [0|300] "km/h" Vector__XXX
 SG_ Wheel_Speed_FL_mph : 48|16@0+ (0.00621,-100) [0|186.3] "mph" Vector__XXX
