VERSION ""

NS_ :

BS_: 500

BU_: Vector__XXX

BO_ 130 MSG_082: 8 Vector__XXX
 SG_ Steering_Angle : 32|16@0- (0.1,0) [-720|720] "��" Vector__XXX

BO_ 513 MSG_201: 8 Vector__XXX
 SG_ Accelerator_Pedal_Position : 8|8@0+ (0.5,0) [0|100] "%" Vector__XXX
 SG_ Engine_Speed : 48|16@0+ (1,0) [0|10000] "rpm" Vector__XXX

BO_ 517 MSG_205: 8 Vector__XXX
 SG_ Brake_Light : 46|1@0+ (1,0) [0|0] "on/off" Vector__XXX

BO_ 527 MSG_20F: 8 Vector__XXX
 SG_ Brake_Position : 48|16@0+ (0.00625,-187) [0|100] "%" Vector__XXX
