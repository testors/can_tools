VERSION ""

NS_ :

BS_: 500

BU_: Vector__XXX

BO_ 512 MSG_200: 8 Vector__XXX
 SG_ Wheel_Speed_FR_kph : 16|14@0+ (0.0625,0) [0|500] "km/h" Vector__XXX
 SG_ Wheel_Speed_FR_mph : 16|14@0+ (0.0388125,0) [0|310.5] "mph" Vector__XXX
 SG_ Wheel_Speed_FL_kph : 32|14@0+ (0.0625,0) [0|500] "km/h" Vector__XXX
 SG_ Wheel_Speed_FL_mph : 32|14@0+ (0.0388125,0) [0|310.5] "mph" Vector__XXX

BO_ 520 MSG_208: 8 Vector__XXX
 SG_ Wheel_Speed_RL_kph : 0|14@0+ (0.0625,0) [0|500] "km/h" Vector__XXX
 SG_ Wheel_Speed_RL_mph : 0|14@0+ (0.0388125,0) [0|310.5] "mph" Vector__XXX
 SG_ ABS_Intervention : 6|1@1+ (1,0) [0|1] "" Vector__XXX
 SG_ Wheel_Speed_RR_kph : 16|14@0+ (0.0625,0) [0|500] "km/h" Vector__XXX
 SG_ Wheel_Speed_RR_mph : 16|14@0+ (0.0388125,0) [0|310.5] "mph" Vector__XXX

BO_ 533 MSG_215: 7 Vector__XXX
 SG_ Indicated_Vehicle_Speed_kph : 48|16@0+ (0.0078125,0) [0|511] "km/h" Vector__XXX
 SG_ Indicated_Vehicle_Speed_mph : 48|16@0+ (0.0048515625,0) [0|317.331] "mph" Vector__XXX

BO_ 566 MSG_236: 8 Vector__XXX
 SG_ Steering_Angle : 50|11@0+ (2,-2048) [-2048|2046] "��" Vector__XXX

BO_ 768 MSG_300: 8 Vector__XXX
 SG_ Yaw_Rate : 0|16@0+ (0.01,-327.68) [-327.68|327.68] "��/s" Vector__XXX

BO_ 776 MSG_308: 8 Vector__XXX
 SG_ Engine_Speed : 40|16@0+ (1,0) [0|65534] "rpm" Vector__XXX

BO_ 789 MSG_315: 6 Vector__XXX
 SG_ Brake_Light : 0|2@1+ (1,0) [0|3] "on/off" Vector__XXX
 SG_ Battery_Voltage : 40|8@1+ (0.1,0) [5|18] "V" Vector__XXX

BO_ 805 MSG_325: 7 Vector__XXX
 SG_ Odometer_Reading : 32|24@0+ (0.1,0) [0|1677721.4] "km" Vector__XXX

BO_ 808 MSG_328: 8 Vector__XXX
 SG_ Indicated_Lateral_Acceleration : 16|8@1+ (0.08,-10.24) [-10.24|10.08] "m/s��" Vector__XXX

BO_ 1023 MSG_3FF: 6 Vector__XXX
 SG_ Full_Beam : 51|1@0+ (1,0) [0|0] "on/off" Vector__XXX

BO_ 1184 MSG_4A0: 8 Vector__XXX
 SG_ Accelerator_Pedal_Position : 8|8@0+ (0.5102,0) [0|100] "%" Vector__XXX

BO_ 1544 MSG_608: 8 Vector__XXX
 SG_ Coolant_Temperature : 0|8@1+ (1,-40) [-40|214] "��C" Vector__XXX
 SG_ Intake_Air_Temperature : 8|8@1+ (1,-40) [-40|214] "��C" Vector__XXX
