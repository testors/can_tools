VERSION ""

NS_ :

BS_: 500

BU_: Vector__XXX

BO_ 520 MSG_208: 8 Vector__XXX
 SG_ Brake_Position : 32|12@0+ (0.0244,0) [0|100] "%" Vector__XXX

BO_ 528 MSG_210: 8 Vector__XXX
 SG_ Accelerator_Pedal_Position : 40|8@0+ (0.4,0) [0|100] "%" Vector__XXX

BO_ 776 MSG_308: 8 Vector__XXX
 SG_ Engine_Speed : 41|15@0+ (2,0) [0|10000] "rpm" Vector__XXX
