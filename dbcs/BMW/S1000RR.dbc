VERSION ""

NS_ :

BS_: 500

BU_: Vector__XXX

BO_ 268 MSG_10C: 8 Vector__XXX
 SG_ Throttle_Position : 8|8@0- (0.394,0) [0|100] "%" Vector__XXX
 SG_ Clutch_Position : 34|1@1+ (1,0) [0|0] "" Vector__XXX

BO_ 304 MSG_130: 8 Vector__XXX
 SG_ Brake_Position : 56|1@1+ (1,0) [0|1] "on/off" Vector__XXX

BO_ 390 MSG_186: 8 Vector__XXX
 SG_ Engine_Speed : 8|16@1- (0.5,0) [0|10000] "rpm" Vector__XXX

BO_ 672 MSG_2A0: 8 Vector__XXX
 SG_ Lean_Angle : 40|8@0- (-0.983,127.5) [0|50] "��" Vector__XXX

BO_ 676 MSG_2A4: 8 Vector__XXX
 SG_ Indicated_Vehicle_Speed_kph : 48|12@1- (0.1366,0) [0|559] "km/h" Vector__XXX
 SG_ Indicated_Vehicle_Speed_mph : 48|12@1- (0.0848286,0) [0|347.139] "mph" Vector__XXX

BO_ 700 MSG_2BC: 8 Vector__XXX
 SG_ Gear : 37|3@1+ (1,0) [0|6] "" Vector__XXX
