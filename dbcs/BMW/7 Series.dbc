VERSION ""

NS_ :

BS_: 500

BU_: Vector__XXX

BO_ 170 MSG_0AA: 8 Vector__XXX
 SG_ Engine_Speed : 32|16@1+ (0.25,0) [0|10000] "rpm" Vector__XXX

BO_ 416 MSG_1A0: 8 Vector__XXX
 SG_ Indicated_Vehicle_Speed : 0|12@1+ (0.1,0) [0|320] "" Vector__XXX
