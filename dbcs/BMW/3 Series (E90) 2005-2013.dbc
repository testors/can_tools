VERSION ""

NS_ :

BS_: 500

BU_: Vector__XXX

BO_ 170 MSG_0AA: 8 Vector__XXX
 SG_ Accelerator_Pedal_Position : 24|8@1+ (0.7874,0) [0|100] "%" Vector__XXX
 SG_ Engine_Speed : 32|16@1+ (0.25,0) [0|10000] "rpm" Vector__XXX

BO_ 196 MSG_0C4: 7 Vector__XXX
 SG_ Steering_Angle : 0|16@1- (0.0439453,0) [-32768|32767] "" Vector__XXX

BO_ 206 MSG_0CE: 8 Vector__XXX
 SG_ Wheel_Speed_FL_kph : 0|16@1- (0.0625,0) [0|400] "km/h" Vector__XXX
 SG_ Wheel_Speed_FL_mph : 0|16@1- (0.0388125,0) [0|248.4] "mph" Vector__XXX
 SG_ Wheel_Speed_FR_kph : 16|16@1- (0.0625,0) [0|400] "km/h" Vector__XXX
 SG_ Wheel_Speed_FR_mph : 16|16@1- (0.0388125,0) [0|248.4] "mph" Vector__XXX
 SG_ Wheel_Speed_RL_kph : 32|16@1- (0.0625,0) [0|400] "km/h" Vector__XXX
 SG_ Wheel_Speed_RL_mph : 32|16@1- (0.0388125,0) [0|248.4] "mph" Vector__XXX
 SG_ Wheel_Speed_RR_kph : 48|16@1- (0.0625,0) [0|400] "km/h" Vector__XXX
 SG_ Wheel_Speed_RR_mph : 48|16@1- (0.0388125,0) [0|248.4] "mph" Vector__XXX

BO_ 304 MSG_130: 5 Vector__XXX
 SG_ Clutch_Position : 46|1@0+ (1,0) [0|0] "" Vector__XXX

BO_ 414 MSG_19E: 8 Vector__XXX
 SG_ Brake_Position : 48|8@1+ (1,0) [0|100] "%" Vector__XXX

BO_ 464 MSG_1D0: 8 Vector__XXX
 SG_ Oil_Temperature : 48|8@0+ (1,-48) [-48|207] "" Vector__XXX
 SG_ Coolant_Temperature : 56|8@0+ (1,-48) [-48|207] "��C" Vector__XXX

BO_ 948 MSG_3B4: 8 Vector__XXX
 SG_ Battery_Voltage : 0|12@1+ (0.015,0) [0|61.5] "" Vector__XXX
