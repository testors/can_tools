VERSION ""

NS_ :

BS_: 500

BU_: Vector__XXX

BO_ 790 MSG_316: 4 Vector__XXX
 SG_ Engine_Speed : 16|16@1+ (0.150337,96.2342) [96.2342329129|9948.59196245] "rpm" Vector__XXX

BO_ 809 MSG_329: 7 Vector__XXX
 SG_ Brake_Position : 8|1@0+ (1,0) [0|1] "" Vector__XXX
 SG_ Throttle_Position : 8|16@0+ (0.0015378,0) [0|100.779664145] "%" Vector__XXX
