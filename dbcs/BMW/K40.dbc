VERSION ""

NS_ :

BS_: 500

BU_: Vector__XXX

BO_ 268 MSG_10C: 8 Vector__XXX
 SG_ Throttle_Position : 8|8@1+ (0.4,0) [0|100] "" Vector__XXX
 SG_ Engine_Speed : 16|16@1+ (0.25,0) [0|10000] "rpm" Vector__XXX

BO_ 680 MSG_2A8: 8 Vector__XXX
 SG_ Wheel_Speed_1_kph : 16|16@1+ (0.0625,0) [0|400] "km/h" Vector__XXX
 SG_ Wheel_Speed_1_mph : 16|16@1+ (0.0388125,0) [0|248.4] "mph" Vector__XXX
