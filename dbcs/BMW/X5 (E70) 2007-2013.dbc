VERSION ""

NS_ :

BS_: 500

BU_: Vector__XXX

BO_ 492 MSG_1EC: 3 Vector__XXX
 SG_ Steering_Angle : 0|20@1+ (1,0) [0|1048575] "��" Vector__XXX
