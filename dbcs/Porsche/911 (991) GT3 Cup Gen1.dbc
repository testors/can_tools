VERSION ""

NS_ :

BS_: 500

BU_: Vector__XXX

BO_ 201 MSG_0C9: 8 Vector__XXX
 SG_ Accelerator_Pedal_Position : 24|8@0+ (0.392157,0) [0|100.000035] "%" Vector__XXX
 SG_ Engine_Speed : 40|16@0+ (0.25,0) [0|10000] "rpm" Vector__XXX

BO_ 241 MSG_0F1: 6 Vector__XXX
 SG_ Brake_Position : 48|8@0+ (0.392157,0) [0|100.000035] "%" Vector__XXX

BO_ 259 MSG_103: 8 Vector__XXX
 SG_ Wheel_Speed_FL_kph : 16|12@1+ (0.1,0) [0|0] "km/h" Vector__XXX
 SG_ Wheel_Speed_FL_mph : 16|12@1+ (0.0621,0) [0|0] "mph" Vector__XXX
 SG_ Wheel_Speed_FR_kph : 28|12@1+ (0.1,0) [0|0] "km/h" Vector__XXX
 SG_ Wheel_Speed_FR_mph : 28|12@1+ (0.0621,0) [0|0] "mph" Vector__XXX
 SG_ Wheel_Speed_RL_kph : 40|12@1+ (0.1,0) [0|0] "km/h" Vector__XXX
 SG_ Wheel_Speed_RL_mph : 40|12@1+ (0.0621,0) [0|0] "mph" Vector__XXX
 SG_ Wheel_Speed_RR_kph : 52|12@1+ (0.1,0) [0|0] "km/h" Vector__XXX
 SG_ Wheel_Speed_RR_mph : 52|12@1+ (0.0621,0) [0|0] "mph" Vector__XXX

BO_ 485 MSG_1E5: 8 Vector__XXX
 SG_ Steering_Angle : 40|16@0- (-0.0625,0) [-2048|2047.9375] "��" Vector__XXX

BO_ 501 MSG_1F5: 8 Vector__XXX
 SG_ Gear : 56|4@0+ (1,0) [0|15] "" Vector__XXX
