VERSION ""

NS_ :

BS_: 500

BU_: Vector__XXX

BO_ 640 MSG_280: 8 Vector__XXX
 SG_ Engine_Speed : 16|16@1+ (0.25,0) [0|10000] "rpm" Vector__XXX
 SG_ Accelerator_Pedal_Position : 40|8@1+ (0.39,0) [-127|127] "" Vector__XXX

BO_ 680 MSG_2A8: 8 Vector__XXX
 SG_ Wheel_Speed_1_kph : 0|16@1+ (0.0056,0) [-32767|32767] "km/h" Vector__XXX
 SG_ Wheel_Speed_1_mph : 0|16@1+ (0.0034776,0) [-20348.307|20348.307] "mph" Vector__XXX
 SG_ Wheel_Speed_2_kph : 16|16@1+ (0.0056,0) [-32767|32767] "km/h" Vector__XXX
 SG_ Wheel_Speed_2_mph : 16|16@1+ (0.0034776,0) [-20348.307|20348.307] "mph" Vector__XXX
 SG_ Wheel_Speed_3_kph : 32|16@1+ (0.0056,0) [-32767|32767] "km/h" Vector__XXX
 SG_ Wheel_Speed_3_mph : 32|16@1+ (0.0034776,0) [-20348.307|20348.307] "mph" Vector__XXX
 SG_ Wheel_Speed_4_kph : 48|16@1+ (0.0056,0) [-32767|32767] "km/h" Vector__XXX
 SG_ Wheel_Speed_4_mph : 48|16@1+ (0.0034776,0) [-20348.307|20348.307] "mph" Vector__XXX

BO_ 1248 MSG_4E0: 8 Vector__XXX
 SG_ Boost_Pressure : 32|8@1+ (1,0) [0|255] "kPa" Vector__XXX
