VERSION ""

NS_ :

BS_: 500

BU_: Vector__XXX

BO_ 2021 MSG_7E5: 8 Vector__XXX
 SG_ Brake_Bias : 8|8@0- (0.1,0) [-12.7|12.7] "" Vector__XXX

BO_ 2024 MSG_7E8: 8 Vector__XXX
 SG_ Steering_Angle : 0|16@0- (0.018711,-0.0935551) [-613.197505198|613.01039501] "��" Vector__XXX

BO_ 2026 MSG_7EA: 8 Vector__XXX
 SG_ Gear : 8|4@0- (1,0) [-7|7] "" Vector__XXX

BO_ 2027 MSG_7EB: 8 Vector__XXX
 SG_ Engine_Speed : 32|14@0+ (1,0) [0|10000] "rpm" Vector__XXX

BO_ 2029 MSG_7ED: 8 Vector__XXX
 SG_ Wheel_Speed_RR_kph : 0|16@0+ (0.0161,0) [0|1055.1135] "km/h" Vector__XXX
 SG_ Wheel_Speed_RR_mph : 0|16@0+ (0.01,0) [0|655.35] "mph" Vector__XXX
 SG_ Wheel_Speed_RL_kph : 16|16@0+ (0.0161,0) [0|1055.1135] "km/h" Vector__XXX
 SG_ Wheel_Speed_RL_mph : 16|16@0+ (0.01,0) [0|655.35] "mph" Vector__XXX
 SG_ Wheel_Speed_FR_kph : 32|16@0+ (0.0161,0) [0|1055.1135] "km/h" Vector__XXX
 SG_ Wheel_Speed_FR_mph : 32|16@0+ (0.01,0) [0|655.35] "mph" Vector__XXX
 SG_ Wheel_Speed_FL_kph : 48|16@0+ (0.0161,0) [0|1055.1135] "km/h" Vector__XXX
 SG_ Wheel_Speed_FL_mph : 48|16@0+ (0.01,0) [0|655.35] "mph" Vector__XXX

BO_ 2043 MSG_7FB: 8 Vector__XXX
 SG_ Throttle_Position : 24|8@1+ (0.5,0) [-3|100] "%" Vector__XXX

BO_ 2046 MSG_7FE: 8 Vector__XXX
 SG_ Brake_Pressure___Rear : 40|8@0+ (0.5,0) [0|255] "bar" Vector__XXX
 SG_ Brake_Pressure____Front : 48|8@0+ (0.5,0) [0|255] "bar" Vector__XXX
