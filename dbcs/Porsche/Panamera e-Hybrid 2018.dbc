VERSION ""

NS_ :

BS_: 500

BU_: Vector__XXX

BO_ 160 MSG_0A0: 8 Vector__XXX
 SG_ Steering_Angle : 32|13@1+ (-0.12,0) [-720|720] "��" Vector__XXX

BO_ 173 MSG_0AD: 8 Vector__XXX
 SG_ Gear : 4|4@0+ (1,0) [0|15] "" Vector__XXX
 SG_ Gear_Switch : 18|4@0+ (1,0) [0|15] "" Vector__XXX

BO_ 189 MSG_0BD: 8 Vector__XXX
 SG_ Brake_Position : 33|11@1+ (0.0625,-20) [0|100] "%" Vector__XXX

BO_ 259 MSG_103: 8 Vector__XXX
 SG_ Wheel_Speed_RL_kph : 16|12@1+ (0.1,0) [0|400] "km/h" Vector__XXX
 SG_ Wheel_Speed_RL_mph : 16|12@1+ (0.0621,0) [0|248.4] "mph" Vector__XXX
 SG_ Wheel_Speed_FL_kph : 28|12@1+ (0.1,0) [0|500] "km/h" Vector__XXX
 SG_ Wheel_Speed_FL_mph : 28|12@1+ (0.0621,0) [0|310.5] "mph" Vector__XXX
 SG_ Wheel_Speed_RR_kph : 40|12@1+ (0.1,0) [0|400] "km/h" Vector__XXX
 SG_ Wheel_Speed_RR_mph : 40|12@1+ (0.0621,0) [0|248.4] "mph" Vector__XXX
 SG_ Wheel_Speed_FR_kph : 52|12@1+ (0.1,0) [0|400] "km/h" Vector__XXX
 SG_ Wheel_Speed_FR_mph : 52|12@1+ (0.0621,0) [0|248.4] "mph" Vector__XXX

BO_ 289 MSG_121: 8 Vector__XXX
 SG_ Accelerator_Pedal_Position : 12|8@1+ (0.4,0) [0|100] "%" Vector__XXX

BO_ 429 MSG_1AD: 8 Vector__XXX
 SG_ Suspension_Mode : 28|2@0+ (1,-1) [0|3] "" Vector__XXX

BO_ 968 MSG_3C8: 8 Vector__XXX
 SG_ Sport_Mode : 35|1@0+ (1,0) [0|1] "" Vector__XXX
