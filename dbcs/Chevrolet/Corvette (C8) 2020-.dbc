VERSION ""

NS_ :

BS_: 500

BU_: Vector__XXX

BO_ 35 MSG_023: 8 Vector__XXX
 SG_ Steering_Angle : 16|16@0- (-0.031,0) [-720|720] "��" Vector__XXX

BO_ 41 MSG_029: 8 Vector__XXX
 SG_ Brake_Position : 24|9@0+ (0.285714,0) [0|100] "%" Vector__XXX

BO_ 43 MSG_02B: 8 Vector__XXX
 SG_ Engine_Speed : 48|16@0+ (0.25,0) [0|65535] "rpm" Vector__XXX

BO_ 44 MSG_02C: 8 Vector__XXX
 SG_ Accelerator_Pedal_Position : 54|8@0+ (0.393701,0) [0|100] "%" Vector__XXX
