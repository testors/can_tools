VERSION ""

NS_ :

BS_: 500

BU_: Vector__XXX

BO_ 2147746656 MSG_80040360: 8 Vector__XXX
 SG_ Engine_Speed : 0|12@0+ (1,0) [0|10000] "rpm" Vector__XXX
 SG_ Throttle_Position : 24|12@0+ (0.03125,0) [-2047|2047] "" Vector__XXX

BO_ 2165571616 MSG_81140020: 8 Vector__XXX
 SG_ Wheel_Speed_4_kph : 32|15@0+ (0.01,0) [-16383|16383] "km/h" Vector__XXX
 SG_ Wheel_Speed_4_mph : 32|15@0+ (0.00621,0) [-10173.843|10173.843] "mph" Vector__XXX
 SG_ Wheel_Speed_3_kph : 48|15@0+ (0.01,0) [-16383|16383] "km/h" Vector__XXX
 SG_ Wheel_Speed_3_mph : 48|15@0+ (0.00621,0) [-10173.843|10173.843] "mph" Vector__XXX

BO_ 2506883440 MSG_956C0170: 8 Vector__XXX
 SG_ Wheel_Speed_2_kph : 32|15@0+ (0.01,0) [-16383|16383] "km/h" Vector__XXX
 SG_ Wheel_Speed_2_mph : 32|15@0+ (0.00621,0) [-10173.843|10173.843] "mph" Vector__XXX
 SG_ Wheel_Speed_1_kph : 48|15@0+ (0.01,0) [-16383|16383] "km/h" Vector__XXX
 SG_ Wheel_Speed_1_mph : 48|15@0+ (0.00621,0) [-10173.843|10173.843] "mph" Vector__XXX

BO_ 2524447296 MSG_96780240: 8 Vector__XXX
 SG_ Steering_Angle : 24|16@0+ (0.1,776.5) [-32767|32767] "��" Vector__XXX
