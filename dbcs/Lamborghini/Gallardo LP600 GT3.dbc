VERSION ""

NS_ :

BS_: 500

BU_: Vector__XXX

BO_ 768 MSG_300: 8 Vector__XXX
 SG_ Throttle_Position : 40|8@0+ (0.392156,0) [0|99.9] "%" Vector__XXX
 SG_ Engine_Speed : 48|16@0+ (1,0) [0|10000] "rpm" Vector__XXX

BO_ 774 MSG_306: 8 Vector__XXX
 SG_ Gear : 56|8@0+ (1,0) [0|255] "" Vector__XXX

BO_ 779 MSG_30B: 8 Vector__XXX
 SG_ Coolant_Temperature : 56|8@0+ (0.549019,10) [10|149.9] "��C" Vector__XXX
