VERSION ""

NS_ :

BS_: 500

BU_: Vector__XXX

BO_ 134 MSG_086: 8 Vector__XXX
 SG_ Steering_Angle : 8|10@0+ (-0.8,817.6) [-638.75|638.75] "��" Vector__XXX
 SG_ Steering_Direction : 18|1@0+ (-2,1) [-1|1] "" Vector__XXX

BO_ 258 MSG_102: 8 Vector__XXX
 SG_ Gear : 17|3@0+ (1,0) [0|7] "" Vector__XXX
 SG_ Gear_Requested : 20|4@0+ (1,0) [0|15] "" Vector__XXX

BO_ 259 MSG_103: 8 Vector__XXX
 SG_ Wheel_Speed_RL_kph : 16|12@1+ (0.1,0) [0|400] "km/h" Vector__XXX
 SG_ Wheel_Speed_RL_mph : 16|12@1+ (0.0621,0) [0|248.4] "mph" Vector__XXX
 SG_ Wheel_Speed_FL_kph : 28|12@1+ (0.1,0) [0|500] "km/h" Vector__XXX
 SG_ Wheel_Speed_FL_mph : 28|12@1+ (0.0621,0) [0|310.5] "mph" Vector__XXX
 SG_ Wheel_Speed_RR_kph : 40|12@1+ (0.1,0) [0|400] "km/h" Vector__XXX
 SG_ Wheel_Speed_RR_mph : 40|12@1+ (0.0621,0) [0|248.4] "mph" Vector__XXX
 SG_ Wheel_Speed_FR_kph : 52|12@1+ (0.1,0) [0|400] "km/h" Vector__XXX
 SG_ Wheel_Speed_FR_mph : 52|12@1+ (0.0621,0) [0|248.4] "mph" Vector__XXX

BO_ 261 MSG_105: 8 Vector__XXX
 SG_ Accelerator_Pedal_Position : 8|8@0+ (0.4,0) [0|100] "%" Vector__XXX
 SG_ Engine_Speed : 16|16@1+ (0.25,0) [0|10000] "rpm" Vector__XXX
 SG_ Brake_Position : 26|2@0+ (1,0) [0|3] "%" Vector__XXX
