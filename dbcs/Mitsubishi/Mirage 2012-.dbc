VERSION ""

NS_ :

BS_: 500

BU_: Vector__XXX

BO_ 520 MSG_208: 8 Vector__XXX
 SG_ Brake_Position : 32|12@0+ (0.1,0) [0|100] "%" Vector__XXX

BO_ 528 MSG_210: 8 Vector__XXX
 SG_ Accelerator_Pedal_Position : 56|8@0+ (0.4032,0) [0|100] "%" Vector__XXX

BO_ 566 MSG_236: 8 Vector__XXX
 SG_ Steering_Angle : 48|12@0- (-0.5,0) [-720|720] "��" Vector__XXX

BO_ 776 MSG_308: 8 Vector__XXX
 SG_ Engine_Speed : 40|16@0+ (1,0) [0|65535] "rpm" Vector__XXX

BO_ 789 MSG_315: 8 Vector__XXX
 SG_ Side_Lights : 27|1@0+ (1,0) [0|1] "on/off" Vector__XXX
 SG_ Headlights : 28|1@0+ (1,0) [0|1] "on/off" Vector__XXX

BO_ 839 MSG_347: 8 Vector__XXX
 SG_ Handbrake : 59|1@0+ (1,0) [0|1] "on/off" Vector__XXX

BO_ 869 MSG_365: 8 Vector__XXX
 SG_ Gear_Switch : 20|4@0+ (1,0) [0|15] "" Vector__XXX

BO_ 1060 MSG_424: 8 Vector__XXX
 SG_ Full_Beam : 10|1@0+ (1,0) [0|1] "on/off" Vector__XXX
