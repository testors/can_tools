VERSION ""

NS_ :

BS_: 500

BU_: Vector__XXX

BO_ 528 MSG_210: 8 Vector__XXX
 SG_ Throttle_Position : 40|8@0+ (0.4,0) [0|0] "" Vector__XXX

BO_ 533 MSG_215: 8 Vector__XXX
 SG_ Indicated_Vehicle_Speed : 48|16@0+ (0.00484,0) [0|0] "" Vector__XXX

BO_ 566 MSG_236: 8 Vector__XXX
 SG_ Steering_Rate : 32|16@0+ (0.5,-2048) [0|0] "��/s" Vector__XXX
 SG_ Steering_Angle : 48|16@0+ (0.5,-2048) [0|0] "��" Vector__XXX

BO_ 776 MSG_308: 8 Vector__XXX
 SG_ Engine_Speed : 40|14@0+ (1,0) [0|10000] "rpm" Vector__XXX

BO_ 1184 MSG_4A0: 8 Vector__XXX
 SG_ Boost_Pressure : 24|8@0+ (0.008,-1) [-1|1.04] "" Vector__XXX
