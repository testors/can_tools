VERSION ""

NS_ :

BS_: 500

BU_: Vector__XXX

BO_ 272 MSG_110: 8 Vector__XXX
 SG_ Accelerator_Pedal_Position : 8|8@0+ (0.39216,0) [0|100] "%" Vector__XXX
 SG_ Engine_Speed : 40|16@0+ (0.25,0) [0|10000] "rpm" Vector__XXX

BO_ 320 MSG_140: 8 Vector__XXX
 SG_ Brake_Position : 0|8@0+ (0.39216,0) [0|100] "%" Vector__XXX

BO_ 384 MSG_180: 8 Vector__XXX
 SG_ Steering_Angle : 32|16@0- (-0.0625,0) [-600|600] "��" Vector__XXX

BO_ 392 MSG_188: 8 Vector__XXX
 SG_ Yaw_Rate : 44|12@0- (-0.0625,0) [-2047|2047] "��/s" Vector__XXX

BO_ 648 MSG_288: 8 Vector__XXX
 SG_ Wheel_Speed_RR_kph : 0|16@0+ (0.01475,0) [0|500] "km/h" Vector__XXX
 SG_ Wheel_Speed_RR_mph : 0|16@0+ (0.00915975,0) [0|310.5] "mph" Vector__XXX
 SG_ Wheel_Speed_RL_kph : 16|16@0+ (0.01475,0) [0|500] "km/h" Vector__XXX
 SG_ Wheel_Speed_RL_mph : 16|16@0+ (0.00915975,0) [0|310.5] "mph" Vector__XXX
 SG_ Wheel_Speed_FR_kph : 32|16@0+ (0.01475,0) [0|500] "km/h" Vector__XXX
 SG_ Wheel_Speed_FR_mph : 32|16@0+ (0.00915975,0) [0|310.5] "mph" Vector__XXX
 SG_ Wheel_Speed_FL_kph : 48|16@0+ (0.01475,0) [0|500] "km/h" Vector__XXX
 SG_ Wheel_Speed_FL_mph : 48|16@0+ (0.00915975,0) [0|310.5] "mph" Vector__XXX

BO_ 800 MSG_320: 8 Vector__XXX
 SG_ Gear_Requested : 40|8@0+ (1,0) [0|255] "" Vector__XXX
 SG_ Gear : 48|8@0+ (1,0) [0|255] "" Vector__XXX

BO_ 896 MSG_380: 8 Vector__XXX
 SG_ Handbrake : 22|1@0+ (1,0) [0|0] "" Vector__XXX
