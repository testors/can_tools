VERSION ""

NS_ :

BS_: 500

BU_: Vector__XXX

BO_ 133 MSG_085: 8 Vector__XXX
 SG_ Steering_Angle : 48|16@0+ (-0.1,3200) [0|65535] "��" Vector__XXX

BO_ 357 MSG_165: 8 Vector__XXX
 SG_ Brake_Position : 61|1@0+ (1,0) [0|0] "" Vector__XXX

BO_ 516 MSG_204: 8 Vector__XXX
 SG_ Engine_Speed : 24|16@0+ (2,0) [0|8000] "rpm" Vector__XXX
 SG_ Accelerator_Pedal_Position : 48|10@0+ (0.1,0) [0|1000] "%" Vector__XXX

BO_ 535 MSG_217: 8 Vector__XXX
 SG_ Wheel_Speed_FR_kph : 0|16@0+ (0.012,0) [0|65535] "km/h" Vector__XXX
 SG_ Wheel_Speed_FR_mph : 0|16@0+ (0.007452,0) [0|40697.235] "mph" Vector__XXX
 SG_ Wheel_Speed_FL_kph : 16|16@0+ (0.012,0) [0|65535] "km/h" Vector__XXX
 SG_ Wheel_Speed_FL_mph : 16|16@0+ (0.007452,0) [0|40697.235] "mph" Vector__XXX
 SG_ Wheel_Speed_RR_kph : 32|16@0+ (0.012,0) [0|65535] "km/h" Vector__XXX
 SG_ Wheel_Speed_RR_mph : 32|16@0+ (0.007452,0) [0|40697.235] "mph" Vector__XXX
 SG_ Wheel_Speed_RL_kph : 48|16@0+ (0.012,0) [0|65535] "km/h" Vector__XXX
 SG_ Wheel_Speed_RL_mph : 48|16@0+ (0.007452,0) [0|40697.235] "mph" Vector__XXX
