VERSION ""

NS_ :

BS_: 500

BU_: Vector__XXX

BO_ 640 MSG_280: 8 Vector__XXX
 SG_ Throttle_Position : 16|8@0+ (0.4,0) [0|102] "%" Vector__XXX

BO_ 648 MSG_288: 8 Vector__XXX
 SG_ Brake_Position : 40|2@0+ (1,0) [0|3] "on/off" Vector__XXX

BO_ 1162 MSG_48A: 8 Vector__XXX
 SG_ Engine_Speed : 48|16@1+ (10,0) [0|10000] "rpm" Vector__XXX
