VERSION ""

NS_ :

BS_: 500

BU_: Vector__XXX

BO_ 640 MSG_280: 8 Vector__XXX
 SG_ Engine_Speed : 16|16@1+ (1,0) [0|10000] "rpm" Vector__XXX
