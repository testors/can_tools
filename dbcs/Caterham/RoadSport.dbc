VERSION ""

NS_ :

BS_: 500

BU_: Vector__XXX

BO_ 800 MSG_320: 8 Vector__XXX
 SG_ Throttle_Position : 32|8@0+ (0.515464,-9.79381) [-9.79381443299|121.649484536] "%" Vector__XXX
 SG_ Engine_Speed : 40|12@0+ (1,0) [0|10000] "rpm" Vector__XXX
