VERSION ""

NS_ :

BS_: 500

BU_: Vector__XXX

BO_ 192 MSG_0C0: 8 Vector__XXX
 SG_ Steering_Angle : 0|16@0+ (-0.1,778) [-720|720] "��" Vector__XXX

BO_ 208 MSG_0D0: 8 Vector__XXX
 SG_ Engine_Speed : 16|13@0+ (1,0) [0|8191] "rpm" Vector__XXX

BO_ 272 MSG_110: 8 Vector__XXX
 SG_ Wheel_Speed_RR_kph : 8|16@0+ (0.01,0) [0|500] "km/h" Vector__XXX
 SG_ Wheel_Speed_RR_mph : 8|16@0+ (0.00621,0) [0|310.5] "mph" Vector__XXX
 SG_ Wheel_Speed_RL_kph : 24|16@0+ (0.01,0) [0|500] "km/h" Vector__XXX
 SG_ Wheel_Speed_RL_mph : 24|16@0+ (0.00621,0) [0|310.5] "mph" Vector__XXX

BO_ 304 MSG_130: 8 Vector__XXX
 SG_ Accelerator_Pedal_Position : 8|8@0+ (0.5,0) [0|100] "%" Vector__XXX

BO_ 336 MSG_150: 8 Vector__XXX
 SG_ Brake_Position : 8|10@0+ (0.1,0) [0|100] "%" Vector__XXX

BO_ 352 MSG_160: 8 Vector__XXX
 SG_ Gear_Requested : 0|4@0+ (1,0) [0|15] "" Vector__XXX
 SG_ Gear : 4|4@0+ (1,0) [0|15] "" Vector__XXX
