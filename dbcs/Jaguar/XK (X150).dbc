VERSION ""

NS_ :

BS_: 500

BU_: Vector__XXX

BO_ 523 MSG_20B: 8 Vector__XXX
 SG_ Indicated_Vehicle_Speed_kph : 0|16@0+ (0.01,0) [0|660] "km/h" Vector__XXX
 SG_ Indicated_Vehicle_Speed_mph : 0|16@0+ (0.00621,0) [0|409.86] "mph" Vector__XXX
 SG_ Brake_Pressure : 16|10@0+ (0.2,0) [0|204.6] "bar" Vector__XXX

BO_ 587 MSG_24B: 8 Vector__XXX
 SG_ Wheel_Speed_FL_kph : 0|15@0+ (0.01,0) [0|330] "km/h" Vector__XXX
 SG_ Wheel_Speed_FL_mph : 0|15@0+ (0.00621,0) [0|204.93] "mph" Vector__XXX
 SG_ Wheel_Speed_FR_kph : 16|15@0+ (0.01,0) [0|330] "km/h" Vector__XXX
 SG_ Wheel_Speed_FR_mph : 16|15@0+ (0.00621,0) [0|204.93] "mph" Vector__XXX
 SG_ Yaw_Rate : 32|10@0+ (0.2,-100) [-100.2|104.2] "��/s" Vector__XXX

BO_ 640 MSG_280: 8 Vector__XXX
 SG_ Steering_Angle : 0|16@0+ (0.1,-780) [-780.1|5773.4] "��" Vector__XXX

BO_ 660 MSG_294: 8 Vector__XXX
 SG_ Wheel_Speed_RL_kph : 0|15@0+ (0.01,0) [0|330] "km/h" Vector__XXX
 SG_ Wheel_Speed_RL_mph : 0|15@0+ (0.00621,0) [0|204.93] "mph" Vector__XXX
 SG_ Wheel_Speed_RR_kph : 16|15@0+ (0.01,0) [0|330] "km/h" Vector__XXX
 SG_ Wheel_Speed_RR_mph : 16|15@0+ (0.00621,0) [0|204.93] "mph" Vector__XXX
 SG_ Indicated_Lateral_Acceleration : 48|8@0+ (0.1,-11) [-11.1|14.4] "m/s��" Vector__XXX

BO_ 661 MSG_295: 8 Vector__XXX
 SG_ Engine_Speed : 0|13@0+ (1,0) [0|8200] "rpm" Vector__XXX

BO_ 693 MSG_2B5: 8 Vector__XXX
 SG_ Throttle_Position : 16|10@0+ (0.1,0) [0|102.3] "%" Vector__XXX

BO_ 789 MSG_315: 8 Vector__XXX
 SG_ Air_Temperature : 40|10@0+ (0.25,-128) [-128|127.75] "��C" Vector__XXX

BO_ 851 MSG_353: 8 Vector__XXX
 SG_ Gear : 32|4@0+ (1,0) [13|14] "" Vector__XXX

BO_ 853 MSG_355: 8 Vector__XXX
 SG_ Coolant_Temperature : 16|8@0+ (1,-60) [-60|195] "��C" Vector__XXX

BO_ 953 MSG_3B9: 8 Vector__XXX
 SG_ Indicated_Longitudinal_Acceleration : 24|8@0+ (0.1,-11) [-11|11] "m/s��" Vector__XXX

BO_ 979 MSG_3D3: 8 Vector__XXX
 SG_ Transmission_Oil_Temperature : 24|8@0+ (1,-40) [-40|214] "��C" Vector__XXX

BO_ 1237 MSG_4D5: 8 Vector__XXX
 SG_ Oil_Temperature : 8|8@0+ (1,-60) [-60|195] "��C" Vector__XXX
