VERSION ""

NS_ :

BS_: 500

BU_: Vector__XXX

BO_ 533 MSG_215: 7 Vector__XXX
 SG_ Indicated_Vehicle_Speed_kph : 48|16@0+ (0.0078125,0) [0|511] "km/h" Vector__XXX
 SG_ Indicated_Vehicle_Speed_mph : 48|16@0+ (0.0048515625,0) [0|317.331] "mph" Vector__XXX

BO_ 566 MSG_236: 8 Vector__XXX
 SG_ Steering_Angle : 48|14@0+ (0.5,-2048) [-2048|2047] "��" Vector__XXX

BO_ 768 MSG_300: 8 Vector__XXX
 SG_ Yaw_Rate : 0|16@0+ (0.01,-327.68) [-327.68|327.68] "��/s" Vector__XXX

BO_ 776 MSG_308: 8 Vector__XXX
 SG_ Engine_Speed : 40|16@0+ (1,0) [0|10000] "rpm" Vector__XXX

BO_ 789 MSG_315: 6 Vector__XXX
 SG_ Brake_Position : 0|2@1+ (1,0) [0|3] "" Vector__XXX
 SG_ Battery_Voltage : 40|8@1+ (0.1,0) [5|18] "" Vector__XXX

BO_ 808 MSG_328: 8 Vector__XXX
 SG_ Indicated_Lateral_Acceleration : 16|8@1+ (0.08,-10.24) [-10.24|10.08] "" Vector__XXX

BO_ 1032 MSG_408: 8 Vector__XXX
 SG_ Air_Temperature : 16|8@1+ (0.5,-40) [-40|85] "" Vector__XXX

BO_ 1184 MSG_4A0: 8 Vector__XXX
 SG_ Accelerator_Pedal_Position : 8|8@0+ (0.5102,0) [0|100] "%" Vector__XXX
