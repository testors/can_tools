VERSION ""

NS_ :

BS_: 500

BU_: Vector__XXX

BO_ 512 MSG_200: 8 Vector__XXX
 SG_ Wheel_Speed_FL_kph : 0|16@0+ (0.08,0) [0|400] "km/h" Vector__XXX
 SG_ Wheel_Speed_FL_mph : 0|16@0+ (0.04968,0) [0|248.4] "mph" Vector__XXX
 SG_ Wheel_Speed_FR_kph : 16|16@0+ (0.08,0) [0|400] "km/h" Vector__XXX
 SG_ Wheel_Speed_FR_mph : 16|16@0+ (0.04968,0) [0|248.4] "mph" Vector__XXX

BO_ 520 MSG_208: 8 Vector__XXX
 SG_ Wheel_Speed_RL_kph : 0|16@0+ (0.08,0) [0|400] "km/h" Vector__XXX
 SG_ Wheel_Speed_RL_mph : 0|16@0+ (0.04968,0) [0|248.4] "mph" Vector__XXX
 SG_ Wheel_Speed_RR_kph : 16|16@0+ (0.08,0) [0|400] "km/h" Vector__XXX
 SG_ Wheel_Speed_RR_mph : 16|16@0+ (0.04968,0) [0|248.4] "mph" Vector__XXX

BO_ 528 MSG_210: 8 Vector__XXX
 SG_ Accelerator_Pedal_Position : 40|8@0+ (0.4,0) [0|100] "%" Vector__XXX

BO_ 566 MSG_236: 8 Vector__XXX
 SG_ Steering_Angle : 48|16@0+ (-0.5,2048) [-720|720] "��" Vector__XXX

BO_ 776 MSG_308: 8 Vector__XXX
 SG_ Engine_Speed : 40|16@0+ (1,0) [0|10000] "rpm" Vector__XXX

BO_ 848 MSG_350: 8 Vector__XXX
 SG_ Brake_Position : 32|16@0+ (0.025,0) [0|100] "%" Vector__XXX
