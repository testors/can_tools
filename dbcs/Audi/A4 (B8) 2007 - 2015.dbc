VERSION ""

NS_ :

BS_: 500

BU_: Vector__XXX

BO_ 134 MSG_086: 8 Vector__XXX
 SG_ Steering_Angle : 16|14@1+ (-0.1,0) [-720|720] "��" Vector__XXX

BO_ 259 MSG_103: 8 Vector__XXX
 SG_ Wheel_Speed_1_kph : 16|12@1+ (0.0625,0) [0|4095] "km/h" Vector__XXX
 SG_ Wheel_Speed_1_mph : 16|12@1+ (0.0388125,0) [0|2542.995] "mph" Vector__XXX
 SG_ Wheel_Speed_2_kph : 28|12@1+ (0.0625,0) [0|4095] "km/h" Vector__XXX
 SG_ Wheel_Speed_2_mph : 28|12@1+ (0.0388125,0) [0|2542.995] "mph" Vector__XXX
 SG_ Wheel_Speed_3_kph : 40|12@1+ (0.0625,0) [0|4095] "km/h" Vector__XXX
 SG_ Wheel_Speed_3_mph : 40|12@1+ (0.0388125,0) [0|2542.995] "mph" Vector__XXX
 SG_ Wheel_Speed_4_kph : 52|12@1+ (0.0625,0) [0|4095] "km/h" Vector__XXX
 SG_ Wheel_Speed_4_mph : 52|12@1+ (0.0388125,0) [0|2542.995] "mph" Vector__XXX

BO_ 261 MSG_105: 8 Vector__XXX
 SG_ Throttle_Position : 8|8@0+ (0.4,0) [0|100] "%" Vector__XXX
 SG_ Engine_Speed : 16|16@1+ (0.25,0) [0|10000] "rpm" Vector__XXX
 SG_ Clutch_Position : 25|1@0+ (1,0) [0|1] "on/off" Vector__XXX

BO_ 262 MSG_106: 8 Vector__XXX
 SG_ Brake_Position : 32|3@0+ (1,0) [-0.7|0] "" Vector__XXX
