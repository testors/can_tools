VERSION ""

NS_ :

BS_: 500

BU_: Vector__XXX

BO_ 134 MSG_086: 8 Vector__XXX
 SG_ Steering_Angle : 16|14@1+ (-0.1,0) [-720|720] "��" Vector__XXX

BO_ 261 MSG_105: 8 Vector__XXX
 SG_ Throttle_Position : 8|8@0+ (0.4,0) [0|100] "%" Vector__XXX
 SG_ Engine_Speed : 16|16@1+ (0.25,0) [0|10000] "rpm" Vector__XXX

BO_ 262 MSG_106: 8 Vector__XXX
 SG_ Brake_Light : 5|1@0+ (1,0) [0|0] "on/off" Vector__XXX

BO_ 782 MSG_30E: 8 Vector__XXX
 SG_ Gear : 56|8@0+ (1,0) [0|255] "" Vector__XXX
