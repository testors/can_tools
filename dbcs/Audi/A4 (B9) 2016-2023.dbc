VERSION ""

NS_ :

BS_: 500

BU_: Vector__XXX

BO_ 160 MSG_0A0: 8 Vector__XXX
 SG_ Steering_Angle : 32|13@1+ (-0.152,0) [-622.44|622.592] "��" Vector__XXX

BO_ 168 MSG_0A8: 8 Vector__XXX
 SG_ Engine_Speed : 50|14@1+ (1,0) [0|8000] "rpm" Vector__XXX

BO_ 173 MSG_0AD: 8 Vector__XXX
 SG_ Gear : 4|4@0+ (1,0) [0|15] "" Vector__XXX
 SG_ Gear_Switch : 18|4@0+ (1,0) [0|15] "" Vector__XXX

BO_ 259 MSG_103: 8 Vector__XXX
 SG_ Wheel_Speed_RL_kph : 16|12@1+ (0.1,0) [0|400] "km/h" Vector__XXX
 SG_ Wheel_Speed_RL_mph : 16|12@1+ (0.0621,0) [0|248.4] "mph" Vector__XXX
 SG_ Wheel_Speed_FL_kph : 28|12@1+ (0.1,0) [0|500] "km/h" Vector__XXX
 SG_ Wheel_Speed_FL_mph : 28|12@1+ (0.0621,0) [0|310.5] "mph" Vector__XXX
 SG_ Wheel_Speed_RR_kph : 40|12@1+ (0.1,0) [0|400] "km/h" Vector__XXX
 SG_ Wheel_Speed_RR_mph : 40|12@1+ (0.0621,0) [0|248.4] "mph" Vector__XXX
 SG_ Wheel_Speed_FR_kph : 52|12@1+ (0.1,0) [0|400] "km/h" Vector__XXX
 SG_ Wheel_Speed_FR_mph : 52|12@1+ (0.0621,0) [0|248.4] "mph" Vector__XXX

BO_ 262 MSG_106: 8 Vector__XXX
 SG_ Brake_Position : 16|10@1+ (0.15,-15) [0|100] "%" Vector__XXX

BO_ 289 MSG_121: 8 Vector__XXX
 SG_ Accelerator_Pedal_Position : 12|8@1+ (0.4,0) [0|100] "%" Vector__XXX
