VERSION ""

NS_ :

BS_: 500

BU_: Vector__XXX

BO_ 370 MSG_172: 8 Vector__XXX
 SG_ Gear : 16|8@0+ (1,0) [0|9] "" Vector__XXX

BO_ 640 MSG_280: 8 Vector__XXX
 SG_ Engine_Speed : 16|16@1+ (0.250527,-13.5515) [0|10000] "rpm" Vector__XXX
 SG_ Throttle_Position : 16|8@0+ (0.4,0) [0|102] "%" Vector__XXX

BO_ 1192 MSG_4A8: 8 Vector__XXX
 SG_ Brake_Pressure : 20|12@1+ (2.90323,-743.226) [-743.225806452|11145.483871] "bar" Vector__XXX

BO_ 1478 MSG_5C6: 8 Vector__XXX
 SG_ Steering_Angle : 12|10@1+ (-0.703125,0) [-719.296875|0] "��" Vector__XXX
