VERSION ""

NS_ :

BS_: 500

BU_: Vector__XXX

BO_ 194 MSG_0C2: 8 Vector__XXX
 SG_ Steering_Angle : 0|15@1+ (0.0439453125,0) [0|1439.95605469] "��" Vector__XXX
 SG_ Steering_Direction : 15|1@1+ (1,0) [0|1] "" Vector__XXX

BO_ 416 MSG_1A0: 8 Vector__XXX
 SG_ Indicated_Vehicle_Speed_kph : 16|16@1+ (0.004991,0) [0|410.55] "km/h" Vector__XXX
 SG_ Indicated_Vehicle_Speed_mph : 16|16@1+ (0.0031,0) [0|255] "mph" Vector__XXX

BO_ 428 MSG_1AC: 8 Vector__XXX
 SG_ Indicated_Longitudinal_Acceleration : 48|10@1+ (0.03,-16) [-15.9|15.9] "m/s��" Vector__XXX

BO_ 640 MSG_280: 8 Vector__XXX
 SG_ Engine_Speed : 16|16@1+ (0.25,0) [0|10000] "rpm" Vector__XXX
 SG_ Accelerator_Pedal_Position : 40|8@1+ (0.39,0) [-127|127] "%" Vector__XXX
 SG_ Throttle_Position : 40|8@1+ (0.4,0) [0|101.6] "%" Vector__XXX

BO_ 648 MSG_288: 8 Vector__XXX
 SG_ Coolant_Temperature : 8|8@1+ (0.75,-48) [-47.25|142.5] "��C" Vector__XXX
 SG_ Brake_Position : 40|2@0+ (1,0) [0|3] "on/off" Vector__XXX

BO_ 1088 MSG_440: 8 Vector__XXX
 SG_ Gear : 52|4@0+ (1,0) [0|255] "" Vector__XXX

BO_ 1184 MSG_4A0: 8 Vector__XXX
 SG_ Wheel_Speed_FL_kph : 1|15@1+ (0.01,0) [0|0] "km/h" Vector__XXX
 SG_ Wheel_Speed_FL_mph : 1|15@1+ (0.00621,0) [0|0] "mph" Vector__XXX
 SG_ Wheel_Speed_FR_kph : 17|15@1+ (0.01,0) [0|0] "km/h" Vector__XXX
 SG_ Wheel_Speed_FR_mph : 17|15@1+ (0.00621,0) [0|0] "mph" Vector__XXX
 SG_ Wheel_Speed_RR_kph : 33|15@1+ (0.01,0) [0|0] "km/h" Vector__XXX
 SG_ Wheel_Speed_RR_mph : 33|15@1+ (0.00621,0) [0|0] "mph" Vector__XXX
 SG_ Wheel_Speed_RL_kph : 49|15@1+ (0.01,0) [0|0] "km/h" Vector__XXX
 SG_ Wheel_Speed_RL_mph : 49|15@1+ (0.00621,0) [0|0] "mph" Vector__XXX

BO_ 1192 MSG_4A8: 8 Vector__XXX
 SG_ Yaw_Rate : 0|14@1+ (0.01,0) [0|100] "��/s" Vector__XXX
 SG_ Brake_Pressure : 16|12@1+ (0.1,0) [0|409.4] "bar" Vector__XXX

BO_ 1344 MSG_540: 8 Vector__XXX
 SG_ Gear_Requested : 60|4@1+ (1,-1) [0|14] "" Vector__XXX

BO_ 1416 MSG_588: 8 Vector__XXX
 SG_ Oil_Temperature : 56|8@1+ (1,-60) [-58|194] "��C" Vector__XXX

BO_ 1440 MSG_5A0: 8 Vector__XXX
 SG_ Indicated_Lateral_Acceleration : 0|8@1+ (0.01,-1.27) [-1.27|1.27] "m/s��" Vector__XXX
