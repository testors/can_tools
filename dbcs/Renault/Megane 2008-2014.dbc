VERSION ""

NS_ :

BS_: 500

BU_: Vector__XXX

BO_ 198 MSG_0C6: 8 Vector__XXX
 SG_ Steering_Angle : 48|16@0+ (0.0998225,-3272.68) [-3272|3269] "��" Vector__XXX

BO_ 390 MSG_186: 8 Vector__XXX
 SG_ Throttle_Position : 32|20@1+ (0.00156,-0.125) [-0.125|1635.652] "%" Vector__XXX
 SG_ Engine_Speed : 52|12@0+ (1.97201,168.384) [168.3842|8200] "rpm" Vector__XXX

BO_ 666 MSG_29A: 8 Vector__XXX
 SG_ Indicated_Vehicle_Speed_kph : 16|16@0+ (0.01,0) [0|655.34] "km/h" Vector__XXX
 SG_ Indicated_Vehicle_Speed_mph : 16|16@0+ (0.00621,0) [0|406.96614] "mph" Vector__XXX
 SG_ Wheel_Speed_FL_kph : 32|16@0+ (0.01,0) [0|2732.8095] "km/h" Vector__XXX
 SG_ Wheel_Speed_FL_mph : 32|16@0+ (0.00621,0) [0|1697.0746995] "mph" Vector__XXX
 SG_ Wheel_Speed_FR_kph : 48|16@0+ (0.01,0) [0|2730.583] "km/h" Vector__XXX
 SG_ Wheel_Speed_FR_mph : 48|16@0+ (0.00621,0) [0|1695.692043] "mph" Vector__XXX

BO_ 668 MSG_29C: 8 Vector__XXX
 SG_ Wheel_Speed_RR_kph : 32|16@0+ (0.01,0) [0|2732.8095] "km/h" Vector__XXX
 SG_ Wheel_Speed_RR_mph : 32|16@0+ (0.00621,0) [0|1697.0746995] "mph" Vector__XXX
 SG_ Wheel_Speed_RL_kph : 48|16@0+ (0.01,0) [0|2730.583] "km/h" Vector__XXX
 SG_ Wheel_Speed_RL_mph : 48|16@0+ (0.00621,0) [0|1695.692043] "mph" Vector__XXX

BO_ 850 MSG_352: 8 Vector__XXX
 SG_ Brake_Position : 32|8@0+ (1,0) [0|255] "%" Vector__XXX
