VERSION ""

NS_ :

BS_: 500

BU_: Vector__XXX

BO_ 264 MSG_108: 8 Vector__XXX
 SG_ Throttle_Position : 16|16@0+ (0.0998004,-0.0998004) [-0.0998003992016|6540.31936128] "%" Vector__XXX

BO_ 392 MSG_188: 8 Vector__XXX
 SG_ Gear : 32|4@0+ (1,-1) [-1|14] "" Vector__XXX
