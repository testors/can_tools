VERSION ""

NS_ :

BS_: 500

BU_: Vector__XXX

BO_ 256 MSG_100: 8 Vector__XXX
 SG_ Boost_Pressure : 0|16@0+ (1,0) [0|10] "mbar" Vector__XXX
 SG_ Wheel_Speed_FR_kph : 32|16@0+ (0.06,0) [0|500] "km/h" Vector__XXX
 SG_ Wheel_Speed_FR_mph : 32|16@0+ (0.03726,0) [0|310.5] "mph" Vector__XXX
 SG_ Wheel_Speed_FL_kph : 48|16@0+ (0.06,0) [0|500] "km/h" Vector__XXX
 SG_ Wheel_Speed_FL_mph : 48|16@0+ (0.03726,0) [0|310.5] "mph" Vector__XXX

BO_ 264 MSG_108: 8 Vector__XXX
 SG_ Throttle_Position : 16|16@0+ (0.1,0) [0|16383.75] "%" Vector__XXX

BO_ 272 MSG_110: 8 Vector__XXX
 SG_ Oil_Temperature : 16|16@0+ (0.1,-100) [0|200] "��C" Vector__XXX
 SG_ Coolant_Temperature : 32|16@0+ (0.1,-100) [0|200] "��C" Vector__XXX

BO_ 296 MSG_128: 8 Vector__XXX
 SG_ Fuel_Pressure : 32|16@0+ (0.001,0) [0|10] "bar" Vector__XXX
 SG_ Oil_Pressure : 48|16@0+ (0.001,0) [0|10] "bar" Vector__XXX

BO_ 312 MSG_138: 8 Vector__XXX
 SG_ Steering_Angle : 48|16@0+ (0.1,-3276.8) [0|16383.75] "��" Vector__XXX

BO_ 368 MSG_170: 8 Vector__XXX
 SG_ Engine_Speed : 48|16@0+ (1,0) [0|10000] "rpm" Vector__XXX

BO_ 392 MSG_188: 8 Vector__XXX
 SG_ Gear : 32|8@0+ (1,0) [0|16383.75] "" Vector__XXX
