VERSION ""

NS_ :

BS_: 500

BU_: Vector__XXX

BO_ 352 MSG_160: 8 Vector__XXX
 SG_ Oil_Pressure : 32|16@0+ (0.1,0) [0|0] "bar" Vector__XXX

BO_ 353 MSG_161: 8 Vector__XXX
 SG_ Air_Temperature : 0|16@0- (1,0) [0|100] "��C" Vector__XXX
 SG_ Engine_Speed : 16|16@0+ (1,0) [0|10000] "rpm" Vector__XXX

BO_ 354 MSG_162: 8 Vector__XXX
 SG_ Gear : 8|8@0+ (1,-48) [0|0] "" Vector__XXX
 SG_ Manifold_Pressure : 16|16@0+ (1,0) [0|0] "mbar" Vector__XXX
 SG_ Battery_Voltage : 32|16@0+ (0.1,0) [0|30] "V" Vector__XXX
 SG_ Coolant_Temperature : 48|16@0- (1,0) [0|120] "��C" Vector__XXX

BO_ 358 MSG_166: 8 Vector__XXX
 SG_ Gear_Switch : 48|8@0+ (1,0) [0|0] "on/off" Vector__XXX

BO_ 359 MSG_167: 8 Vector__XXX
 SG_ Throttle_Position : 0|8@0+ (1,0) [0|100] "%" Vector__XXX
