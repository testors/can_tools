VERSION ""

NS_ :

BS_: 500

BU_: Vector__XXX

BO_ 194 MSG_0C2: 8 Vector__XXX
 SG_ Steering_Angle : 48|16@0- (0.1,0) [0|65535] "" Vector__XXX

BO_ 250 MSG_0FA: 8 Vector__XXX
 SG_ Throttle_Position : 32|8@0+ (0.39,0) [-127|127] "" Vector__XXX
 SG_ Engine_Speed : 48|16@0+ (0.125,0) [0|10000] "rpm" Vector__XXX

BO_ 257 MSG_101: 8 Vector__XXX
 SG_ Wheel_Speed_4_kph : 0|16@0+ (0.0161,0) [-52754.87|52754.87] "km/h" Vector__XXX
 SG_ Wheel_Speed_4_mph : 0|16@0+ (0.01,0) [-32767|32767] "mph" Vector__XXX
 SG_ Wheel_Speed_3_kph : 16|16@0+ (0.0161,0) [-52754.87|52754.87] "km/h" Vector__XXX
 SG_ Wheel_Speed_3_mph : 16|16@0+ (0.01,0) [-32767|32767] "mph" Vector__XXX
 SG_ Wheel_Speed_2_kph : 32|16@0+ (0.0161,0) [-52754.87|52754.87] "km/h" Vector__XXX
 SG_ Wheel_Speed_2_mph : 32|16@0+ (0.01,0) [-32767|32767] "mph" Vector__XXX
 SG_ Wheel_Speed_1_kph : 48|16@0+ (0.0161,0) [-52754.87|52754.87] "km/h" Vector__XXX
 SG_ Wheel_Speed_1_mph : 48|16@0+ (0.01,0) [-32767|32767] "mph" Vector__XXX

BO_ 258 MSG_102: 8 Vector__XXX
 SG_ Brake_Position : 40|2@0+ (1,0) [0|1] "on/off" Vector__XXX
