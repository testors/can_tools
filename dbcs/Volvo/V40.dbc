VERSION ""

NS_ :

BS_: 500

BU_: Vector__XXX

BO_ 101 MSG_065: 8 Vector__XXX
 SG_ Engine_Speed : 0|12@0+ (1,0) [0|10000] "rpm" Vector__XXX

BO_ 245 MSG_0F5: 8 Vector__XXX
 SG_ Wheel_Speed_FR : 0|16@0+ (0.01,-327.68) [0|255] "" Vector__XXX
 SG_ Wheel_Speed_FL_kph : 16|16@0+ (0.01,-327.68) [-327.68|327.67] "km/h" Vector__XXX
 SG_ Wheel_Speed_FL_mph : 16|16@0+ (0.00621,-327.68) [-203.48928|203.48307] "mph" Vector__XXX

BO_ 288 MSG_120: 8 Vector__XXX
 SG_ Wheel_Speed_RR_kph : 0|16@0+ (0.01,-327.68) [-327.68|327.67] "km/h" Vector__XXX
 SG_ Wheel_Speed_RR_mph : 0|16@0+ (0.00621,-327.68) [-203.48928|203.48307] "mph" Vector__XXX
 SG_ Wheel_Speed_RL_kph : 16|16@0+ (0.01,-327.68) [-327.68|327.67] "km/h" Vector__XXX
 SG_ Wheel_Speed_RL_mph : 16|16@0+ (0.00621,-327.68) [-203.48928|203.48307] "mph" Vector__XXX

BO_ 325 MSG_145: 8 Vector__XXX
 SG_ Clutch_Position : 47|1@0+ (1,0) [0|0] "on/off" Vector__XXX

BO_ 336 MSG_150: 8 Vector__XXX
 SG_ Steering_Angle : 32|16@0- (-0.514286,-1048.63) [-17900.2285714|15802.9714286] "��" Vector__XXX

BO_ 432 MSG_1B0: 8 Vector__XXX
 SG_ Brake_Position : 16|10@0+ (0.130719,0) [0|255] "" Vector__XXX

BO_ 681 MSG_2A9: 8 Vector__XXX
 SG_ Indicator_Left : 14|1@0+ (1,0) [0|0] "on/off" Vector__XXX
 SG_ Indicator_Right : 15|1@0+ (1,0) [0|0] "on/off" Vector__XXX

BO_ 693 MSG_2B5: 8 Vector__XXX
 SG_ Accelerator_Pedal_Position : 48|8@0+ (0.392157,0) [0|100] "%" Vector__XXX
