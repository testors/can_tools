VERSION ""

NS_ :

BS_: 500

BU_: Vector__XXX

BO_ 16 MSG_010: 8 Vector__XXX
 SG_ Steering_Angle : 0|16@0+ (0.044,0) [-720|720] "��" Vector__XXX

BO_ 277 MSG_115: 8 Vector__XXX
 SG_ Accelerator_Pedal_Position : 32|8@0+ (0.431034,0) [0|100] "%" Vector__XXX

BO_ 298 MSG_12A: 8 Vector__XXX
 SG_ Engine_Speed : 0|13@0+ (1,0) [0|8191] "rpm" Vector__XXX

BO_ 328 MSG_148: 8 Vector__XXX
 SG_ Brake_Position : 16|10@0+ (0.1,0) [0|100] "%" Vector__XXX

BO_ 544 MSG_220: 8 Vector__XXX
 SG_ Wheel_Speed_RL_kph : 0|15@0+ (0.01,0) [0|330] "km/h" Vector__XXX
 SG_ Wheel_Speed_RL_mph : 0|15@0+ (0.00621,0) [0|204.93] "mph" Vector__XXX
 SG_ Wheel_Speed_RR_kph : 16|15@0+ (0.01,0) [0|32767] "km/h" Vector__XXX
 SG_ Wheel_Speed_RR_mph : 16|15@0+ (0.00621,0) [0|20348.307] "mph" Vector__XXX

BO_ 565 MSG_235: 8 Vector__XXX
 SG_ Wheel_Speed_FL_kph : 0|15@0+ (0.01,0) [0|330] "km/h" Vector__XXX
 SG_ Wheel_Speed_FL_mph : 0|15@0+ (0.00621,0) [0|204.93] "mph" Vector__XXX
 SG_ Wheel_Speed_FR_kph : 16|15@0+ (0.01,0) [0|330] "km/h" Vector__XXX
 SG_ Wheel_Speed_FR_mph : 16|15@0+ (0.00621,0) [0|204.93] "mph" Vector__XXX
