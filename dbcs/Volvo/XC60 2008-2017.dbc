VERSION ""

NS_ :

BS_: 500

BU_: Vector__XXX

BO_ 245 MSG_0F5: 8 Vector__XXX
 SG_ Engine_Speed : 0|13@0+ (1,0) [0|8000] "rpm" Vector__XXX

BO_ 805 MSG_325: 8 Vector__XXX
 SG_ Indicated_Vehicle_Speed_kph : 16|15@0+ (0.010304,0) [0|322] "km/h" Vector__XXX
 SG_ Indicated_Vehicle_Speed_mph : 16|15@0+ (0.0064,0) [0|200] "mph" Vector__XXX

BO_ 928 MSG_3A0: 8 Vector__XXX
 SG_ Handbrake : 12|1@0+ (1,0) [0|1] "on/off" Vector__XXX
