VERSION ""

NS_ :

BS_: 500

BU_: Vector__XXX

BO_ 74 MSG_04A: 8 Vector__XXX
 SG_ Accelerator_Pedal_Position : 24|7@0+ (1,0) [0|127] "" Vector__XXX

BO_ 273 MSG_111: 8 Vector__XXX
 SG_ Engine_Speed : 48|15@0+ (0.5,0) [0|10000] "rpm" Vector__XXX

BO_ 357 MSG_165: 8 Vector__XXX
 SG_ Brake_Position : 32|16@0+ (0.0175,0) [0|100] "%" Vector__XXX
