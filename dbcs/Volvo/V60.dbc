VERSION ""

NS_ :

BS_: 500

BU_: Vector__XXX

BO_ 16 MSG_010: 8 Vector__XXX
 SG_ Steering_Angle : 0|14@0+ (0.0439,0) [0|720] "��" Vector__XXX

BO_ 32 MSG_020: 8 Vector__XXX
 SG_ Throttle_Position : 32|10@0+ (0.1,0) [0|100] "%" Vector__XXX

BO_ 298 MSG_12A: 8 Vector__XXX
 SG_ Engine_Speed : 0|13@0+ (1,0) [0|8192] "rpm" Vector__XXX

BO_ 328 MSG_148: 8 Vector__XXX
 SG_ Indicated_Vehicle_Speed_kph : 0|15@0+ (0.01,0) [0|327] "km/h" Vector__XXX
 SG_ Indicated_Vehicle_Speed_mph : 0|15@0+ (0.00621,0) [0|203.067] "mph" Vector__XXX

BO_ 352 MSG_160: 8 Vector__XXX
 SG_ Ignition_On : 20|1@0+ (1,0) [0|1] "" Vector__XXX

BO_ 544 MSG_220: 8 Vector__XXX
 SG_ Wheel_Speed_RL_kph : 0|15@0+ (0.01,0) [0|327] "km/h" Vector__XXX
 SG_ Wheel_Speed_RL_mph : 0|15@0+ (0.00621,0) [0|203.067] "mph" Vector__XXX
 SG_ Wheel_Speed_RR_kph : 16|15@0+ (0.01,0) [0|327] "km/h" Vector__XXX
 SG_ Wheel_Speed_RR_mph : 16|15@0+ (0.00621,0) [0|203.067] "mph" Vector__XXX

BO_ 565 MSG_235: 8 Vector__XXX
 SG_ Wheel_Speed_FL_kph : 0|15@0+ (0.01,0) [0|327] "km/h" Vector__XXX
 SG_ Wheel_Speed_FL_mph : 0|15@0+ (0.00621,0) [0|203.067] "mph" Vector__XXX
 SG_ Wheel_Speed_FR_kph : 16|15@0+ (0.01,0) [0|327] "km/h" Vector__XXX
 SG_ Wheel_Speed_FR_mph : 16|15@0+ (0.00621,0) [0|203.067] "mph" Vector__XXX

BO_ 750 MSG_2EE: 8 Vector__XXX
 SG_ Handbrake : 17|1@0+ (1,0) [0|1] "" Vector__XXX
