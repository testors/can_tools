VERSION ""

NS_ :

BS_: 500

BU_: Vector__XXX

BO_ 2156937502 MSG_8090411E: 8 Vector__XXX
 SG_ Engine_Speed : 32|12@0+ (1,0) [0|8000] "rpm" Vector__XXX

BO_ 2176860198 MSG_81C04026: 8 Vector__XXX
 SG_ Wheel_Speed_4_kph : 0|15@0+ (0.0064,0) [0|250] "km/h" Vector__XXX
 SG_ Wheel_Speed_4_mph : 0|15@0+ (0.0039744,0) [0|155.25] "mph" Vector__XXX
 SG_ Wheel_Speed_3_kph : 16|15@0+ (0.0064,0) [0|250] "km/h" Vector__XXX
 SG_ Wheel_Speed_3_mph : 16|15@0+ (0.0039744,0) [0|155.25] "mph" Vector__XXX
 SG_ Wheel_Speed_2_kph : 32|15@0+ (1,0) [-16383|16383] "km/h" Vector__XXX
 SG_ Wheel_Speed_2_mph : 32|15@0+ (0.621,0) [-10173.843|10173.843] "mph" Vector__XXX
 SG_ Wheel_Speed_1_kph : 48|15@0+ (1,0) [-16383|16383] "km/h" Vector__XXX
 SG_ Wheel_Speed_1_mph : 48|15@0+ (0.621,0) [-10173.843|10173.843] "mph" Vector__XXX

BO_ 2181038118 MSG_82000026: 8 Vector__XXX
 SG_ Brake_Position : 16|8@0+ (1,0) [0|1000] "" Vector__XXX

BO_ 2197831950 MSG_8300410E: 8 Vector__XXX
 SG_ Throttle_Position : 0|10@0+ (1,0) [0|1000] "" Vector__XXX

BO_ 2202026286 MSG_8340412E: 8 Vector__XXX
 SG_ Steering_Angle : 0|16@0+ (0.04395,0) [-720|720] "" Vector__XXX
