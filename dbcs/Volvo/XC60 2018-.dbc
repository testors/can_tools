VERSION ""

NS_ :

BS_: 500

BU_: Vector__XXX

BO_ 128 MSG_080: 8 Vector__XXX
 SG_ Brake_Position : 32|16@0+ (0.006,0) [0|100] "%" Vector__XXX

BO_ 144 MSG_090: 8 Vector__XXX
 SG_ Accelerator_Pedal_Position : 0|15@0+ (0.00390625,0) [0|100] "%" Vector__XXX
 SG_ Steering_Angle : 48|15@0- (-0.05625,0) [-540|540] "��" Vector__XXX
