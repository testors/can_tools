VERSION ""

NS_ :

BS_: 500

BU_: Vector__XXX

BO_ 496 MSG_1F0: 8 Vector__XXX
 SG_ Wheel_Speed_FL_kph : 0|12@1+ (1,0) [0|0] "km/h" Vector__XXX
 SG_ Wheel_Speed_FL_mph : 0|12@1+ (0.621,0) [0|0] "mph" Vector__XXX
 SG_ Wheel_Speed_FR_kph : 16|12@1+ (1,0) [0|0] "km/h" Vector__XXX
 SG_ Wheel_Speed_FR_mph : 16|12@1+ (0.621,0) [0|0] "mph" Vector__XXX
 SG_ Wheel_Speed_RL_kph : 32|12@1+ (1,0) [0|0] "km/h" Vector__XXX
 SG_ Wheel_Speed_RL_mph : 32|12@1+ (0.621,0) [0|0] "mph" Vector__XXX
 SG_ Wheel_Speed_RR_kph : 48|12@1+ (1,0) [0|0] "km/h" Vector__XXX
 SG_ Wheel_Speed_RR_mph : 48|12@1+ (0.621,0) [0|0] "mph" Vector__XXX

BO_ 790 MSG_316: 8 Vector__XXX
 SG_ Engine_Speed : 16|16@1+ (1,0) [0|10000] "rpm" Vector__XXX
