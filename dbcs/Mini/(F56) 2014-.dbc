VERSION ""

NS_ :

BS_: 500

BU_: Vector__XXX

BO_ 168 MSG_0A8: 8 Vector__XXX
 SG_ Clutch_Position : 40|1@1+ (1,0) [0|1] "on/off" Vector__XXX

BO_ 170 MSG_0AA: 8 Vector__XXX
 SG_ Accelerator_Pedal_Position : 24|8@1+ (0.390625,0) [0|100] "%" Vector__XXX
 SG_ Engine_Speed : 32|16@1+ (0.25,0) [0|8000] "rpm" Vector__XXX

BO_ 196 MSG_0C4: 7 Vector__XXX
 SG_ Steering_Angle : 0|16@1- (-0.044,0) [-720|720] "��" Vector__XXX

BO_ 414 MSG_19E: 8 Vector__XXX
 SG_ Brake_Position : 0|16@0+ (0.002,0) [0|1] "%" Vector__XXX
