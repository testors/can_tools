VERSION ""

NS_ :

BS_: 500

BU_: Vector__XXX

BO_ 529 MSG_211: 8 Vector__XXX
 SG_ Indicated_Vehicle_Speed : 32|16@0+ (0.0045,0) [0|0] "" Vector__XXX
