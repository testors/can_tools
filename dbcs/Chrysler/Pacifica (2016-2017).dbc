VERSION ""

NS_ :

BS_: 500

BU_: Vector__XXX

BO_ 258 MSG_102: 8 Vector__XXX
 SG_ Steering_Rate : 32|14@0+ (0.5,-2048) [-2048|2047] "" Vector__XXX
 SG_ Steering_Angle : 48|16@0+ (-0.5,2046) [-1000|1000] "��" Vector__XXX

BO_ 288 MSG_120: 7 Vector__XXX
 SG_ Accelerator_Pedal_Position : 40|8@0+ (0.4,0) [0|100] "%" Vector__XXX

BO_ 320 MSG_140: 8 Vector__XXX
 SG_ Brake_Position : 2|2@1+ (1,0) [0|3] "" Vector__XXX

BO_ 324 MSG_144: 8 Vector__XXX
 SG_ Gear : 48|4@0+ (1,0) [0|15] "" Vector__XXX
 SG_ Gear_Requested : 52|4@0+ (1,0) [0|15] "" Vector__XXX

BO_ 344 MSG_158: 8 Vector__XXX
 SG_ Wheel_Speed_RR_kph : 0|14@0+ (0.06762,0) [0|13187.51] "km/h" Vector__XXX
 SG_ Wheel_Speed_RR_mph : 0|14@0+ (0.042,0) [0|8191] "mph" Vector__XXX
 SG_ Wheel_Speed_RL_kph : 16|14@0+ (0.06762,0) [0|13187.51] "km/h" Vector__XXX
 SG_ Wheel_Speed_RL_mph : 16|14@0+ (0.042,0) [0|8191] "mph" Vector__XXX
 SG_ Wheel_Speed_FR_kph : 32|14@0+ (0.06762,0) [0|13187.51] "km/h" Vector__XXX
 SG_ Wheel_Speed_FR_mph : 32|14@0+ (0.042,0) [0|8191] "mph" Vector__XXX
 SG_ Wheel_Speed_FL_kph : 48|14@0+ (0.06762,0) [0|13187.51] "km/h" Vector__XXX
 SG_ Wheel_Speed_FL_mph : 48|14@0+ (0.042,0) [0|8191] "mph" Vector__XXX

BO_ 384 MSG_180: 8 Vector__XXX
 SG_ Air_Temperature : 0|8@1+ (1,-40) [-40|214] "��C" Vector__XXX
 SG_ Coolant_Temperature : 8|8@1+ (1,-40) [-40|214] "��C" Vector__XXX

BO_ 501 MSG_1F5: 8 Vector__XXX
 SG_ Clutch_Position : 0|8@0+ (0.392157,0) [0|100.000035] "%" Vector__XXX

BO_ 512 MSG_200: 8 Vector__XXX
 SG_ Battery_Voltage : 48|8@1+ (0.1,0) [5|18] "V" Vector__XXX

BO_ 672 MSG_2A0: 8 Vector__XXX
 SG_ Oil_Temperature : 24|8@1+ (1,-40) [-40|160] "��C" Vector__XXX
