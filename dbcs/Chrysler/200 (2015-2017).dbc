VERSION ""

NS_ :

BS_: 500

BU_: Vector__XXX

BO_ 480 MSG_1E0: 8 Vector__XXX
 SG_ Brake_Position : 14|10@0+ (0.2,-12) [0|100] "%" Vector__XXX

BO_ 494 MSG_1EE: 6 Vector__XXX
 SG_ Steering_Angle : 48|16@0+ (-0.1,720) [-700|700] "��" Vector__XXX

BO_ 496 MSG_1F0: 8 Vector__XXX
 SG_ Throttle_Position : 53|8@0+ (0.39,0) [0|0] "%" Vector__XXX

BO_ 500 MSG_1F4: 7 Vector__XXX
 SG_ Gear : 24|4@0+ (1,0) [0|15] "" Vector__XXX

BO_ 504 MSG_1F8: 8 Vector__XXX
 SG_ Accelerator_Pedal_Position : 40|8@0+ (0.392157,0) [0|100] "%" Vector__XXX

BO_ 508 MSG_1FC: 8 Vector__XXX
 SG_ Engine_Speed : 48|16@0+ (1,0) [0|10000] "rpm" Vector__XXX

BO_ 740 MSG_2E4: 8 Vector__XXX
 SG_ Wheel_Speed_RL_kph : 30|14@0+ (0.0078125,0) [0|500] "km/h" Vector__XXX
 SG_ Wheel_Speed_RL_mph : 30|14@0+ (0.0048515625,0) [0|310.5] "mph" Vector__XXX
 SG_ Wheel_Speed_RR_kph : 46|16@0+ (0.00390625,0) [0|255.99609375] "km/h" Vector__XXX
 SG_ Wheel_Speed_RR_mph : 46|16@0+ (0.00242578125,0) [0|158.973574219] "mph" Vector__XXX

BO_ 742 MSG_2E6: 8 Vector__XXX
 SG_ Wheel_Speed_FL_kph : 30|14@0+ (0.0078125,0) [0|500] "km/h" Vector__XXX
 SG_ Wheel_Speed_FL_mph : 30|14@0+ (0.0048515625,0) [0|310.5] "mph" Vector__XXX
 SG_ Wheel_Speed_FR_kph : 46|16@0+ (0.00390625,0) [0|255.99609375] "km/h" Vector__XXX
 SG_ Wheel_Speed_FR_mph : 46|16@0+ (0.00242578125,0) [0|158.973574219] "mph" Vector__XXX
