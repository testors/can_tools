VERSION ""

NS_ :

BS_: 500

BU_: Vector__XXX

BO_ 2148573190 MSG_8010A006: 8 Vector__XXX
 SG_ Brake_Position : 40|16@0+ (0.15267,0) [0|100] "%" Vector__XXX
 SG_ Brake_Pressure : 40|10@0+ (3.6259,0) [0|2900] "psi" Vector__XXX

BO_ 2150146063 MSG_8028A00F: 8 Vector__XXX
 SG_ Yaw_Rate : 8|12@0+ (0.08,-163.84) [0|0] "��/s" Vector__XXX
 SG_ Indicated_Lateral_Acceleration : 20|12@0+ (0.00203943243,-4.17676) [-4|4] "g" Vector__XXX
 SG_ Indicated_Longitudinal_Acceleration : 32|12@0+ (0.00203943243,-4.17676) [-4|4] "g" Vector__XXX

BO_ 2150670338 MSG_8030A002: 8 Vector__XXX
 SG_ Steering_Angle : 24|16@0+ (-1.57,7137) [-720|720] "��" Vector__XXX

BO_ 2182651910 MSG_8218A006: 8 Vector__XXX
 SG_ Wheel_Speed_FL_kph : 0|16@0+ (0.0625,0) [0|400] "km/h" Vector__XXX
 SG_ Wheel_Speed_FL_mph : 0|16@0+ (0.0388125,0) [0|248.4] "mph" Vector__XXX
 SG_ Wheel_Speed_RL_kph : 16|16@0+ (0.0625,0) [0|400] "km/h" Vector__XXX
 SG_ Wheel_Speed_RL_mph : 16|16@0+ (0.0388125,0) [0|248.4] "mph" Vector__XXX
 SG_ Wheel_Speed_FR_kph : 32|16@0+ (0.0625,0) [0|400] "km/h" Vector__XXX
 SG_ Wheel_Speed_FR_mph : 32|16@0+ (0.0388125,0) [0|248.4] "mph" Vector__XXX
 SG_ Wheel_Speed_RR_kph : 48|16@0+ (0.0625,0) [0|400] "km/h" Vector__XXX
 SG_ Wheel_Speed_RR_mph : 48|16@0+ (0.0388125,0) [0|248.4] "mph" Vector__XXX

BO_ 2249760769 MSG_8618A001: 8 Vector__XXX
 SG_ Accelerator_Pedal_Position : 0|8@0+ (0.3902,0) [0|100] "%" Vector__XXX
 SG_ Engine_Speed : 32|16@0+ (1,0) [0|8000] "rpm" Vector__XXX

BO_ 2316869632 MSG_8A18A000: 8 Vector__XXX
 SG_ Handbrake : 13|1@0+ (1,0) [0|1] "on/off" Vector__XXX

BO_ 2316869633 MSG_8A18A001: 8 Vector__XXX
 SG_ Coolant_Temperature : 32|8@0+ (1,-40) [-40|215] "��C" Vector__XXX

BO_ 2316869638 MSG_8A18A006: 8 Vector__XXX
 SG_ Indicated_Vehicle_Speed_kph : 32|13@0+ (0.062468,0) [0|511.98] "km/h" Vector__XXX
 SG_ Indicated_Vehicle_Speed_mph : 32|13@0+ (0.0388,0) [0|318] "mph" Vector__XXX

BO_ 2317131777 MSG_8A1CA001: 8 Vector__XXX
 SG_ Boost_Pressure : 40|8@0+ (0.21756,0) [0|55] "psi" Vector__XXX
