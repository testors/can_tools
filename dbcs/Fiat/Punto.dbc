VERSION ""

NS_ :

BS_: 500

BU_: Vector__XXX

BO_ 2182651910 MSG_8218A006: 8 Vector__XXX
 SG_ Wheel_Speed_4_kph : 0|13@0+ (0.07084,0) [3.22|322] "km/h" Vector__XXX
 SG_ Wheel_Speed_4_mph : 0|13@0+ (0.044,0) [2|200] "mph" Vector__XXX
 SG_ Wheel_Speed_3_kph : 16|13@0+ (0.07084,0) [3.22|322] "km/h" Vector__XXX
 SG_ Wheel_Speed_3_mph : 16|13@0+ (0.044,0) [2|200] "mph" Vector__XXX
 SG_ Wheel_Speed_2_kph : 32|13@0+ (0.07084,0) [3.22|322] "km/h" Vector__XXX
 SG_ Wheel_Speed_2_mph : 32|13@0+ (0.044,0) [2|200] "mph" Vector__XXX
 SG_ Wheel_Speed_1_kph : 48|13@0+ (0.07084,0) [3.22|322] "km/h" Vector__XXX
 SG_ Wheel_Speed_1_mph : 48|13@0+ (0.044,0) [2|200] "mph" Vector__XXX

BO_ 2249760769 MSG_8618A001: 8 Vector__XXX
 SG_ Engine_Speed : 32|14@0+ (1,0) [0|10000] "rpm" Vector__XXX
 SG_ Accelerator_Pedal_Position : 56|8@1+ (0.4,0) [0|100] "%" Vector__XXX
