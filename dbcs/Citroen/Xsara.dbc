VERSION ""

NS_ :

BS_: 500

BU_: Vector__XXX

BO_ 1101 MSG_44D: 8 Vector__XXX
 SG_ Wheel_Speed_1_kph : 48|16@0+ (0.010626,0) [0|0] "km/h" Vector__XXX
 SG_ Wheel_Speed_1_mph : 48|16@0+ (0.0066,0) [0|0] "mph" Vector__XXX
