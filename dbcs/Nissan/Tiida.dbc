VERSION ""

NS_ :

BS_: 500

BU_: Vector__XXX

BO_ 385 MSG_181: 8 Vector__XXX
 SG_ Throttle_Position : 24|16@0+ (0.00187761,-7.84) [0|100] "%" Vector__XXX
 SG_ Engine_Speed : 48|16@0+ (0.125,0) [0|8000] "rpm" Vector__XXX
