VERSION ""

NS_ :

BS_: 500

BU_: Vector__XXX

BO_ 2 MSG_002: 5 Vector__XXX
 SG_ Steering_Angle : 0|16@1- (0.1,0) [-3276.7|3276.7] "��" Vector__XXX

BO_ 352 MSG_160: 8 Vector__XXX
 SG_ Accelerator_Pedal_Position : 32|8@0+ (0.5,0) [0|100] "%" Vector__XXX

BO_ 375 MSG_177: 6 Vector__XXX
 SG_ Gear : 40|3@0+ (1,1) [1|8] "" Vector__XXX

BO_ 384 MSG_180: 8 Vector__XXX
 SG_ Engine_Speed : 48|16@0+ (0.125,0) [0|10000] "rpm" Vector__XXX

BO_ 386 MSG_182: 8 Vector__XXX
 SG_ Brake_Light : 14|1@0+ (1,0) [0|1] "on/off" Vector__XXX

BO_ 644 MSG_284: 8 Vector__XXX
 SG_ Wheel_Speed_FL_kph : 32|16@0+ (0.005,0) [0|500] "km/h" Vector__XXX
 SG_ Wheel_Speed_FL_mph : 32|16@0+ (0.003105,0) [0|310.5] "mph" Vector__XXX
 SG_ Wheel_Speed_FR_kph : 48|16@0+ (0.005,0) [0|500] "km/h" Vector__XXX
 SG_ Wheel_Speed_FR_mph : 48|16@0+ (0.003105,0) [0|310.5] "mph" Vector__XXX

BO_ 645 MSG_285: 8 Vector__XXX
 SG_ Wheel_Speed_RL_kph : 32|16@0+ (0.005,0) [0|500] "km/h" Vector__XXX
 SG_ Wheel_Speed_RL_mph : 32|16@0+ (0.003105,0) [0|310.5] "mph" Vector__XXX
 SG_ Wheel_Speed_RR_kph : 48|16@0+ (0.005,0) [0|500] "km/h" Vector__XXX
 SG_ Wheel_Speed_RR_mph : 48|16@0+ (0.003105,0) [0|310.5] "mph" Vector__XXX

BO_ 658 MSG_292: 8 Vector__XXX
 SG_ Brake_Position : 8|8@0+ (0.5,0) [0|127.5] "%" Vector__XXX

BO_ 1057 MSG_421: 3 Vector__XXX
 SG_ Gear_Switch : 59|3@0+ (1,0) [0|7] "" Vector__XXX

BO_ 1477 MSG_5C5: 8 Vector__XXX
 SG_ Handbrake : 58|1@0+ (1,0) [0|1] "on/off" Vector__XXX

BO_ 1549 MSG_60D: 8 Vector__XXX
 SG_ Full_Beam : 51|1@0+ (1,0) [0|1] "on/off" Vector__XXX
 SG_ Headlights : 57|2@0+ (1,0) [0|3] "on/off" Vector__XXX
