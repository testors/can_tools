VERSION ""

NS_ :

BS_: 500

BU_: Vector__XXX

BO_ 5 MSG_005: 4 Vector__XXX
 SG_ Brake_Position : 32|16@0+ (0.0805153,0) [0|5276.57004831] "%" Vector__XXX

BO_ 261 MSG_105: 5 Vector__XXX
 SG_ Throttle_Position : 24|8@0+ (0.4,0) [0|102] "%" Vector__XXX
 SG_ Engine_Speed : 48|15@0+ (1,0) [0|10000] "rpm" Vector__XXX

BO_ 554 MSG_22A: 4 Vector__XXX
 SG_ Steering_Angle : 32|16@0+ (0.0598802,-979.94) [-979.94011976|2944.31137725] "" Vector__XXX
