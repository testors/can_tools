VERSION ""

NS_ :

BS_: 500

BU_: Vector__XXX

BO_ 194 MSG_0C2: 8 Vector__XXX
 SG_ Steering_Angle : 48|16@0+ (0.1,-3276.7) [0|0] "" Vector__XXX

BO_ 385 MSG_181: 8 Vector__XXX
 SG_ Throttle_Position : 32|8@0+ (0.48076923077,-7.6923076923) [0|0] "%" Vector__XXX
 SG_ Engine_Speed : 48|16@0+ (0.125,0) [0|10000] "rpm" Vector__XXX

BO_ 861 MSG_35D: 8 Vector__XXX
 SG_ Brake_Position : 28|1@0+ (1,0) [0|0] "" Vector__XXX
