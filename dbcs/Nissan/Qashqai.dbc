VERSION ""

NS_ :

BS_: 500

BU_: Vector__XXX

BO_ 346 MSG_15A: 8 Vector__XXX
 SG_ Throttle_Position : 40|8@0+ (0.5,0) [0|0] "%" Vector__XXX

BO_ 348 MSG_15C: 8 Vector__XXX
 SG_ Engine_Speed : 48|16@0+ (0.125,0) [0|10000] "rpm" Vector__XXX

BO_ 645 MSG_285: 8 Vector__XXX
 SG_ Wheel_Speed_RL_kph : 32|16@0+ (0.01,0) [0|0] "km/h" Vector__XXX
 SG_ Wheel_Speed_RL_mph : 32|16@0+ (0.00621,0) [0|0] "mph" Vector__XXX
 SG_ Wheel_Speed_RR_kph : 48|16@0+ (0.01,0) [0|0] "km/h" Vector__XXX
 SG_ Wheel_Speed_RR_mph : 48|16@0+ (0.00621,0) [0|0] "mph" Vector__XXX

BO_ 666 MSG_29A: 8 Vector__XXX
 SG_ Wheel_Speed_FL_kph : 32|16@0+ (0.01,0) [0|0] "km/h" Vector__XXX
 SG_ Wheel_Speed_FL_mph : 32|16@0+ (0.00621,0) [0|0] "mph" Vector__XXX
 SG_ Wheel_Speed_FR_kph : 48|16@0+ (0.01,0) [0|0] "km/h" Vector__XXX
 SG_ Wheel_Speed_FR_mph : 48|16@0+ (0.00621,0) [0|0] "mph" Vector__XXX

BO_ 683 MSG_2AB: 8 Vector__XXX
 SG_ Steering_Angle : 32|10@0- (1.25,0) [0|0] "��" Vector__XXX
