VERSION ""

NS_ :

BS_: 500

BU_: Vector__XXX

BO_ 561 MSG_231: 8 Vector__XXX
 SG_ Throttle_Position : 16|8@1+ (0.5,0) [0|0] "" Vector__XXX

BO_ 573 MSG_23D: 8 Vector__XXX
 SG_ Engine_Speed : 24|16@1+ (3.35,0) [0|10000] "rpm" Vector__XXX

BO_ 2147483648 MSG_80000000: 8 Vector__XXX
 SG_ Brake_Position : 0|8@1+ (1,0) [0|0] "" Vector__XXX
