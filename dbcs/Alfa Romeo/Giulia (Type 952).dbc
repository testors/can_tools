VERSION ""

NS_ :

BS_: 500

BU_: Vector__XXX

BO_ 222 MSG_0DE: 6 Vector__XXX
 SG_ Steering_Angle : 48|16@0+ (-0.1,720) [-5833.5|720] "��" Vector__XXX

BO_ 238 MSG_0EE: 8 Vector__XXX
 SG_ Wheel_Speed_RR_kph : 12|13@0+ (0.066214,0) [0|542.358874] "km/h" Vector__XXX
 SG_ Wheel_Speed_RR_mph : 12|13@0+ (0.041118894,0) [0|336.804860754] "mph" Vector__XXX
 SG_ Wheel_Speed_RL_kph : 25|13@0+ (0.066214,0) [0|542.358874] "km/h" Vector__XXX
 SG_ Wheel_Speed_RL_mph : 25|13@0+ (0.041118894,0) [0|336.804860754] "mph" Vector__XXX
 SG_ Wheel_Speed_FR_kph : 38|13@0+ (0.066214,0) [0|542.358874] "km/h" Vector__XXX
 SG_ Wheel_Speed_FR_mph : 38|13@0+ (0.041118894,0) [0|336.804860754] "mph" Vector__XXX
 SG_ Wheel_Speed_FL_kph : 51|13@0+ (0.066214,0) [0|542.358874] "km/h" Vector__XXX
 SG_ Wheel_Speed_FL_mph : 51|13@0+ (0.041118894,0) [0|336.804860754] "mph" Vector__XXX

BO_ 252 MSG_0FC: 8 Vector__XXX
 SG_ Accelerator_Pedal_Position : 36|9@0+ (0.1969,0) [0|100] "%" Vector__XXX
 SG_ Engine_Speed : 50|14@0+ (1,0) [0|10000] "rpm" Vector__XXX

BO_ 257 MSG_101: 8 Vector__XXX
 SG_ Brake_Position : 32|12@0+ (0.1,0) [0|409.5] "%" Vector__XXX

BO_ 599 MSG_257: 8 Vector__XXX
 SG_ Seat_Belt___Driver : 45|1@0+ (1,0) [0|0] "" Vector__XXX
