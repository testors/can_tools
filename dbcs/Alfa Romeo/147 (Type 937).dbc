VERSION ""

NS_ :

BS_: 500

BU_: Vector__XXX

BO_ 358 MSG_166: 8 Vector__XXX
 SG_ Wheel_Speed_RR_kph : 0|16@0+ (0.0625,0) [0|4095] "km/h" Vector__XXX
 SG_ Wheel_Speed_RR_mph : 0|16@0+ (0.0388125,0) [0|2542.995] "mph" Vector__XXX
 SG_ Wheel_Speed_RL_kph : 16|16@0+ (0.0625,0) [0|4095] "km/h" Vector__XXX
 SG_ Wheel_Speed_RL_mph : 16|16@0+ (0.0388125,0) [0|2542.995] "mph" Vector__XXX
 SG_ Wheel_Speed_FR_kph : 32|16@0+ (0.0625,0) [0|4095] "km/h" Vector__XXX
 SG_ Wheel_Speed_FR_mph : 32|16@0+ (0.0388125,0) [0|2542.995] "mph" Vector__XXX
 SG_ Wheel_Speed_FL_kph : 48|16@0+ (0.0625,0) [0|4095] "km/h" Vector__XXX
 SG_ Wheel_Speed_FL_mph : 48|16@0+ (0.0388125,0) [0|2542.995] "mph" Vector__XXX

BO_ 865 MSG_361: 8 Vector__XXX
 SG_ Throttle_Position : 0|8@0+ (0.4,0) [0|100] "%" Vector__XXX
 SG_ Engine_Speed : 32|16@0+ (1,0) [0|10000] "rpm" Vector__XXX
