VERSION ""

NS_ :

BS_: 500

BU_: Vector__XXX

BO_ 1632 MSG_660: 8 Vector__XXX
 SG_ Battery_Voltage : 16|8@0+ (0.1,0) [0|250] "V" Vector__XXX
 SG_ Gear : 24|8@0+ (1,0) [0|255] "" Vector__XXX
 SG_ Indicated_Vehicle_Speed_kph : 32|16@0+ (1,0) [0|500] "km/h" Vector__XXX
 SG_ Indicated_Vehicle_Speed_mph : 32|16@0+ (0.621,0) [0|310.5] "mph" Vector__XXX
 SG_ Engine_Speed : 48|16@0+ (1,0) [0|32000] "rpm" Vector__XXX

BO_ 1633 MSG_661: 8 Vector__XXX
 SG_ Coolant_Temperature : 32|16@0- (1,0) [-50|250] "��C" Vector__XXX
 SG_ Intake_Air_Temperature : 48|16@0- (1,0) [-50|250] "��C" Vector__XXX

BO_ 1634 MSG_662: 8 Vector__XXX
 SG_ Manifold_Pressure : 32|16@0+ (0.1,0) [0|0] "kPa" Vector__XXX
 SG_ Throttle_Position : 48|16@0+ (1,0) [0|255] "%" Vector__XXX
