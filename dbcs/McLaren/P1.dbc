VERSION ""

NS_ :

BS_: 500

BU_: Vector__XXX

BO_ 131 MSG_083: 8 Vector__XXX
 SG_ Engine_Speed : 32|16@1+ (0.25,0) [0|10000] "rpm" Vector__XXX

BO_ 132 MSG_084: 8 Vector__XXX
 SG_ Throttle_Position : 24|8@1+ (0.5,0) [0|127.5] "%" Vector__XXX

BO_ 145 MSG_091: 8 Vector__XXX
 SG_ Coolant_Temperature : 48|8@1+ (0.75,-48) [-48|142.5] "��C" Vector__XXX

BO_ 170 MSG_0AA: 8 Vector__XXX
 SG_ Oil_Temperature : 40|8@0+ (1,-40) [-40|215] "��C" Vector__XXX

BO_ 176 MSG_0B0: 8 Vector__XXX
 SG_ Steering_Rate : 32|14@0+ (0.5,-2048) [-2048|2047] "��/s" Vector__XXX
 SG_ Steering_Angle : 48|14@0+ (0.5,-2048) [-2048|2047] "��" Vector__XXX

BO_ 193 MSG_0C1: 8 Vector__XXX
 SG_ Wheel_Speed_FL_kph : 8|14@1+ (0.0625,0) [0|8191] "km/h" Vector__XXX
 SG_ Wheel_Speed_FL_mph : 8|14@1+ (0.0388125,0) [0|5086.611] "mph" Vector__XXX
 SG_ Wheel_Speed_FR_kph : 22|14@1+ (0.0625,0) [0|8191] "km/h" Vector__XXX
 SG_ Wheel_Speed_FR_mph : 22|14@1+ (0.0388125,0) [0|5086.611] "mph" Vector__XXX
 SG_ Wheel_Speed_RL_kph : 36|14@1+ (0.0625,0) [0|8191] "km/h" Vector__XXX
 SG_ Wheel_Speed_RL_mph : 36|14@1+ (0.0388125,0) [0|5086.611] "mph" Vector__XXX
 SG_ Wheel_Speed_RR_kph : 50|14@1+ (0.0625,0) [0|8191] "km/h" Vector__XXX
 SG_ Wheel_Speed_RR_mph : 50|14@1+ (0.0388125,0) [0|5086.611] "mph" Vector__XXX

BO_ 194 MSG_0C2: 8 Vector__XXX
 SG_ Yaw_Rate : 48|16@0+ (0.005,-163.84) [-163.84|163.83] "��/s" Vector__XXX

BO_ 195 MSG_0C3: 8 Vector__XXX
 SG_ Brake_Pressure : 16|8@0+ (1,0) [0|255] "bar" Vector__XXX

BO_ 262 MSG_106: 8 Vector__XXX
 SG_ Air_Temperature : 24|8@0+ (1,-40) [-40|215] "��C" Vector__XXX

BO_ 268 MSG_10C: 8 Vector__XXX
 SG_ Ride_Height_RR : 32|8@0+ (0.5,-75) [-75|52.5] "mm" Vector__XXX
 SG_ Ride_Height_RL : 40|8@0+ (0.5,-75) [-75|52.5] "mm" Vector__XXX
 SG_ Ride_Height_FR : 48|8@0+ (0.5,-75) [-75|52.5] "mm" Vector__XXX
 SG_ Ride_Height_FL : 56|8@0+ (0.5,-75) [-75|52.5] "mm" Vector__XXX
