VERSION ""

NS_ :

BS_: 500

BU_: Vector__XXX

BO_ 128 MSG_080: 8 Vector__XXX
 SG_ Coolant_Temperature : 0|8@1+ (0.75,-48) [-48|142.5] "��C" Vector__XXX

BO_ 130 MSG_082: 8 Vector__XXX
 SG_ Throttle_Position : 0|8@1+ (0.39,0) [0|99.45] "%" Vector__XXX

BO_ 131 MSG_083: 8 Vector__XXX
 SG_ Engine_Speed : 16|12@1+ (2.5,0) [0|10000] "rpm" Vector__XXX

BO_ 132 MSG_084: 8 Vector__XXX
 SG_ Boost_Pressure : 56|8@1+ (0.0125,0) [0|3.1875] "bar" Vector__XXX

BO_ 162 MSG_0A2: 8 Vector__XXX
 SG_ Gear : 32|4@0+ (1,0) [0|15] "" Vector__XXX

BO_ 170 MSG_0AA: 8 Vector__XXX
 SG_ Oil_Temperature : 16|8@1+ (1,-40) [-40|215] "��C" Vector__XXX

BO_ 176 MSG_0B0: 8 Vector__XXX
 SG_ Steering_Rate : 32|14@0+ (0.5,-2048) [-2048|2047] "��/s" Vector__XXX
 SG_ Steering_Angle : 48|14@0+ (0.5,-2048) [-2048|2047] "��" Vector__XXX

BO_ 194 MSG_0C2: 8 Vector__XXX
 SG_ Yaw_Rate : 48|16@0+ (0.005,-163.84) [-163.84|163.83] "��/s" Vector__XXX

BO_ 195 MSG_0C3: 8 Vector__XXX
 SG_ Brake_Pressure : 16|8@0+ (1,0) [0|255] "bar" Vector__XXX

BO_ 216 MSG_0D8: 8 Vector__XXX
 SG_ Indicated_Vehicle_Speed_kph : 48|16@0+ (0.01,0) [0|655.35] "km/h" Vector__XXX
 SG_ Indicated_Vehicle_Speed_mph : 48|16@0+ (0.00621,0) [0|406.97235] "mph" Vector__XXX

BO_ 450 MSG_1C2: 8 Vector__XXX
 SG_ Tyre_Temperature_RR : 0|8@0+ (1,-40) [-40|215] "��C" Vector__XXX
 SG_ Tyre_Pressure_RR : 8|8@0+ (0.025,0) [0|6.375] "bar" Vector__XXX
 SG_ Tyre_Temperature_RL : 16|8@0+ (1,-40) [-40|215] "��C" Vector__XXX
 SG_ Tyre_Pressure_RL : 24|8@0+ (0.025,0) [0|6.375] "bar" Vector__XXX
 SG_ Tyre_Temperature_FR : 32|8@0+ (1,-40) [-40|215] "��C" Vector__XXX
 SG_ Tyre_Pressure_FR : 40|8@0+ (0.025,0) [0|6.375] "bar" Vector__XXX
 SG_ Tyre_Temperature_FL : 48|8@0+ (1,-40) [-40|215] "��C" Vector__XXX
 SG_ Tyre_Pressure_FL : 56|8@0+ (0.025,0) [0|6.375] "bar" Vector__XXX
