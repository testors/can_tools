VERSION ""

NS_ :

BS_: 500

BU_: Vector__XXX

BO_ 131 MSG_083: 8 Vector__XXX
 SG_ Engine_Speed : 0|16@1+ (0.25,0) [0|10000] "rpm" Vector__XXX
 SG_ Brake_Position : 16|16@1+ (5.382131324e-05,2260) [0|1] "" Vector__XXX

BO_ 132 MSG_084: 8 Vector__XXX
 SG_ Throttle_Position : 16|8@1+ (0.51282,4) [0|100] "" Vector__XXX
 SG_ Indicated_Vehicle_Speed_kph : 40|8@1+ (1,0) [0|400] "km/h" Vector__XXX
 SG_ Indicated_Vehicle_Speed_mph : 40|8@1+ (0.621,0) [0|248.4] "mph" Vector__XXX

BO_ 164 MSG_0A4: 8 Vector__XXX
 SG_ Gear : 0|8@1+ (0.0625,0) [0|112] "" Vector__XXX
