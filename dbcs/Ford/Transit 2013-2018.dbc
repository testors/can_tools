VERSION ""

NS_ :

BS_: 500

BU_: Vector__XXX

BO_ 16 MSG_010: 8 Vector__XXX
 SG_ Steering_Angle : 0|15@0+ (0.044,0) [0|32767] "��" Vector__XXX

BO_ 273 MSG_111: 8 Vector__XXX
 SG_ Gear_Switch : 13|3@0+ (1,0) [0|7] "" Vector__XXX
 SG_ Gear : 43|5@0+ (1,0) [0|31] "" Vector__XXX

BO_ 277 MSG_115: 8 Vector__XXX
 SG_ Engine_Speed : 0|16@0+ (2,0) [0|10000] "rpm" Vector__XXX

BO_ 290 MSG_122: 8 Vector__XXX
 SG_ Accelerator_Pedal_Position : 32|10@0+ (0.1,0) [0|100] "%" Vector__XXX

BO_ 529 MSG_211: 8 Vector__XXX
 SG_ Brake_Position : 40|13@0+ (0.015,0) [0|100] "%" Vector__XXX
