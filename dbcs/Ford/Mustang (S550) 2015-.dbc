VERSION ""

NS_ :

BS_: 500

BU_: Vector__XXX

BO_ 125 MSG_07D: 8 Vector__XXX
 SG_ Brake_Position : 48|16@0+ (0.02,0) [0|100] "%" Vector__XXX

BO_ 133 MSG_085: 8 Vector__XXX
 SG_ Steering_Angle : 48|16@0+ (0.1,-3200) [-3200|3353.3] "" Vector__XXX

BO_ 342 MSG_156: 8 Vector__XXX
 SG_ Coolant_Temperature : 56|8@0+ (1,-60) [-60|195] "��C" Vector__XXX

BO_ 357 MSG_165: 8 Vector__XXX
 SG_ Brake_Light : 61|1@0+ (1,0) [0|0] "" Vector__XXX

BO_ 369 MSG_171: 8 Vector__XXX
 SG_ Gear___Manual : 60|4@0+ (1,0) [0|0] "" Vector__XXX

BO_ 516 MSG_204: 8 Vector__XXX
 SG_ Engine_Speed : 24|13@0+ (2,0) [0|10000] "rpm" Vector__XXX
 SG_ Throttle_Position : 48|10@0+ (0.1,0) [0|102.3] "%" Vector__XXX

BO_ 535 MSG_217: 8 Vector__XXX
 SG_ Wheel_Speed_RR_kph : 0|15@0+ (0.01,0) [0|327.65] "km/h" Vector__XXX
 SG_ Wheel_Speed_RR_mph : 0|15@0+ (0.00621,0) [0|203.47065] "mph" Vector__XXX
 SG_ Wheel_Speed_RL_kph : 16|15@0+ (0.01,0) [0|327.65] "km/h" Vector__XXX
 SG_ Wheel_Speed_RL_mph : 16|15@0+ (0.00621,0) [0|203.47065] "mph" Vector__XXX
 SG_ Wheel_Speed_FR_kph : 32|15@0+ (0.01,0) [0|327.65] "km/h" Vector__XXX
 SG_ Wheel_Speed_FR_mph : 32|15@0+ (0.00621,0) [0|203.47065] "mph" Vector__XXX
 SG_ Wheel_Speed_FL_kph : 48|15@0+ (0.01,0) [0|327.65] "km/h" Vector__XXX
 SG_ Wheel_Speed_FL_mph : 48|15@0+ (0.00621,0) [0|203.47065] "mph" Vector__XXX

BO_ 560 MSG_230: 8 Vector__XXX
 SG_ Gearbox_Oil_Temperature : 24|8@0+ (1,-60) [-60|193] "��C" Vector__XXX
 SG_ Gear___Automatic : 49|4@0+ (1,0) [0|0] "" Vector__XXX

BO_ 949 MSG_3B5: 8 Vector__XXX
 SG_ Tyre_Pressure_FR : 32|16@0+ (1,0) [0|65533] "" Vector__XXX
 SG_ Tyre_Pressure_FL : 48|16@0+ (1,0) [0|65533] "" Vector__XXX

BO_ 952 MSG_3B8: 8 Vector__XXX
 SG_ Tyre_Pressure_RR : 32|16@0+ (1,0) [0|65533] "" Vector__XXX
 SG_ Tyre_Pressure_RL : 48|16@0+ (1,0) [0|65533] "" Vector__XXX

BO_ 963 MSG_3C3: 8 Vector__XXX
 SG_ Handbrake : 44|1@0+ (1,0) [0|1] "" Vector__XXX

BO_ 1046 MSG_416: 8 Vector__XXX
 SG_ Traction_Control_Mode : 55|1@0+ (1,0) [0|1] "" Vector__XXX

BO_ 1069 MSG_42D: 8 Vector__XXX
 SG_ Intake_Air_Temperature : 40|10@0+ (0.25,-128) [-128|127.25] "��C" Vector__XXX

BO_ 1071 MSG_42F: 8 Vector__XXX
 SG_ Clutch_Position : 48|2@0+ (1,0) [0|4] "" Vector__XXX

BO_ 1072 MSG_430: 8 Vector__XXX
 SG_ Air_Temperature : 24|8@0+ (0.5,-40) [-40|86.5] "��C" Vector__XXX
 SG_ Odometer_Reading : 32|24@0+ (1,0) [0|16777214] "" Vector__XXX

BO_ 1077 MSG_435: 8 Vector__XXX
 SG_ Fuel_Level : 24|10@0+ (0.108696,-5.21741) [-5.217408|105.9786] "%" Vector__XXX
