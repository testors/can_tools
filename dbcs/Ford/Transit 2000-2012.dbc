VERSION ""

NS_ :

BS_: 500

BU_: Vector__XXX

BO_ 246 MSG_0F6: 8 Vector__XXX
 SG_ Engine_Speed : 16|13@0+ (1,0) [0|10000] "rpm" Vector__XXX

BO_ 297 MSG_129: 8 Vector__XXX
 SG_ Throttle_Position : 0|10@0+ (0.1,0) [0|0] "" Vector__XXX

BO_ 906 MSG_38A: 8 Vector__XXX
 SG_ Wheel_Speed_2_kph : 0|16@0+ (0.006215,0) [0|0] "km/h" Vector__XXX
 SG_ Wheel_Speed_2_mph : 0|16@0+ (0.003859515,0) [0|0] "mph" Vector__XXX
 SG_ Wheel_Speed_1_kph : 16|16@0+ (0.006215,0) [0|0] "km/h" Vector__XXX
 SG_ Wheel_Speed_1_mph : 16|16@0+ (0.003859515,0) [0|0] "mph" Vector__XXX

BO_ 907 MSG_38B: 8 Vector__XXX
 SG_ Wheel_Speed_4_kph : 0|16@0+ (0.006215,0) [0|0] "km/h" Vector__XXX
 SG_ Wheel_Speed_4_mph : 0|16@0+ (0.003859515,0) [0|0] "mph" Vector__XXX
 SG_ Wheel_Speed_3_kph : 16|16@0+ (0.006215,0) [0|0] "km/h" Vector__XXX
 SG_ Wheel_Speed_3_mph : 16|16@0+ (0.003859515,0) [0|0] "mph" Vector__XXX
