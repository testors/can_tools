VERSION ""

NS_ :

BS_: 500

BU_: Vector__XXX

BO_ 119 MSG_077: 8 Vector__XXX
 SG_ Indicated_Longitudinal_Acceleration : 0|10@0+ (0.035,-17.9) [-17.9|17.835] "m/s��" Vector__XXX
 SG_ Indicated_Lateral_Acceleration : 10|10@0+ (0.035,-17.9) [-17.9|17.835] "m/s��" Vector__XXX
 SG_ Yaw_Rate : 32|12@0+ (0.03663,-75) [-75|74.92659] "" Vector__XXX
 SG_ Indicated_Vehicle_Speed : 48|16@0+ (0.01,0) [0|655.33] "" Vector__XXX

BO_ 126 MSG_07E: 8 Vector__XXX
 SG_ Steering_Angle : 48|16@0+ (-0.1,3200) [0|65535] "��" Vector__XXX

BO_ 369 MSG_171: 8 Vector__XXX
 SG_ Gear : 60|4@0+ (1,0) [0|15] "" Vector__XXX

BO_ 376 MSG_178: 8 Vector__XXX
 SG_ Barometric_Pressure : 10|6@0+ (10,500) [500|1110] "mbar" Vector__XXX
 SG_ Air_Temperature : 16|10@0+ (0.25,-128) [-128|127.75] "��C" Vector__XXX

BO_ 516 MSG_204: 8 Vector__XXX
 SG_ Engine_Speed : 24|13@0+ (2,0) [0|16382] "rpm" Vector__XXX
 SG_ Accelerator_Pedal_Position : 48|10@0+ (0.1,0) [0|102.3] "%" Vector__XXX

BO_ 535 MSG_217: 8 Vector__XXX
 SG_ Wheel_Speed_RR_kph : 0|16@0+ (0.01428,0) [0|65535] "km/h" Vector__XXX
 SG_ Wheel_Speed_RR_mph : 0|16@0+ (0.00886788,0) [0|40697.235] "mph" Vector__XXX
 SG_ Wheel_Speed_RL_kph : 16|16@0+ (0.01428,0) [0|65535] "km/h" Vector__XXX
 SG_ Wheel_Speed_RL_mph : 16|16@0+ (0.00886788,0) [0|40697.235] "mph" Vector__XXX
 SG_ Wheel_Speed_FR_kph : 32|16@0+ (0.01428,0) [0|65535] "km/h" Vector__XXX
 SG_ Wheel_Speed_FR_mph : 32|16@0+ (0.00886788,0) [0|40697.235] "mph" Vector__XXX
 SG_ Wheel_Speed_FL_kph : 48|16@0+ (0.01428,0) [0|65535] "km/h" Vector__XXX
 SG_ Wheel_Speed_FL_mph : 48|16@0+ (0.00886788,0) [0|40697.235] "mph" Vector__XXX

BO_ 560 MSG_230: 8 Vector__XXX
 SG_ Gear_Switch : 49|4@0+ (1,0) [0|15] "" Vector__XXX

BO_ 949 MSG_3B5: 8 Vector__XXX
 SG_ Tyre_Pressure_RL : 0|16@0+ (1,0) [0|65533] "kPa" Vector__XXX
 SG_ Tyre_Pressure_RR : 16|16@0+ (1,0) [0|65533] "kPa" Vector__XXX
 SG_ Tyre_Pressure_FR : 32|16@0+ (1,0) [0|65533] "kPa" Vector__XXX
 SG_ Tyre_Pressure_FL : 48|16@0+ (1,0) [0|65533] "kPa" Vector__XXX

BO_ 1069 MSG_42D: 8 Vector__XXX
 SG_ Intake_Air_Temperature : 40|10@0+ (0.25,-128) [-128|127.25] "��C" Vector__XXX

BO_ 1072 MSG_430: 8 Vector__XXX
 SG_ Odometer_Reading : 32|24@0+ (1,0) [0|16777214] "km" Vector__XXX

BO_ 1077 MSG_435: 8 Vector__XXX
 SG_ Fuel_Level : 24|10@0+ (0.108696,-5.21741) [-5.217408|105.9786] "%" Vector__XXX

BO_ 1086 MSG_43E: 8 Vector__XXX
 SG_ Boost_Pressure : 11|13@0+ (0.1,-206.8) [-206.8|612.3] "" Vector__XXX
