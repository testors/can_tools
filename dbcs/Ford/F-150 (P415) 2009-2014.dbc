VERSION ""

NS_ :

BS_: 500

BU_: Vector__XXX

BO_ 119 MSG_077: 8 Vector__XXX
 SG_ Battery_Voltage : 40|8@0+ (1,180) [180|434] "V" Vector__XXX

BO_ 124 MSG_07C: 8 Vector__XXX
 SG_ Brake_Position : 48|16@0+ (0.005,0) [0|65535] "%" Vector__XXX

BO_ 128 MSG_080: 8 Vector__XXX
 SG_ Steering_Angle : 49|15@0+ (0.1,-1000) [-1000|1000] "��" Vector__XXX

BO_ 145 MSG_091: 8 Vector__XXX
 SG_ Indicated_Longitudinal_Acceleration : 0|12@0+ (0.01,-20) [-20|20] "m/s��" Vector__XXX
 SG_ Indicated_Lateral_Acceleration : 16|12@0+ (0.01,-20) [-20|20] "m/s��" Vector__XXX
 SG_ Yaw_Rate : 48|12@0+ (0.1,-180) [-180|180] "��/s" Vector__XXX

BO_ 340 MSG_154: 8 Vector__XXX
 SG_ Boost_Pressure : 48|10@0+ (0.1,-30) [-30|72.2] "psi" Vector__XXX

BO_ 384 MSG_180: 8 Vector__XXX
 SG_ Engine_Speed : 48|16@0+ (0.25,0) [0|10000] "rpm" Vector__XXX

BO_ 513 MSG_201: 8 Vector__XXX
 SG_ Throttle_Position : 8|8@0+ (0.5,0) [0|100] "%" Vector__XXX
 SG_ Indicated_Vehicle_Speed_kph : 16|16@0+ (0.01,-100) [-100|555.33] "km/h" Vector__XXX
 SG_ Indicated_Vehicle_Speed_mph : 16|16@0+ (0.00621,-100) [-62.1|344.85993] "mph" Vector__XXX

BO_ 533 MSG_215: 8 Vector__XXX
 SG_ Wheel_Speed_RR_kph : 0|16@0+ (0.01,-100) [-100|300] "km/h" Vector__XXX
 SG_ Wheel_Speed_RR_mph : 0|16@0+ (0.00621,-100) [-62.1|186.3] "mph" Vector__XXX
 SG_ Wheel_Speed_RL_kph : 16|16@0+ (0.01,-100) [-100|300] "km/h" Vector__XXX
 SG_ Wheel_Speed_RL_mph : 16|16@0+ (0.00621,-100) [-62.1|186.3] "mph" Vector__XXX
 SG_ Wheel_Speed_FR_kph : 32|16@0+ (0.01,-100) [-100|300] "km/h" Vector__XXX
 SG_ Wheel_Speed_FR_mph : 32|16@0+ (0.00621,-100) [-62.1|186.3] "mph" Vector__XXX
 SG_ Wheel_Speed_FL_kph : 48|16@0+ (0.01,-100) [-100|300] "km/h" Vector__XXX
 SG_ Wheel_Speed_FL_mph : 48|16@0+ (0.00621,-100) [-62.1|186.3] "mph" Vector__XXX

BO_ 1056 MSG_420: 8 Vector__XXX
 SG_ Coolant_Temperature : 56|8@0+ (1,-40) [-40|213] "��C" Vector__XXX
