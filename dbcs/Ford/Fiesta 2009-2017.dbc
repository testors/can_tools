VERSION ""

NS_ :

BS_: 500

BU_: Vector__XXX

BO_ 115 MSG_073: 8 Vector__XXX
 SG_ Indicated_Longitudinal_Acceleration : 17|15@0+ (0.0010197,-3.06) [-3|3] "g" Vector__XXX
 SG_ Indicated_Lateral_Acceleration : 33|15@0+ (0.0010197,-3.06) [-3|3] "g" Vector__XXX
 SG_ Yaw_Rate : 49|15@0+ (0.1,-360) [-360|360] "��/s" Vector__XXX

BO_ 128 MSG_080: 8 Vector__XXX
 SG_ Steering_Angle : 48|16@0+ (-0.1,1000) [-1000|1000] "��" Vector__XXX

BO_ 253 MSG_0FD: 8 Vector__XXX
 SG_ Air_Temperature : 40|10@0+ (0.25,-128) [-100|100] "��C" Vector__XXX

BO_ 400 MSG_190: 8 Vector__XXX
 SG_ Clutch_Position : 44|1@0+ (1,0) [0|0] "on/off" Vector__XXX
 SG_ Brake_Position : 46|1@0+ (1,0) [0|0] "%" Vector__XXX

BO_ 513 MSG_201: 8 Vector__XXX
 SG_ Accelerator_Pedal_Position : 8|8@0+ (0.5,0) [0|255] "%" Vector__XXX
 SG_ Indicated_Vehicle_Speed_kph : 16|15@0+ (0.01,0) [0|327] "km/h" Vector__XXX
 SG_ Indicated_Vehicle_Speed_mph : 16|15@0+ (0.00621,0) [0|203.067] "mph" Vector__XXX
 SG_ Engine_Speed : 48|16@0+ (1,0) [0|9000] "rpm" Vector__XXX

BO_ 527 MSG_20F: 8 Vector__XXX
 SG_ Brake_Pressure : 48|16@0+ (0.01,-300) [-300|300] "bar" Vector__XXX

BO_ 1001 MSG_3E9: 8 Vector__XXX
 SG_ Gear_Requested : 48|4@0+ (1,0) [0|15] "" Vector__XXX

BO_ 1056 MSG_420: 8 Vector__XXX
 SG_ Coolant_Temperature : 56|8@0+ (1,-40) [-40|215] "��C" Vector__XXX

BO_ 1064 MSG_428: 8 Vector__XXX
 SG_ Battery_Voltage : 48|8@0+ (0.1,0) [0|25.5] "V" Vector__XXX

BO_ 1075 MSG_433: 8 Vector__XXX
 SG_ Handbrake : 32|1@0+ (1,0) [0|0] "" Vector__XXX

BO_ 1200 MSG_4B0: 8 Vector__XXX
 SG_ Wheel_Speed_RR_kph : 0|16@0+ (0.01,-100) [0|300] "km/h" Vector__XXX
 SG_ Wheel_Speed_RR_mph : 0|16@0+ (0.00621,-100) [0|186.3] "mph" Vector__XXX
 SG_ Wheel_Speed_RL_kph : 16|16@0+ (0.01,-100) [0|300] "km/h" Vector__XXX
 SG_ Wheel_Speed_RL_mph : 16|16@0+ (0.00621,-100) [0|186.3] "mph" Vector__XXX
 SG_ Wheel_Speed_FR_kph : 32|16@0+ (0.01,-100) [0|300] "km/h" Vector__XXX
 SG_ Wheel_Speed_FR_mph : 32|16@0+ (0.00621,-100) [0|186.3] "mph" Vector__XXX
 SG_ Wheel_Speed_FL_kph : 48|16@0+ (0.01,-100) [0|300] "km/h" Vector__XXX
 SG_ Wheel_Speed_FL_mph : 48|16@0+ (0.00621,-100) [0|186.3] "mph" Vector__XXX
