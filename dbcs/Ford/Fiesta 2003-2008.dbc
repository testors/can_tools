VERSION ""

NS_ :

BS_: 500

BU_: Vector__XXX

BO_ 513 MSG_201: 8 Vector__XXX
 SG_ Accelerator_Pedal_Position : 8|8@0+ (0.5,0) [-127|127] "" Vector__XXX
 SG_ Indicated_Vehicle_Speed_kph : 16|16@0+ (0.01,-100) [-32767|32767] "km/h" Vector__XXX
 SG_ Indicated_Vehicle_Speed_mph : 16|16@0+ (0.00621,-100) [-20348.307|20348.307] "mph" Vector__XXX
 SG_ Engine_Speed : 48|16@0+ (0.244,0) [-32767|32767] "rpm" Vector__XXX

BO_ 1200 MSG_4B0: 8 Vector__XXX
 SG_ Wheel_Speed_RR_kph : 0|16@0+ (0.01,-100) [-32767|32767] "km/h" Vector__XXX
 SG_ Wheel_Speed_RR_mph : 0|16@0+ (0.00621,-100) [-20348.307|20348.307] "mph" Vector__XXX
 SG_ Wheel_Speed_RL_kph : 16|16@0+ (0.01,-100) [-32767|32767] "km/h" Vector__XXX
 SG_ Wheel_Speed_RL_mph : 16|16@0+ (0.00621,-100) [-20348.307|20348.307] "mph" Vector__XXX
 SG_ Wheel_Speed_FR_kph : 32|16@0+ (0.01,-100) [-32767|32767] "km/h" Vector__XXX
 SG_ Wheel_Speed_FR_mph : 32|16@0+ (0.00621,-100) [-20348.307|20348.307] "mph" Vector__XXX
 SG_ Wheel_Speed_FL_kph : 48|16@0+ (0.01,-100) [-32767|32767] "km/h" Vector__XXX
 SG_ Wheel_Speed_FL_mph : 48|16@0+ (0.00621,-100) [-20348.307|20348.307] "mph" Vector__XXX
