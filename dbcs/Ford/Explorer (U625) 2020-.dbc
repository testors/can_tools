VERSION ""

NS_ :

BS_: 500

BU_: Vector__XXX

BO_ 119 MSG_077: 8 Vector__XXX
 SG_ Indicated_Longitudinal_Acceleration : 0|10@0+ (0.035,-17.9) [-17.9|17.835] "m/s��" Vector__XXX
 SG_ Indicated_Lateral_Acceleration : 10|10@0+ (0.035,-17.9) [-17.9|17.835] "m/s��" Vector__XXX
 SG_ Yaw_Rate : 32|12@0+ (0.03663,-75) [-75|74.92659] "rad/s" Vector__XXX
 SG_ Indicated_Vehicle_Speed_kph : 48|16@0+ (0.01,0) [0|655.33] "km/h" Vector__XXX
 SG_ Indicated_Vehicle_Speed_mph : 48|16@0+ (0.00621,0) [0|406.95993] "mph" Vector__XXX

BO_ 125 MSG_07D: 8 Vector__XXX
 SG_ Brake_Position : 23|13@0+ (4,0) [0|32756] "" Vector__XXX

BO_ 133 MSG_085: 8 Vector__XXX
 SG_ Steering_Angle : 48|16@0+ (-0.1,3200) [0|65535] "��" Vector__XXX

BO_ 357 MSG_165: 8 Vector__XXX
 SG_ Brake_Light : 61|1@0+ (1,0) [0|0] "on/off" Vector__XXX

BO_ 376 MSG_178: 8 Vector__XXX
 SG_ Air_Temperature : 16|10@0+ (0.25,-128) [-128|127.75] "��C" Vector__XXX

BO_ 516 MSG_204: 8 Vector__XXX
 SG_ Engine_Speed : 24|16@0+ (2,0) [0|8000] "rpm" Vector__XXX
 SG_ Accelerator_Pedal_Position : 48|10@0+ (0.1,0) [0|1000] "%" Vector__XXX

BO_ 535 MSG_217: 8 Vector__XXX
 SG_ Wheel_Speed_RR_kph : 0|16@0+ (0.01428,0) [0|65535] "km/h" Vector__XXX
 SG_ Wheel_Speed_RR_mph : 0|16@0+ (0.00886788,0) [0|40697.235] "mph" Vector__XXX
 SG_ Wheel_Speed_RL_kph : 16|16@0+ (0.01428,0) [0|65535] "km/h" Vector__XXX
 SG_ Wheel_Speed_RL_mph : 16|16@0+ (0.00886788,0) [0|40697.235] "mph" Vector__XXX
 SG_ Wheel_Speed_FR_kph : 32|16@0+ (0.01428,0) [0|65535] "km/h" Vector__XXX
 SG_ Wheel_Speed_FR_mph : 32|16@0+ (0.00886788,0) [0|40697.235] "mph" Vector__XXX
 SG_ Wheel_Speed_FL_kph : 48|16@0+ (0.01428,0) [0|65535] "km/h" Vector__XXX
 SG_ Wheel_Speed_FL_mph : 48|16@0+ (0.00886788,0) [0|40697.235] "mph" Vector__XXX

BO_ 560 MSG_230: 8 Vector__XXX
 SG_ Gear_Switch : 49|3@0+ (1,0) [0|7] "" Vector__XXX
