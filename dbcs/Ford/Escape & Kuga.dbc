VERSION ""

NS_ :

BS_: 500

BU_: Vector__XXX

BO_ 16 MSG_010: 8 Vector__XXX
 SG_ Steering_Angle : 0|15@0+ (0.044,0) [0|520] "��" Vector__XXX
 SG_ Steering_Direction : 31|1@0+ (1,0) [0|1] "" Vector__XXX

BO_ 128 MSG_080: 2 Vector__XXX
 SG_ Accelerator_Pedal_Position : 48|10@0+ (0.1,0) [0|100] "%" Vector__XXX
 SG_ Brake_Light : 58|1@0+ (1,0) [0|0] "on/off" Vector__XXX

BO_ 144 MSG_090: 6 Vector__XXX
 SG_ Engine_Speed : 16|12@0+ (2,0) [0|8000] "rpm" Vector__XXX

BO_ 200 MSG_0C8: 4 Vector__XXX
 SG_ Handbrake : 38|1@0+ (1,0) [0|0] "" Vector__XXX

BO_ 224 MSG_0E0: 5 Vector__XXX
 SG_ Gear_Requested : 27|5@0+ (1,0) [0|31] "" Vector__XXX
 SG_ Gear : 59|5@0+ (1,0) [0|31] "" Vector__XXX

BO_ 400 MSG_190: 8 Vector__XXX
 SG_ Wheel_Speed_RR_kph : 0|15@0+ (0.0125,0) [0|300] "km/h" Vector__XXX
 SG_ Wheel_Speed_RR_mph : 0|15@0+ (0.0077625,0) [0|186.3] "mph" Vector__XXX
 SG_ Wheel_Speed_RL_kph : 16|15@0+ (0.0125,0) [0|300] "km/h" Vector__XXX
 SG_ Wheel_Speed_RL_mph : 16|15@0+ (0.0077625,0) [0|186.3] "mph" Vector__XXX
 SG_ Wheel_Speed_FR_kph : 32|15@0+ (0.0125,0) [0|300] "km/h" Vector__XXX
 SG_ Wheel_Speed_FR_mph : 32|15@0+ (0.0077625,0) [0|186.3] "mph" Vector__XXX
 SG_ Wheel_Speed_FL_kph : 48|15@0+ (0.0125,0) [0|300] "km/h" Vector__XXX
 SG_ Wheel_Speed_FL_mph : 48|15@0+ (0.0077625,0) [0|186.3] "mph" Vector__XXX

BO_ 448 MSG_1C0: 8 Vector__XXX
 SG_ Brake_Position : 0|16@0+ (0.03,0) [0|100] "%" Vector__XXX

BO_ 784 MSG_310: 4 Vector__XXX
 SG_ Wiper_Trigger : 36|1@0+ (1,0) [0|1] "on/off" Vector__XXX
