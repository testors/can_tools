VERSION ""

NS_ :

BS_: 500

BU_: Vector__XXX

BO_ 118 MSG_076: 8 Vector__XXX
 SG_ Steering_Angle : 0|15@0+ (0.04395067757,0) [-720|720] "��" Vector__XXX

BO_ 253 MSG_0FD: 8 Vector__XXX
 SG_ Throttle_Position : 16|10@0+ (0.1,0) [-127|127] "%" Vector__XXX

BO_ 320 MSG_140: 8 Vector__XXX
 SG_ Engine_Speed : 0|12@0+ (1,0) [0|10000] "rpm" Vector__XXX

BO_ 554 MSG_22A: 8 Vector__XXX
 SG_ Wheel_Speed_2_kph : 16|15@0+ (0.01,0) [-32767|32767] "km/h" Vector__XXX
 SG_ Wheel_Speed_2_mph : 16|15@0+ (0.00621,0) [-20348.307|20348.307] "mph" Vector__XXX
 SG_ Wheel_Speed_1_kph : 32|15@0+ (0.01,0) [-32767|32767] "km/h" Vector__XXX
 SG_ Wheel_Speed_1_mph : 32|15@0+ (0.00621,0) [-20348.307|20348.307] "mph" Vector__XXX

BO_ 572 MSG_23C: 8 Vector__XXX
 SG_ Wheel_Speed_4_kph : 24|15@0+ (0.01,0) [-32767|32767] "km/h" Vector__XXX
 SG_ Wheel_Speed_4_mph : 24|15@0+ (0.00621,0) [-20348.307|20348.307] "mph" Vector__XXX
 SG_ Wheel_Speed_3_kph : 40|15@0+ (0.01,0) [-32767|32767] "km/h" Vector__XXX
 SG_ Wheel_Speed_3_mph : 40|15@0+ (0.00621,0) [-20348.307|20348.307] "mph" Vector__XXX
