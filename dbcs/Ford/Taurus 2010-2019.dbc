VERSION ""

NS_ :

BS_: 500

BU_: Vector__XXX

BO_ 117 MSG_075: 8 Vector__XXX
 SG_ Yaw_Rate : 52|12@0+ (0.03663,-75) [-75|74.92659] "��/s" Vector__XXX

BO_ 124 MSG_07C: 8 Vector__XXX
 SG_ Brake_Position : 48|16@0+ (0.003125,0) [0|100] "%" Vector__XXX

BO_ 132 MSG_084: 8 Vector__XXX
 SG_ Steering_Angle : 48|16@0+ (-0.05,1600) [-720|720] "��" Vector__XXX
 SG_ Steering_Angle : 48|16@0+ (-0.05,1600) [-720|720] "��" Vector__XXX

BO_ 340 MSG_154: 8 Vector__XXX
 SG_ Air_Temperature : 16|10@0+ (0.25,-128) [-128|-127.75] "��C" Vector__XXX

BO_ 342 MSG_156: 8 Vector__XXX
 SG_ Oil_Temperature : 48|8@0+ (1,-60) [-60|193] "��C" Vector__XXX
 SG_ Coolant_Temperature : 56|8@0+ (1,-60) [-60|195] "��C" Vector__XXX

BO_ 513 MSG_201: 8 Vector__XXX
 SG_ Accelerator_Pedal_Position : 22|10@0+ (0.1,0) [0|100] "%" Vector__XXX
 SG_ Accelerator_Pedal_Position : 22|10@0+ (0.1,0) [0|100] "%" Vector__XXX
 SG_ Engine_Speed : 48|16@0+ (0.25,0) [0|10000] "rpm" Vector__XXX
 SG_ Engine_Speed : 48|16@0+ (0.25,0) [0|10000] "rpm" Vector__XXX

BO_ 529 MSG_211: 8 Vector__XXX
 SG_ ABS_Intervention : 11|1@0+ (1,0) [0|1] "on/off" Vector__XXX

BO_ 533 MSG_215: 8 Vector__XXX
 SG_ Wheel_Speed_1_kph : 48|16@0+ (0.0625,0) [0|65535] "km/h" Vector__XXX
 SG_ Wheel_Speed_1_mph : 48|16@0+ (0.0388125,0) [0|40697.235] "mph" Vector__XXX

BO_ 560 MSG_230: 8 Vector__XXX
 SG_ Gear : 44|4@0+ (1,0) [0|15] "" Vector__XXX
 SG_ Gear_Switch : 44|4@0+ (1,0) [0|15] "" Vector__XXX
 SG_ Gear : 60|4@0+ (1,0) [0|15] "" Vector__XXX

BO_ 949 MSG_3B5: 8 Vector__XXX
 SG_ Tyre_Pressure_RL : 32|8@0+ (1,0) [0|252] "psi" Vector__XXX
 SG_ Tyre_Pressure_RR : 40|8@0+ (1,0) [0|252] "psi" Vector__XXX
 SG_ Tyre_Pressure_FR : 48|8@0+ (1,0) [0|252] "psi" Vector__XXX
 SG_ Tyre_Pressure_FL : 56|8@0+ (1,0) [0|252] "psi" Vector__XXX

BO_ 963 MSG_3C3: 8 Vector__XXX
 SG_ Brake_Light : 47|1@0+ (1,0) [0|1] "on/off" Vector__XXX

BO_ 1072 MSG_430: 8 Vector__XXX
 SG_ Odometer_Reading : 16|24@0+ (1,0) [0|16777214] "" Vector__XXX

BO_ 1075 MSG_433: 8 Vector__XXX
 SG_ Fuel_Level : 54|10@0+ (0.108696,-5.21741) [-5.217408|105.9786] "%" Vector__XXX
