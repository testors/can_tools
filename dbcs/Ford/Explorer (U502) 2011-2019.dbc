VERSION ""

NS_ :

BS_: 500

BU_: Vector__XXX

BO_ 125 MSG_07D: 8 Vector__XXX
 SG_ Brake_Position : 48|16@0+ (0.02,0) [0|100] "%" Vector__XXX

BO_ 133 MSG_085: 8 Vector__XXX
 SG_ Steering_Angle : 48|16@0+ (-0.1,3200) [-720|720] "��" Vector__XXX

BO_ 513 MSG_201: 8 Vector__XXX
 SG_ Accelerator_Pedal_Position : 22|10@0+ (0.1,0) [0|100] "%" Vector__XXX

BO_ 516 MSG_204: 8 Vector__XXX
 SG_ Engine_Speed : 24|16@0+ (2,0) [0|10000] "rpm" Vector__XXX
 SG_ Accelerator_Pedal_Position : 48|14@0+ (0.1,0) [0|100] "%" Vector__XXX

BO_ 535 MSG_217: 8 Vector__XXX
 SG_ Wheel_Speed_RR_kph : 0|16@0+ (0.012,0) [0|500] "km/h" Vector__XXX
 SG_ Wheel_Speed_RR_mph : 0|16@0+ (0.007452,0) [0|310.5] "mph" Vector__XXX
 SG_ Wheel_Speed_RL_kph : 16|16@0+ (0.012,0) [0|500] "km/h" Vector__XXX
 SG_ Wheel_Speed_RL_mph : 16|16@0+ (0.007452,0) [0|310.5] "mph" Vector__XXX
 SG_ Wheel_Speed_FR_kph : 32|16@0+ (0.012,0) [0|500] "km/h" Vector__XXX
 SG_ Wheel_Speed_FR_mph : 32|16@0+ (0.007452,0) [0|310.5] "mph" Vector__XXX
 SG_ Wheel_Speed_FL_kph : 48|16@0+ (0.012,0) [0|500] "km/h" Vector__XXX
 SG_ Wheel_Speed_FL_mph : 48|16@0+ (0.007452,0) [0|310.5] "mph" Vector__XXX
