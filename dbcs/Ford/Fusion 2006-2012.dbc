VERSION ""

NS_ :

BS_: 500

BU_: Vector__XXX

BO_ 115 MSG_073: 8 Vector__XXX
 SG_ Indicated_Longitudinal_Acceleration : 17|15@0+ (0.0010197,-3.06) [-3|3] "g" Vector__XXX
 SG_ Indicated_Lateral_Acceleration : 33|15@0+ (0.0010197,-3.06) [-3|3] "g" Vector__XXX
 SG_ Yaw_Rate : 49|15@0+ (0.1,-360) [-360|360] "��/s" Vector__XXX

BO_ 128 MSG_080: 8 Vector__XXX
 SG_ Steering_Angle : 32|16@0+ (-0.1,2000) [-540|540] "��" Vector__XXX

BO_ 512 MSG_200: 8 Vector__XXX
 SG_ Brake_Position : 8|1@0+ (1,0) [0|0] "on/off" Vector__XXX

BO_ 513 MSG_201: 8 Vector__XXX
 SG_ Accelerator_Pedal_Position : 8|8@0+ (0.5,0) [0|100] "%" Vector__XXX
 SG_ Engine_Speed : 48|16@0+ (0.25,0) [0|10000] "rpm" Vector__XXX

BO_ 533 MSG_215: 8 Vector__XXX
 SG_ Wheel_Speed_RR_kph : 0|16@0+ (0.01,-100) [0|300] "km/h" Vector__XXX
 SG_ Wheel_Speed_RR_mph : 0|16@0+ (0.00621,-100) [0|186.3] "mph" Vector__XXX
 SG_ Wheel_Speed_RL_kph : 16|16@0+ (0.01,-100) [0|300] "km/h" Vector__XXX
 SG_ Wheel_Speed_RL_mph : 16|16@0+ (0.00621,-100) [0|186.3] "mph" Vector__XXX
 SG_ Wheel_Speed_FR_kph : 32|16@0+ (0.01,-100) [0|300] "km/h" Vector__XXX
 SG_ Wheel_Speed_FR_mph : 32|16@0+ (0.00621,-100) [0|186.3] "mph" Vector__XXX
 SG_ Wheel_Speed_FL_kph : 48|16@0+ (0.01,-100) [0|300] "km/h" Vector__XXX
 SG_ Wheel_Speed_FL_mph : 48|16@0+ (0.00621,-100) [0|186.3] "mph" Vector__XXX

BO_ 560 MSG_230: 8 Vector__XXX
 SG_ Gear : 60|4@0+ (1,0) [0|15] "" Vector__XXX
