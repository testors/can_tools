VERSION ""

NS_ :

BS_: 500

BU_: Vector__XXX

BO_ 768 MSG_300: 8 Vector__XXX
 SG_ Engine_Speed : 0|8@1+ (1,0) [0|10000] "rpm" Vector__XXX
 SG_ Throttle_Position : 16|8@1+ (0.3921,0) [0|99.985] "%" Vector__XXX

BO_ 774 MSG_306: 8 Vector__XXX
 SG_ Gear : 0|8@1+ (1,0) [0|7] "" Vector__XXX

BO_ 776 MSG_308: 8 Vector__XXX
 SG_ Battery_Voltage : 48|16@0- (0.0175,0) [0|20] "V" Vector__XXX

BO_ 779 MSG_30B: 8 Vector__XXX
 SG_ Coolant_Temperature : 0|8@1+ (0.6274,-10) [-10|150] "��C" Vector__XXX
 SG_ Oil_Temperature : 8|8@1+ (0.6274,-10) [-10|150] "��C" Vector__XXX
