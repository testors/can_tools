VERSION ""

NS_ :

BS_: 500

BU_: Vector__XXX

BO_ 3 MSG_003: 8 Vector__XXX
 SG_ Steering_Angle : 48|16@0+ (0.5,-2050) [-720|720] "��" Vector__XXX

BO_ 5 MSG_005: 8 Vector__XXX
 SG_ Brake_Position : 32|12@0+ (0.0244141,0) [0|100] "%" Vector__XXX

BO_ 261 MSG_105: 8 Vector__XXX
 SG_ Accelerator_Pedal_Position : 32|8@0+ (0.4,0) [0|100] "%" Vector__XXX
 SG_ Engine_Speed : 48|16@0+ (1,0) [0|10000] "rpm" Vector__XXX
