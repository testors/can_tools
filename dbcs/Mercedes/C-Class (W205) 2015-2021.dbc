VERSION ""

NS_ :

BS_: 500

BU_: Vector__XXX

BO_ 47 MSG_02F: 8 Vector__XXX
 SG_ Steering_Angle : 16|13@1+ (0.1,0) [0|819.1] "��" Vector__XXX

BO_ 61 MSG_03D: 8 Vector__XXX
 SG_ Accelerator_Pedal_Position : 40|8@0+ (0.4,0) [0|100] "%" Vector__XXX

BO_ 135 MSG_087: 8 Vector__XXX
 SG_ Brake_Position : 16|16@1+ (0.015,0) [0|100] "%" Vector__XXX

BO_ 161 MSG_0A1: 8 Vector__XXX
 SG_ Wheel_Speed_FL_kph : 16|12@1+ (0.06125,0) [0|500] "km/h" Vector__XXX
 SG_ Wheel_Speed_FL_mph : 16|12@1+ (0.03803625,0) [0|310.5] "mph" Vector__XXX
 SG_ Wheel_Speed_RL_kph : 40|12@1+ (0.06125,0) [0|500] "km/h" Vector__XXX
 SG_ Wheel_Speed_RL_mph : 40|12@1+ (0.03803625,0) [0|310.5] "mph" Vector__XXX

BO_ 163 MSG_0A3: 8 Vector__XXX
 SG_ Wheel_Speed_FR_kph : 16|12@1+ (0.06125,0) [0|500] "km/h" Vector__XXX
 SG_ Wheel_Speed_FR_mph : 16|12@1+ (0.03803625,0) [0|310.5] "mph" Vector__XXX
 SG_ Wheel_Speed_RR_kph : 40|12@1+ (0.06125,0) [0|500] "km/h" Vector__XXX
 SG_ Wheel_Speed_RR_mph : 40|12@1+ (0.03803625,0) [0|310.5] "mph" Vector__XXX

BO_ 177 MSG_0B1: 8 Vector__XXX
 SG_ Engine_Speed : 24|16@1+ (1,0) [0|65535] "rpm" Vector__XXX

BO_ 752 MSG_2F0: 8 Vector__XXX
 SG_ ACC_Distance : 37|3@0+ (1,0) [0|7] "" Vector__XXX

BO_ 766 MSG_2FE: 8 Vector__XXX
 SG_ Ignition_On : 36|1@0+ (-1,1) [0|1] "" Vector__XXX
