VERSION ""

NS_ :

BS_: 500

BU_: Vector__XXX

BO_ 512 MSG_200: 8 Vector__XXX
 SG_ Wheel_Speed_FL_kph : 16|16@0+ (1,0) [-32767|32767] "km/h" Vector__XXX
 SG_ Wheel_Speed_FL_mph : 16|16@0+ (0.621,0) [-20348.307|20348.307] "mph" Vector__XXX
 SG_ Wheel_Speed_FR_kph : 32|16@0+ (1,0) [-32767|32767] "km/h" Vector__XXX
 SG_ Wheel_Speed_FR_mph : 32|16@0+ (0.621,0) [-20348.307|20348.307] "mph" Vector__XXX

BO_ 520 MSG_208: 8 Vector__XXX
 SG_ Wheel_Speed_RL_kph : 0|16@0+ (1,0) [0|65535] "km/h" Vector__XXX
 SG_ Wheel_Speed_RL_mph : 0|16@0+ (0.621,0) [0|40697.235] "mph" Vector__XXX
 SG_ Wheel_Speed_RR_kph : 16|16@0+ (1,0) [-32767|32767] "km/h" Vector__XXX
 SG_ Wheel_Speed_RR_mph : 16|16@0+ (0.621,0) [-20348.307|20348.307] "mph" Vector__XXX
 SG_ Brake_Position : 32|12@0+ (1,0) [-2047|2047] "" Vector__XXX

BO_ 568 MSG_238: 8 Vector__XXX
 SG_ Steering_Angle : 32|11@0+ (1,0) [-1023|1023] "" Vector__XXX

BO_ 768 MSG_300: 8 Vector__XXX
 SG_ Yaw_Rate : 0|15@0+ (1,0) [-16383|16383] "" Vector__XXX

BO_ 776 MSG_308: 8 Vector__XXX
 SG_ Engine_Speed : 40|16@0+ (1,0) [0|10000] "rpm" Vector__XXX

BO_ 808 MSG_328: 8 Vector__XXX
 SG_ Indicated_Lateral_Acceleration : 40|8@0- (1,0) [0|255] "" Vector__XXX

BO_ 1544 MSG_608: 8 Vector__XXX
 SG_ Air_Temperature : 48|8@0+ (1,0) [-127|127] "" Vector__XXX
 SG_ Coolant_Temperature : 56|8@0+ (1,0) [-127|127] "" Vector__XXX
