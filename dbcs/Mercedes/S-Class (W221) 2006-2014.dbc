VERSION ""

NS_ :

BS_: 500

BU_: Vector__XXX

BO_ 3 MSG_003: 8 Vector__XXX
 SG_ Steering_Angle : 48|16@0+ (0.5,-4096) [-360|360] "��" Vector__XXX

BO_ 243 MSG_0F3: 8 Vector__XXX
 SG_ Gear : 60|4@0+ (1,0) [0|15] "" Vector__XXX

BO_ 261 MSG_105: 8 Vector__XXX
 SG_ Throttle_Position : 24|8@0+ (1,0) [0|250] "" Vector__XXX
 SG_ Engine_Speed : 48|14@0+ (1,0) [0|10000] "rpm" Vector__XXX

BO_ 515 MSG_203: 8 Vector__XXX
 SG_ Wheel_Speed_RR_kph : 0|14@0+ (0.06734,0) [0|0] "km/h" Vector__XXX
 SG_ Wheel_Speed_RR_mph : 0|14@0+ (0.04181814,0) [0|0] "mph" Vector__XXX
 SG_ Wheel_Speed_RL_kph : 16|14@0+ (0.06734,0) [0|0] "km/h" Vector__XXX
 SG_ Wheel_Speed_RL_mph : 16|14@0+ (0.04181814,0) [0|0] "mph" Vector__XXX
 SG_ Wheel_Speed_FR_kph : 32|14@0+ (0.06734,0) [0|0] "km/h" Vector__XXX
 SG_ Wheel_Speed_FR_mph : 32|14@0+ (0.04181814,0) [0|0] "mph" Vector__XXX
 SG_ Wheel_Speed_FL_kph : 48|14@0+ (0.06734,0) [0|0] "km/h" Vector__XXX
 SG_ Wheel_Speed_FL_mph : 48|14@0+ (0.04181814,0) [0|0] "mph" Vector__XXX
