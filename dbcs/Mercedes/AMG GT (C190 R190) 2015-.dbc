VERSION ""

NS_ :

BS_: 500

BU_: Vector__XXX

BO_ 3 MSG_003: 8 Vector__XXX
 SG_ Steering_Angle : 48|12@0- (0.5,0) [-720|720] "��" Vector__XXX

BO_ 243 MSG_0F3: 8 Vector__XXX
 SG_ Gear : 56|4@0+ (1,0) [0|15] "" Vector__XXX
 SG_ Gear_Requested : 60|4@0+ (1,0) [0|15] "" Vector__XXX

BO_ 261 MSG_105: 8 Vector__XXX
 SG_ Accelerator_Pedal_Position : 32|8@0+ (0.4,0) [0|100] "%" Vector__XXX
 SG_ Engine_Speed : 48|15@0+ (1,0) [0|10000] "rpm" Vector__XXX

BO_ 515 MSG_203: 8 Vector__XXX
 SG_ Wheel_Speed_RR_kph : 0|14@0+ (0.064,0) [0|1048.512] "km/h" Vector__XXX
 SG_ Wheel_Speed_RR_mph : 0|14@0+ (0.039744,0) [0|651.125952] "mph" Vector__XXX
 SG_ Wheel_Speed_RL_kph : 16|14@0+ (0.064,0) [0|1048.512] "km/h" Vector__XXX
 SG_ Wheel_Speed_RL_mph : 16|14@0+ (0.039744,0) [0|651.125952] "mph" Vector__XXX
 SG_ Wheel_Speed_FR_kph : 32|14@0+ (0.062,0) [0|1015.746] "km/h" Vector__XXX
 SG_ Wheel_Speed_FR_mph : 32|14@0+ (0.038502,0) [0|630.778266] "mph" Vector__XXX
 SG_ Wheel_Speed_FL_kph : 48|14@0+ (0.062,0) [0|1015.746] "km/h" Vector__XXX
 SG_ Wheel_Speed_FL_mph : 48|14@0+ (0.038502,0) [0|630.778266] "mph" Vector__XXX
