VERSION ""

NS_ :

BS_: 500

BU_: Vector__XXX

BO_ 261 MSG_105: 8 Vector__XXX
 SG_ Engine_Speed : 42|14@0+ (0.25,0) [0|10000] "rpm" Vector__XXX
