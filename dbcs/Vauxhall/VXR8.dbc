VERSION ""

NS_ :

BS_: 500

BU_: Vector__XXX

BO_ 201 MSG_0C9: 8 Vector__XXX
 SG_ Engine_Speed : 40|16@0+ (0.25,0) [0|10000] "rpm" Vector__XXX

BO_ 401 MSG_191: 8 Vector__XXX
 SG_ Throttle_Position : 8|8@0+ (0.392157,0) [0|100.000035] "%" Vector__XXX

BO_ 485 MSG_1E5: 8 Vector__XXX
 SG_ Steering_Angle : 40|16@0- (0.0625,0) [-2048|2047.9375] "��" Vector__XXX

BO_ 532 MSG_214: 4 Vector__XXX
 SG_ Brake_Pressure : 49|8@0+ (75,0) [0|19125] "kPa" Vector__XXX

BO_ 840 MSG_348: 4 Vector__XXX
 SG_ Wheel_Speed_RR_kph : 32|14@0+ (0.03125,0) [0|511.96875] "km/h" Vector__XXX
 SG_ Wheel_Speed_RR_mph : 32|14@0+ (0.01940625,0) [0|317.93259375] "mph" Vector__XXX
 SG_ Wheel_Speed_RL_kph : 48|14@0+ (0.03125,0) [0|511.96875] "km/h" Vector__XXX
 SG_ Wheel_Speed_RL_mph : 48|14@0+ (0.01940625,0) [0|317.93259375] "mph" Vector__XXX

BO_ 842 MSG_34A: 4 Vector__XXX
 SG_ Wheel_Speed_FR_kph : 32|14@0+ (0.03125,0) [0|511.96875] "km/h" Vector__XXX
 SG_ Wheel_Speed_FR_mph : 32|14@0+ (0.01940625,0) [0|317.93259375] "mph" Vector__XXX
 SG_ Wheel_Speed_FL_kph : 48|14@0+ (0.03125,0) [0|511.96875] "km/h" Vector__XXX
 SG_ Wheel_Speed_FL_mph : 48|14@0+ (0.01940625,0) [0|317.93259375] "mph" Vector__XXX

BO_ 1233 MSG_4D1: 8 Vector__XXX
 SG_ Oil_Temperature : 48|8@0+ (1,-40) [-40|215] "��C" Vector__XXX
