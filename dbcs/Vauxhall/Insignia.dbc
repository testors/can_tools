VERSION ""

NS_ :

BS_: 500

BU_: Vector__XXX

BO_ 2418843712 MSG_902CA040: 8 Vector__XXX
 SG_ Throttle_Position : 16|8@0+ (0.4,0) [0|100] "" Vector__XXX
 SG_ Engine_Speed : 32|16@0+ (0.25,0) [0|10000] "rpm" Vector__XXX

BO_ 2422964288 MSG_906B8040: 8 Vector__XXX
 SG_ Wheel_Speed_RR_kph : 0|16@0+ (0.0322,0) [0|2110.227] "km/h" Vector__XXX
 SG_ Wheel_Speed_RR_mph : 0|16@0+ (0.02,0) [0|1310.7] "mph" Vector__XXX
 SG_ Wheel_Speed_RL_kph : 16|16@0+ (0.0322,0) [0|2110.227] "km/h" Vector__XXX
 SG_ Wheel_Speed_RL_mph : 16|16@0+ (0.02,0) [0|1310.7] "mph" Vector__XXX
 SG_ Wheel_Speed_FR_kph : 32|16@0+ (0.0322,0) [0|2110.227] "km/h" Vector__XXX
 SG_ Wheel_Speed_FR_mph : 32|16@0+ (0.02,0) [0|1310.7] "mph" Vector__XXX
 SG_ Wheel_Speed_FL_kph : 48|16@0+ (0.0322,0) [0|2110.227] "km/h" Vector__XXX
 SG_ Wheel_Speed_FL_mph : 48|16@0+ (0.02,0) [0|1310.7] "mph" Vector__XXX
