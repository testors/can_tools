VERSION ""

NS_ :

BS_: 500

BU_: Vector__XXX

BO_ 2 MSG_002: 8 Vector__XXX
 SG_ Steering_Angle : 0|16@1- (-0.0625,0) [-600|600] "��" Vector__XXX

BO_ 1040 MSG_410: 8 Vector__XXX
 SG_ Accelerator_Pedal_Position : 32|8@1+ (0.3921,0) [0|100] "%" Vector__XXX
 SG_ Engine_Speed : 40|16@1+ (1,0) [0|10000] "rpm" Vector__XXX

BO_ 1056 MSG_420: 8 Vector__XXX
 SG_ Gear : 48|4@0+ (1,0) [0|15] "" Vector__XXX

BO_ 1297 MSG_511: 8 Vector__XXX
 SG_ Brake_Position : 24|8@0+ (1,0) [0|100] "%" Vector__XXX
