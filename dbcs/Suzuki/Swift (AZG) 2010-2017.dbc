VERSION ""

NS_ :

BS_: 500

BU_: Vector__XXX

BO_ 290 MSG_122: 8 Vector__XXX
 SG_ Throttle_Position : 40|16@0+ (0.0015259,0) [0|99] "%" Vector__XXX

BO_ 319 MSG_13F: 8 Vector__XXX
 SG_ Engine_Speed : 40|16@0+ (0.233744,158.606) [158.7|8000] "rpm" Vector__XXX

BO_ 431 MSG_1AF: 8 Vector__XXX
 SG_ Brake_Pressure : 8|8@0+ (1.31579,0) [0|335] "%" Vector__XXX
