VERSION ""

NS_ :

BS_: 500

BU_: Vector__XXX

BO_ 310 MSG_136: 8 Vector__XXX
 SG_ Accelerator_Pedal_Position : 24|8@0+ (0.492611,0) [0|100] "%" Vector__XXX

BO_ 344 MSG_158: 8 Vector__XXX
 SG_ Wheel_Speed_FR_kph : 16|16@0+ (0.01,0) [0|500] "km/h" Vector__XXX
 SG_ Wheel_Speed_FR_mph : 16|16@0+ (0.00621,0) [0|310.5] "mph" Vector__XXX
 SG_ Wheel_Speed_FL_kph : 48|16@0+ (0.01,0) [0|500] "km/h" Vector__XXX
 SG_ Wheel_Speed_FL_mph : 48|16@0+ (0.00621,0) [0|310.5] "mph" Vector__XXX

BO_ 346 MSG_15A: 8 Vector__XXX
 SG_ Wheel_Speed_RR_kph : 16|16@0+ (0.01,0) [0|500] "km/h" Vector__XXX
 SG_ Wheel_Speed_RR_mph : 16|16@0+ (0.00621,0) [0|310.5] "mph" Vector__XXX
 SG_ Wheel_Speed_RL_kph : 48|16@0+ (0.01,0) [0|500] "km/h" Vector__XXX
 SG_ Wheel_Speed_RL_mph : 48|16@0+ (0.00621,0) [0|310.5] "mph" Vector__XXX

BO_ 356 MSG_164: 8 Vector__XXX
 SG_ Handbrake : 58|1@0+ (1,0) [0|1] "on/off" Vector__XXX

BO_ 380 MSG_17C: 8 Vector__XXX
 SG_ Brake_Light : 24|1@0+ (1,0) [0|1] "on/off" Vector__XXX

BO_ 432 MSG_1B0: 7 Vector__XXX
 SG_ Steering_Angle : 32|16@0- (1,0) [-720|720] "��" Vector__XXX

BO_ 476 MSG_1DC: 4 Vector__XXX
 SG_ Engine_Speed : 40|16@0+ (1,0) [0|65535] "rpm" Vector__XXX
