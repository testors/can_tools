VERSION ""

NS_ :

BS_: 500

BU_: Vector__XXX

BO_ 512 MSG_200: 8 Vector__XXX
 SG_ Engine_Speed : 32|16@0+ (1,0) [0|10000] "rpm" Vector__XXX

BO_ 786 MSG_312: 8 Vector__XXX
 SG_ Throttle_Position : 0|15@0+ (0.00333,0) [0|0] "%" Vector__XXX
