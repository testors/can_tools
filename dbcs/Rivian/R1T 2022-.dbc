VERSION ""

NS_ :

BS_: 500

BU_: Vector__XXX

BO_ 64 MSG_040: 8 Vector__XXX
 SG_ Steering_Angle : 32|16@0- (-0.028,0) [-600|600] "��" Vector__XXX

BO_ 336 MSG_150: 8 Vector__XXX
 SG_ Accelerator_Pedal_Position : 30|10@0+ (0.1,0) [0|100] "%" Vector__XXX

BO_ 520 MSG_208: 8 Vector__XXX
 SG_ Brake_Position : 16|15@0- (-0.00666667,0) [-109.22|109.226666667] "%" Vector__XXX

BO_ 521 MSG_209: 8 Vector__XXX
 SG_ Wheel_Speed_FR_kph : 16|16@0+ (0.01,0) [0|655.35] "km/h" Vector__XXX
 SG_ Wheel_Speed_FR_mph : 16|16@0+ (0.00621,0) [0|406.97235] "mph" Vector__XXX
 SG_ Wheel_Speed_FL_kph : 32|16@0+ (0.01,0) [0|655.35] "km/h" Vector__XXX
 SG_ Wheel_Speed_FL_mph : 32|16@0+ (0.00621,0) [0|406.97235] "mph" Vector__XXX

BO_ 522 MSG_20A: 8 Vector__XXX
 SG_ Wheel_Speed_RR_kph : 16|16@0+ (0.01,0) [0|655.35] "km/h" Vector__XXX
 SG_ Wheel_Speed_RR_mph : 16|16@0+ (0.00621,0) [0|406.97235] "mph" Vector__XXX
 SG_ Wheel_Speed_RL_kph : 32|16@0+ (0.01,0) [0|655.35] "km/h" Vector__XXX
 SG_ Wheel_Speed_RL_mph : 32|16@0+ (0.00621,0) [0|406.97235] "mph" Vector__XXX
