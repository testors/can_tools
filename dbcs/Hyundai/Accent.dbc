VERSION ""

NS_ :

BS_: 500

BU_: Vector__XXX

BO_ 809 MSG_329: 8 Vector__XXX
 SG_ Throttle_Position : 16|8@0+ (0.472,-15) [0|100] "%" Vector__XXX

BO_ 1087 MSG_43F: 8 Vector__XXX
 SG_ Engine_Speed : 40|16@1+ (0.25,0) [0|10000] "rpm" Vector__XXX
 SG_ Gear : 56|3@0+ (1,0) [0|7] "" Vector__XXX

BO_ 1088 MSG_440: 8 Vector__XXX
 SG_ Brake_Position : 35|1@0+ (1,0) [0|0] "on/off" Vector__XXX
