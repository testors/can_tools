VERSION ""

NS_ :

BS_: 500

BU_: Vector__XXX

BO_ 771 MSG_303: 8 Vector__XXX
 SG_ Brake_Pressure___Rear : 0|16@0- (0.01,0) [0|0] "bar" Vector__XXX
 SG_ Brake_Pressure____Front : 16|16@0- (0.01,0) [0|0] "bar" Vector__XXX
 SG_ Throttle_Position : 32|16@0- (0.012207,0) [0|100] "��" Vector__XXX
 SG_ Accelerator_Pedal_Position : 48|16@0- (0.012207,0) [0|100] "%" Vector__XXX

BO_ 773 MSG_305: 8 Vector__XXX
 SG_ Boost_Pressure : 16|16@0- (1,0) [0|3000] "mbar" Vector__XXX

BO_ 775 MSG_307: 8 Vector__XXX
 SG_ Steering_Angle : 0|16@0- (0.03125,0) [-720|720] "��" Vector__XXX
 SG_ Exhaust_Temperature : 16|16@0- (0.1,0) [0|0] "��C" Vector__XXX

BO_ 776 MSG_308: 8 Vector__XXX
 SG_ Manifold_Pressure : 0|8@0- (1,0) [0|0] "mbar" Vector__XXX
 SG_ Engine_Speed : 48|16@0- (1,0) [0|0] "rpm" Vector__XXX

BO_ 784 MSG_310: 8 Vector__XXX
 SG_ Air_Fuel_Ratio : 16|16@0- (0.001,0) [0|0] "" Vector__XXX
 SG_ Gear : 32|16@0- (1,0) [0|0] "" Vector__XXX
