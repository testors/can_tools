VERSION ""

NS_ :

BS_: 500

BU_: Vector__XXX

BO_ 790 MSG_316: 8 Vector__XXX
 SG_ Engine_Speed : 16|16@1+ (0.25,0) [0|8000] "rpm" Vector__XXX

BO_ 809 MSG_329: 8 Vector__XXX
 SG_ Brake_Position : 32|1@1+ (1,0) [0|1] "on/off" Vector__XXX
 SG_ Accelerator_Pedal_Position : 56|8@1+ (0.393701,0) [0|100] "%" Vector__XXX

BO_ 1087 MSG_43F: 8 Vector__XXX
 SG_ Gear : 48|8@1+ (1,0) [0|16] "" Vector__XXX
 SG_ Gear_Switch : 48|4@1+ (1,0) [0|8] "" Vector__XXX
