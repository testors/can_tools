VERSION ""

NS_ :

BS_: 500

BU_: Vector__XXX

BO_ 160 MSG_0A0: 8 Vector__XXX
 SG_ Engine_Speed : 16|16@1+ (0.25,0) [0|8000] "rpm" Vector__XXX

BO_ 496 MSG_1F0: 4 Vector__XXX
 SG_ Steering_Angle : 16|16@1+ (-2,32740) [-720|720] "��" Vector__XXX

BO_ 809 MSG_329: 8 Vector__XXX
 SG_ Brake_Position : 33|1@1+ (1,0) [0|1] "on/off" Vector__XXX
 SG_ Accelerator_Pedal_Position : 48|8@1+ (0.390625,0) [0|100] "%" Vector__XXX
