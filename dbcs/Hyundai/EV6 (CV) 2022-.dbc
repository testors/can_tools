VERSION ""

NS_ :

BS_: 500

BU_: Vector__XXX

BO_ 54 MSG_036: 8 Vector__XXX
 SG_ Accelerator_Pedal_Position : 16|8@0+ (0.393701,0) [0|100] "%" Vector__XXX

BO_ 99 MSG_063: 8 Vector__XXX
 SG_ Brake_Position : 0|16@1+ (0.1,0) [0|100] "%" Vector__XXX

BO_ 162 MSG_0A2: 8 Vector__XXX
 SG_ Wheel_Speed_FL_kph : 0|16@1+ (0.03333,0) [0|300] "km/h" Vector__XXX
 SG_ Wheel_Speed_FL_mph : 0|16@1+ (0.02069793,0) [0|186.3] "mph" Vector__XXX
 SG_ Wheel_Speed_FR_kph : 16|16@1+ (0.0333,0) [0|300] "km/h" Vector__XXX
 SG_ Wheel_Speed_FR_mph : 16|16@1+ (0.0206793,0) [0|186.3] "mph" Vector__XXX
 SG_ Wheel_Speed_RL_kph : 32|16@1+ (0.0333,0) [0|300] "km/h" Vector__XXX
 SG_ Wheel_Speed_RL_mph : 32|16@1+ (0.0206793,0) [0|186.3] "mph" Vector__XXX
 SG_ Wheel_Speed_RR_kph : 48|16@1+ (0.03333,0) [0|300] "km/h" Vector__XXX
 SG_ Wheel_Speed_RR_mph : 48|16@1+ (0.02069793,0) [0|186.3] "mph" Vector__XXX

BO_ 236 MSG_0EC: 8 Vector__XXX
 SG_ Steering_Angle : 32|16@1- (-0.1,0) [-540|540] "��" Vector__XXX

BO_ 961 MSG_3C1: 8 Vector__XXX
 SG_ Indicator_Left : 28|1@0+ (1,0) [0|1] "on/off" Vector__XXX
 SG_ Indicator_Right : 30|1@0+ (1,0) [0|1] "on/off" Vector__XXX
