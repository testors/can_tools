VERSION ""

NS_ :

BS_: 500

BU_: Vector__XXX

BO_ 160 MSG_0A0: 8 Vector__XXX
 SG_ Engine_Speed : 16|16@1+ (0.25,0) [0|16383.75] "rpm" Vector__XXX

BO_ 688 MSG_2B0: 8 Vector__XXX
 SG_ Steering_Angle : 0|16@1- (-0.1,0) [-720|720] "��" Vector__XXX

BO_ 809 MSG_329: 8 Vector__XXX
 SG_ Accelerator_Pedal_Position : 8|8@0+ (0.393701,0) [0|100] "%" Vector__XXX
