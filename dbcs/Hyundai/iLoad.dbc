VERSION ""

NS_ :

BS_: 500

BU_: Vector__XXX

BO_ 497 MSG_1F1: 8 Vector__XXX
 SG_ Wheel_Speed_1_kph : 12|12@0+ (0.008,0) [0|0] "km/h" Vector__XXX
 SG_ Wheel_Speed_1_mph : 12|12@0+ (0.004968,0) [0|0] "mph" Vector__XXX
 SG_ Wheel_Speed_2_kph : 28|12@1+ (0.0625,0) [0|0] "km/h" Vector__XXX
 SG_ Wheel_Speed_2_mph : 28|12@1+ (0.0388125,0) [0|0] "mph" Vector__XXX
 SG_ Wheel_Speed_3_kph : 40|12@1+ (0.0625,0) [0|0] "km/h" Vector__XXX
 SG_ Wheel_Speed_3_mph : 40|12@1+ (0.0388125,0) [0|0] "mph" Vector__XXX
 SG_ Wheel_Speed_4_kph : 52|12@1+ (0.0625,0) [0|0] "km/h" Vector__XXX
 SG_ Wheel_Speed_4_mph : 52|12@1+ (0.0388125,0) [0|0] "mph" Vector__XXX

BO_ 790 MSG_316: 8 Vector__XXX
 SG_ Engine_Speed : 24|16@0+ (0.25,0) [0|10000] "rpm" Vector__XXX

BO_ 809 MSG_329: 8 Vector__XXX
 SG_ Throttle_Position : 16|8@0+ (0.46948356808,-15.023474178) [0|0] "" Vector__XXX
 SG_ Brake_Position : 24|1@0+ (-1,1) [0|0] "" Vector__XXX

BO_ 1349 MSG_545: 8 Vector__XXX
 SG_ Battery_Voltage : 32|8@0+ (0.1,0) [0|0] "" Vector__XXX
