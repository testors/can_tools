VERSION ""

NS_ :

BS_: 500

BU_: Vector__XXX

BO_ 497 MSG_1F1: 8 Vector__XXX
 SG_ Wheel_Speed_1_kph : 0|12@0+ (0.0625,0) [0|4095] "km/h" Vector__XXX
 SG_ Wheel_Speed_1_mph : 0|12@0+ (0.0388125,0) [0|2542.995] "mph" Vector__XXX
 SG_ Wheel_Speed_2_kph : 12|12@0+ (0.0625,0) [0|4095] "km/h" Vector__XXX
 SG_ Wheel_Speed_2_mph : 12|12@0+ (0.0388125,0) [0|2542.995] "mph" Vector__XXX
 SG_ Wheel_Speed_3_kph : 24|12@0+ (0.0625,0) [0|4095] "km/h" Vector__XXX
 SG_ Wheel_Speed_3_mph : 24|12@0+ (0.0388125,0) [0|2542.995] "mph" Vector__XXX
 SG_ Wheel_Speed_4_kph : 36|12@0+ (0.0625,0) [0|4095] "km/h" Vector__XXX
 SG_ Wheel_Speed_4_mph : 36|12@0+ (0.0388125,0) [0|2542.995] "mph" Vector__XXX

BO_ 688 MSG_2B0: 5 Vector__XXX
 SG_ Steering_Angle : 0|16@1- (-0.1,0) [0|65535] "" Vector__XXX

BO_ 809 MSG_329: 8 Vector__XXX
 SG_ Accelerator_Pedal_Position : 16|8@0+ (0.47,-15) [0|100] "%" Vector__XXX

BO_ 1087 MSG_43F: 8 Vector__XXX
 SG_ Engine_Speed : 40|16@1+ (0.25,0) [0|10000] "rpm" Vector__XXX
 SG_ Gear : 56|3@0+ (1,0) [0|7] "" Vector__XXX

BO_ 1088 MSG_440: 8 Vector__XXX
 SG_ Brake_Position : 35|1@0+ (1,0) [0|0] "" Vector__XXX
