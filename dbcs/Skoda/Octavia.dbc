VERSION ""

NS_ :

BS_: 500

BU_: Vector__XXX

BO_ 194 MSG_0C2: 8 Vector__XXX
 SG_ Steering_Angle : 0|15@1+ (0.043956,0) [0|0] "��" Vector__XXX
