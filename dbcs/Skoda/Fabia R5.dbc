VERSION ""

NS_ :

BS_: 500

BU_: Vector__XXX

BO_ 100 MSG_064: 8 Vector__XXX
 SG_ Brake_Pressure____Front : 0|16@0+ (0.1,0) [0|0] "bar" Vector__XXX
 SG_ Indicated_Vehicle_Speed_kph : 16|16@0+ (0.1,0) [0|0] "km/h" Vector__XXX
 SG_ Indicated_Vehicle_Speed_mph : 16|16@0+ (0.0621,0) [0|0] "mph" Vector__XXX
 SG_ Accelerator_Pedal_Position : 32|16@0+ (0.1,0) [0|0] "%" Vector__XXX
 SG_ Engine_Speed : 48|16@0+ (1,0) [0|10000] "rpm" Vector__XXX

BO_ 101 MSG_065: 8 Vector__XXX
 SG_ Gear : 48|16@0+ (0.00390625,0) [0|0] "" Vector__XXX
